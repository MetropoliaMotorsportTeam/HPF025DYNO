VERSION ""

NS_ :

BS_:

BU_: IVT_Mod ECU Inverters AMS

VAL_TABLE_ _B9_Voltage_Channels 3 "3 Channels" 0 "0 Channels" ;
VAL_TABLE_ _B9_Supply_Voltage 1 "12 / 24 V nominal supply voltage" ;
VAL_TABLE_ _B9_Current 2500 "2500 A" 1000 "1000 A" 500 "500 A" 300 "300 A" 100 "100 A" ;
VAL_TABLE_ _B9_Device_Type 2 "IVT-S" 1 "IVT-Mod" ;
VAL_TABLE_ VtDevice_Com 2 "CAN 2 - not terminated" 1 "CAN 1 - terminated" 0 "none" ;
VAL_TABLE_ VtDevice_TOI 3 "I" ;
VAL_TABLE_ VtResetErrorLogdata 7 "Reset error current implausible" 6 "Reset error Vref" 5 "Reset error Underflow ADC ch2" 4 "Reset error Overflow ADC ch2" 3 "Reset error Underflow ADC ch1" 2 "Reset error Overflow ADC ch1" 1 "Reset error ADC interrupt" 0 "Reset all measurement errors" ;
VAL_TABLE_ VtID_Result 0 "Vt_Result_inaktive" 8 "Vt_Result_Wh" 7 "Vt_Result_Ah" 6 "Vt_Result_W" 5 "Vt_Result_T" 4 "Vt_Result_U3" 3 "Vt_Result_U2" 2 "Vt_Result_U1" 1 "Vt_Result_I" ;
VAL_TABLE_ VtID_Cmd 54 "Set_THRESHOLD_neg" 53 "Set_THRESHOLD_pos" 32 "Set_MODE_Result_I" 16 "Set_CAN_ID_Result_I" 52 "Set_MODE" 51 "START_OC_TEST" 50 "STORE" 49 "TRIGGER" 48 "Reset_Err_Log" 39 "Set_MODE_Result_Wh" 38 "Set_MODE_Result_Ah" 37 "Set_MODE_Result_W" 23 "Set_CAN_ID_Result_Wh" 22 "Set_CAN_ID_Result_Ah" 21 "Set_CAN_ID_Result_W" 20 "Set_CAN_ID_Result_T" 35 "Set_MODE_Result_U3" 31 "Set_CAN_ID_Cmd" 29 "Set_CAN_ID_Response" 19 "Set_CAN_ID_Result_U3" 18 "Set_CAN_ID_Result_U2" 36 "Set_MODE_Result_T" 34 "Set_MODE_Result_U2" 33 "Set_MODE_Result_U1" 17 "Set_CAN_ID_Result_U1" ;
VAL_TABLE_ VtTriggerMode 2 "CYCLIC" 1 "TRIGGERED" 0 "DISABLED" ;
VAL_TABLE_ VtRunMode 1 "START" 0 "STOP" ;
VAL_TABLE_ VtID_Response 149 "ARTICLE_NUMBER" 148 "SERIAL NUMBER" 147 "SW_VERSION" 146 "DEVICE_ID" 145 "STATUS" 143 "CAN_ID" 142 "STORE_to_default" 134 "START_OC_TEST" 133 "Description for the value '0x85'" 132 "THRESHOLD" 131 "CONFIG" 130 "MODE" 129 "STORE" 128 "TRIGGER" ;

BO_ 3221225472 VECTOR__INDEPENDENT_SIG_MSG: 0 Vector__XXX
 SG_ _B1_Resp_Trigger_Mask : 0|16@0+ (1,0) [0|0] "" Vector__XXX
 SG_ _B9_Resp_Device_spare : 0|8@0+ (1,0) [0|0] "" Vector__XXX
 SG_ Device_dc_link_vol_5 : 0|16@1- (0.0625,0) [-2048|2047.9375] "V" Vector__XXX
 SG_ Device_ambient_temp_5 : 16|16@1- (0.0625,0) [-2048|2047.9375] "�C" Vector__XXX
 SG_ Device_dc_link_power_5 : 32|16@1- (0.016,0) [-524.288|524.272] "kW" Vector__XXX
 SG_ Device_dc_link_vol_4 : 0|16@1- (0.0625,0) [-2048|2047.9375] "V" Vector__XXX
 SG_ Device_ambient_temp_4 : 16|16@1- (0.0625,0) [-2048|2047.9375] "�C" Vector__XXX
 SG_ Device_dc_link_power_4 : 32|16@1- (0.016,0) [-524.288|524.272] "kW" Vector__XXX
 SG_ Device_dc_link_vol_3 : 0|16@1- (0.0625,0) [-2048|2047.9375] "V" Vector__XXX
 SG_ Device_ambient_temp_3 : 16|16@1- (0.0625,0) [-2048|2047.9375] "�C" Vector__XXX
 SG_ Device_dc_link_power_3 : 32|16@1- (0.016,0) [-524.288|524.272] "kW" Vector__XXX
 SG_ Device_dc_link_vol_2 : 0|16@1- (0.0625,0) [-2048|2047.9375] "V" Vector__XXX
 SG_ Device_ambient_temp_2 : 16|16@1- (0.0625,0) [-2048|2047.9375] "�C" Vector__XXX
 SG_ Device_dc_link_power_2 : 32|16@1- (0.016,0) [-524.288|524.272] "kW" Vector__XXX
 SG_ Device_dc_link_vol_1 : 0|16@1- (0.0625,0) [-2048|2047.9375] "V" Vector__XXX
 SG_ Device_ambient_temp_1 : 16|16@1- (0.0625,0) [-2048|2047.9375] "�C" Vector__XXX
 SG_ Device_dc_link_power_1 : 32|16@1- (0.016,0) [-524.288|524.272] "kW" Vector__XXX
 SG_ Device_dc_link_vol_13 : 0|16@1- (0.0625,0) [-2048|2047.9375] "V" Vector__XXX
 SG_ Device_ambient_temp_13 : 16|16@1- (0.0625,0) [-2048|2047.9375] "�C" Vector__XXX
 SG_ Device_dc_link_power_13 : 32|16@1- (0.016,0) [-524.288|524.272] "kW" Vector__XXX
 SG_ Device_dc_link_vol_12 : 0|16@1- (0.0625,0) [-2048|2047.9375] "V" Vector__XXX
 SG_ Device_ambient_temp_12 : 16|16@1- (0.0625,0) [-2048|2047.9375] "�C" Vector__XXX
 SG_ Device_dc_link_power_12 : 32|16@1- (0.016,0) [-524.288|524.272] "kW" Vector__XXX
 SG_ Device_dc_link_vol_11 : 0|16@1- (0.0625,0) [-2048|2047.9375] "V" Vector__XXX
 SG_ Device_ambient_temp_11 : 16|16@1- (0.0625,0) [-2048|2047.9375] "�C" Vector__XXX
 SG_ Device_dc_link_power_11 : 32|16@1- (0.016,0) [-524.288|524.272] "kW" Vector__XXX
 SG_ Device_dc_link_vol_10 : 0|16@1- (0.0625,0) [-2048|2047.9375] "V" Vector__XXX
 SG_ Device_ambient_temp_10 : 16|16@1- (0.0625,0) [-2048|2047.9375] "�C" Vector__XXX
 SG_ Device_dc_link_power_10 : 32|16@1- (0.016,0) [-524.288|524.272] "kW" Vector__XXX
 SG_ Device_dc_link_vol_9 : 0|16@1- (0.0625,0) [-2048|2047.9375] "V" Vector__XXX
 SG_ Device_ambient_temp_9 : 16|16@1- (0.0625,0) [-2048|2047.9375] "�C" Vector__XXX
 SG_ Device_dc_link_power_9 : 32|16@1- (0.016,0) [-524.288|524.272] "kW" Vector__XXX
 SG_ Device_dc_link_vol_8 : 0|16@1- (0.0625,0) [-2048|2047.9375] "V" Vector__XXX
 SG_ Device_ambient_temp_8 : 16|16@1- (0.0625,0) [-2048|2047.9375] "�C" Vector__XXX
 SG_ Device_dc_link_power_8 : 32|16@1- (0.016,0) [-524.288|524.272] "kW" Vector__XXX
 SG_ Device_dc_link_vol_7 : 0|16@1- (0.0625,0) [-2048|2047.9375] "V" Vector__XXX
 SG_ Device_ambient_temp_7 : 16|16@1- (0.0625,0) [-2048|2047.9375] "�C" Vector__XXX
 SG_ Device_dc_link_power_7 : 32|16@1- (0.016,0) [-524.288|524.272] "kW" Vector__XXX
 SG_ Inverter_A_Statusword_5 : 0|7@1+ (1,0) [0|127] "" Vector__XXX
 SG_ EVENTBUFFER_NEW_EVENT : 16|1@1+ (1,0) [0|1] "" Vector__XXX
 SG_ EVENTBUFFER_OVERFLOW : 17|1@1+ (1,0) [0|1] "" Vector__XXX
 SG_ POWERMODULE_TRIPZONE_OVERCURRE : 18|1@1+ (1,0) [0|1] "" Vector__XXX
 SG_ POWERMODULE_CURRENT_OFFSET_INI : 19|1@1+ (1,0) [0|1] "" Vector__XXX
 SG_ POWERMODULE_TEMPSENSOR_ERROR : 20|1@1+ (1,0) [0|1] "" Vector__XXX
 SG_ POWERMODULE_TEMPERATURE_WARNIN : 21|1@1+ (1,0) [0|1] "" Vector__XXX
 SG_ POWERMODULE_OVERTEMPERATURE : 22|1@1+ (1,0) [0|1] "" Vector__XXX
 SG_ POWERMODULE_IXT_FAULT : 23|1@1+ (1,0) [0|1] "" Vector__XXX
 SG_ POWERMODULE_SW_OVERCURRENT : 24|1@1+ (1,0) [0|1] "" Vector__XXX
 SG_ POWERMODULE_PATTERNDATA_INCONS : 25|1@1+ (1,0) [0|1] "" Vector__XXX
 SG_ DCBUS_TRIPZONE_OVERVOLTAGE : 26|1@1+ (1,0) [0|1] "" Vector__XXX
 SG_ DCBUS_SW_OVERVOLTAGE : 27|1@1+ (1,0) [0|1] "" Vector__XXX
 SG_ DCBUS_SW_UNDERVOLTAGE : 28|1@1+ (1,0) [0|1] "" Vector__XXX
 SG_ NEIGHBOUR_FAULT : 29|1@1+ (1,0) [0|1] "" Vector__XXX
 SG_ MOTOR_TEMPSENSOR_ERROR : 30|1@1+ (1,0) [0|1] "" Vector__XXX
 SG_ MOTOR_TEMPERATURE_WARNING : 31|1@1+ (1,0) [0|1] "" Vector__XXX
 SG_ MOTOR_OVERTEMPERATURE : 32|1@1+ (1,0) [0|1] "" Vector__XXX
 SG_ MOTOR_STATOR_FREQ_TO_HIGH : 33|1@1+ (1,0) [0|1] "" Vector__XXX
 SG_ SUPPLYVOLTAGE_ERROR : 34|1@1+ (1,0) [0|1] "" Vector__XXX
 SG_ RPDO_TIMEOUT : 35|1@1+ (1,0) [0|1] "" Vector__XXX
 SG_ NMT_NOT_OPERATIONAL : 36|1@1+ (1,0) [0|1] "" Vector__XXX
 SG_ TASKOVERRUN : 37|1@1+ (1,0) [0|1] "" Vector__XXX
 SG_ NETSYNC_ERROR : 38|1@1+ (1,0) [0|1] "" Vector__XXX
 SG_ POSDEVICE_SIGNAL_TO_LOW : 39|1@1+ (1,0) [0|1] "" Vector__XXX
 SG_ POSDEVICE_SIGNAL_TO_HIGH : 40|1@1+ (1,0) [0|1] "" Vector__XXX
 SG_ RESOLVER_CALIBRATION_FAILED : 41|1@1+ (1,0) [0|1] "" Vector__XXX
 SG_ SYSTEM_FAULT : 42|1@1+ (1,0) [0|1] "" Vector__XXX
 SG_ INTERLOCK_OPEN : 43|1@1+ (1,0) [0|1] "" Vector__XXX
 SG_ APPC_HAS_GATE_DRIVER_DISABLED : 44|1@1+ (1,0) [0|1] "" Vector__XXX
 SG_ MOTOR_STALL_ERROR : 45|1@1+ (1,0) [0|1] "" Vector__XXX
 SG_ AMBIENT_TEMPERATURE_WARNING : 46|1@1+ (1,0) [0|1] "" Vector__XXX
 SG_ AMBIENT_OVERTEMPERATURE : 47|1@1+ (1,0) [0|1] "" Vector__XXX
 SG_ AMBIENT_TEMPSENSOR_ERROR : 48|1@1+ (1,0) [0|1] "" Vector__XXX
 SG_ POWERMODULE_CLAMPING_TIMEOUT : 49|1@1+ (1,0) [0|1] "" Vector__XXX
 SG_ DCBUS_RIPPLE_TO_HIGH : 50|1@1+ (1,0) [0|1] "" Vector__XXX
 SG_ MOTOR_I2XT_WARNING : 51|1@1+ (1,0) [0|1] "" Vector__XXX
 SG_ MOTOR_I2XT_ERROR : 52|1@1+ (1,0) [0|1] "" Vector__XXX
 SG_ MOTOR_FIELDWEAKENING_ERROR : 53|1@1+ (1,0) [0|1] "" Vector__XXX
 SG_ INVALID_PARAMETER_COMBINATION : 54|1@1+ (1,0) [0|1] "" Vector__XXX
 SG_ PLUG_COVER_SENSOR_SIGNAL_LOW : 55|1@1+ (1,0) [0|1] "" Vector__XXX
 SG_ MOTOR_CONNECTION_TEST_FAILED : 56|1@1+ (1,0) [0|1] "" Vector__XXX
 SG_ POWERMODULE_IXT_WARNING : 57|1@1+ (1,0) [0|1] "" Vector__XXX
 SG_ ISOLATION_FAULT : 58|1@1+ (1,0) [0|1] "" Vector__XXX
 SG_ Inverter_A_Statusword_4 : 0|7@1+ (1,0) [0|127] "" Vector__XXX
 SG_ EVENTBUFFER_NEW_EVENT : 16|1@1+ (1,0) [0|1] "" Vector__XXX
 SG_ EVENTBUFFER_OVERFLOW : 17|1@1+ (1,0) [0|1] "" Vector__XXX
 SG_ POWERMODULE_TRIPZONE_OVERCURRE : 18|1@1+ (1,0) [0|1] "" Vector__XXX
 SG_ POWERMODULE_CURRENT_OFFSET_INI : 19|1@1+ (1,0) [0|1] "" Vector__XXX
 SG_ POWERMODULE_TEMPSENSOR_ERROR : 20|1@1+ (1,0) [0|1] "" Vector__XXX
 SG_ POWERMODULE_TEMPERATURE_WARNIN : 21|1@1+ (1,0) [0|1] "" Vector__XXX
 SG_ POWERMODULE_OVERTEMPERATURE : 22|1@1+ (1,0) [0|1] "" Vector__XXX
 SG_ POWERMODULE_IXT_FAULT : 23|1@1+ (1,0) [0|1] "" Vector__XXX
 SG_ POWERMODULE_SW_OVERCURRENT : 24|1@1+ (1,0) [0|1] "" Vector__XXX
 SG_ POWERMODULE_PATTERNDATA_INCONS : 25|1@1+ (1,0) [0|1] "" Vector__XXX
 SG_ DCBUS_TRIPZONE_OVERVOLTAGE : 26|1@1+ (1,0) [0|1] "" Vector__XXX
 SG_ DCBUS_SW_OVERVOLTAGE : 27|1@1+ (1,0) [0|1] "" Vector__XXX
 SG_ DCBUS_SW_UNDERVOLTAGE : 28|1@1+ (1,0) [0|1] "" Vector__XXX
 SG_ NEIGHBOUR_FAULT : 29|1@1+ (1,0) [0|1] "" Vector__XXX
 SG_ MOTOR_TEMPSENSOR_ERROR : 30|1@1+ (1,0) [0|1] "" Vector__XXX
 SG_ MOTOR_TEMPERATURE_WARNING : 31|1@1+ (1,0) [0|1] "" Vector__XXX
 SG_ MOTOR_OVERTEMPERATURE : 32|1@1+ (1,0) [0|1] "" Vector__XXX
 SG_ MOTOR_STATOR_FREQ_TO_HIGH : 33|1@1+ (1,0) [0|1] "" Vector__XXX
 SG_ SUPPLYVOLTAGE_ERROR : 34|1@1+ (1,0) [0|1] "" Vector__XXX
 SG_ RPDO_TIMEOUT : 35|1@1+ (1,0) [0|1] "" Vector__XXX
 SG_ NMT_NOT_OPERATIONAL : 36|1@1+ (1,0) [0|1] "" Vector__XXX
 SG_ TASKOVERRUN : 37|1@1+ (1,0) [0|1] "" Vector__XXX
 SG_ NETSYNC_ERROR : 38|1@1+ (1,0) [0|1] "" Vector__XXX
 SG_ POSDEVICE_SIGNAL_TO_LOW : 39|1@1+ (1,0) [0|1] "" Vector__XXX
 SG_ POSDEVICE_SIGNAL_TO_HIGH : 40|1@1+ (1,0) [0|1] "" Vector__XXX
 SG_ RESOLVER_CALIBRATION_FAILED : 41|1@1+ (1,0) [0|1] "" Vector__XXX
 SG_ SYSTEM_FAULT : 42|1@1+ (1,0) [0|1] "" Vector__XXX
 SG_ INTERLOCK_OPEN : 43|1@1+ (1,0) [0|1] "" Vector__XXX
 SG_ APPC_HAS_GATE_DRIVER_DISABLED : 44|1@1+ (1,0) [0|1] "" Vector__XXX
 SG_ MOTOR_STALL_ERROR : 45|1@1+ (1,0) [0|1] "" Vector__XXX
 SG_ AMBIENT_TEMPERATURE_WARNING : 46|1@1+ (1,0) [0|1] "" Vector__XXX
 SG_ AMBIENT_OVERTEMPERATURE : 47|1@1+ (1,0) [0|1] "" Vector__XXX
 SG_ AMBIENT_TEMPSENSOR_ERROR : 48|1@1+ (1,0) [0|1] "" Vector__XXX
 SG_ POWERMODULE_CLAMPING_TIMEOUT : 49|1@1+ (1,0) [0|1] "" Vector__XXX
 SG_ DCBUS_RIPPLE_TO_HIGH : 50|1@1+ (1,0) [0|1] "" Vector__XXX
 SG_ MOTOR_I2XT_WARNING : 51|1@1+ (1,0) [0|1] "" Vector__XXX
 SG_ MOTOR_I2XT_ERROR : 52|1@1+ (1,0) [0|1] "" Vector__XXX
 SG_ MOTOR_FIELDWEAKENING_ERROR : 53|1@1+ (1,0) [0|1] "" Vector__XXX
 SG_ INVALID_PARAMETER_COMBINATION : 54|1@1+ (1,0) [0|1] "" Vector__XXX
 SG_ PLUG_COVER_SENSOR_SIGNAL_LOW : 55|1@1+ (1,0) [0|1] "" Vector__XXX
 SG_ MOTOR_CONNECTION_TEST_FAILED : 56|1@1+ (1,0) [0|1] "" Vector__XXX
 SG_ POWERMODULE_IXT_WARNING : 57|1@1+ (1,0) [0|1] "" Vector__XXX
 SG_ ISOLATION_FAULT : 58|1@1+ (1,0) [0|1] "" Vector__XXX
 SG_ Inverter_A_Statusword_3 : 0|7@1+ (1,0) [0|127] "" Vector__XXX
 SG_ EVENTBUFFER_NEW_EVENT : 16|1@1+ (1,0) [0|1] "" Vector__XXX
 SG_ EVENTBUFFER_OVERFLOW : 17|1@1+ (1,0) [0|1] "" Vector__XXX
 SG_ POWERMODULE_TRIPZONE_OVERCURRE : 18|1@1+ (1,0) [0|1] "" Vector__XXX
 SG_ POWERMODULE_CURRENT_OFFSET_INI : 19|1@1+ (1,0) [0|1] "" Vector__XXX
 SG_ POWERMODULE_TEMPSENSOR_ERROR : 20|1@1+ (1,0) [0|1] "" Vector__XXX
 SG_ POWERMODULE_TEMPERATURE_WARNIN : 21|1@1+ (1,0) [0|1] "" Vector__XXX
 SG_ POWERMODULE_OVERTEMPERATURE : 22|1@1+ (1,0) [0|1] "" Vector__XXX
 SG_ POWERMODULE_IXT_FAULT : 23|1@1+ (1,0) [0|1] "" Vector__XXX
 SG_ POWERMODULE_SW_OVERCURRENT : 24|1@1+ (1,0) [0|1] "" Vector__XXX
 SG_ POWERMODULE_PATTERNDATA_INCONS : 25|1@1+ (1,0) [0|1] "" Vector__XXX
 SG_ DCBUS_TRIPZONE_OVERVOLTAGE : 26|1@1+ (1,0) [0|1] "" Vector__XXX
 SG_ DCBUS_SW_OVERVOLTAGE : 27|1@1+ (1,0) [0|1] "" Vector__XXX
 SG_ DCBUS_SW_UNDERVOLTAGE : 28|1@1+ (1,0) [0|1] "" Vector__XXX
 SG_ NEIGHBOUR_FAULT : 29|1@1+ (1,0) [0|1] "" Vector__XXX
 SG_ MOTOR_TEMPSENSOR_ERROR : 30|1@1+ (1,0) [0|1] "" Vector__XXX
 SG_ MOTOR_TEMPERATURE_WARNING : 31|1@1+ (1,0) [0|1] "" Vector__XXX
 SG_ MOTOR_OVERTEMPERATURE : 32|1@1+ (1,0) [0|1] "" Vector__XXX
 SG_ MOTOR_STATOR_FREQ_TO_HIGH : 33|1@1+ (1,0) [0|1] "" Vector__XXX
 SG_ SUPPLYVOLTAGE_ERROR : 34|1@1+ (1,0) [0|1] "" Vector__XXX
 SG_ RPDO_TIMEOUT : 35|1@1+ (1,0) [0|1] "" Vector__XXX
 SG_ NMT_NOT_OPERATIONAL : 36|1@1+ (1,0) [0|1] "" Vector__XXX
 SG_ TASKOVERRUN : 37|1@1+ (1,0) [0|1] "" Vector__XXX
 SG_ NETSYNC_ERROR : 38|1@1+ (1,0) [0|1] "" Vector__XXX
 SG_ POSDEVICE_SIGNAL_TO_LOW : 39|1@1+ (1,0) [0|1] "" Vector__XXX
 SG_ POSDEVICE_SIGNAL_TO_HIGH : 40|1@1+ (1,0) [0|1] "" Vector__XXX
 SG_ RESOLVER_CALIBRATION_FAILED : 41|1@1+ (1,0) [0|1] "" Vector__XXX
 SG_ SYSTEM_FAULT : 42|1@1+ (1,0) [0|1] "" Vector__XXX
 SG_ INTERLOCK_OPEN : 43|1@1+ (1,0) [0|1] "" Vector__XXX
 SG_ APPC_HAS_GATE_DRIVER_DISABLED : 44|1@1+ (1,0) [0|1] "" Vector__XXX
 SG_ MOTOR_STALL_ERROR : 45|1@1+ (1,0) [0|1] "" Vector__XXX
 SG_ AMBIENT_TEMPERATURE_WARNING : 46|1@1+ (1,0) [0|1] "" Vector__XXX
 SG_ AMBIENT_OVERTEMPERATURE : 47|1@1+ (1,0) [0|1] "" Vector__XXX
 SG_ AMBIENT_TEMPSENSOR_ERROR : 48|1@1+ (1,0) [0|1] "" Vector__XXX
 SG_ POWERMODULE_CLAMPING_TIMEOUT : 49|1@1+ (1,0) [0|1] "" Vector__XXX
 SG_ DCBUS_RIPPLE_TO_HIGH : 50|1@1+ (1,0) [0|1] "" Vector__XXX
 SG_ MOTOR_I2XT_WARNING : 51|1@1+ (1,0) [0|1] "" Vector__XXX
 SG_ MOTOR_I2XT_ERROR : 52|1@1+ (1,0) [0|1] "" Vector__XXX
 SG_ MOTOR_FIELDWEAKENING_ERROR : 53|1@1+ (1,0) [0|1] "" Vector__XXX
 SG_ INVALID_PARAMETER_COMBINATION : 54|1@1+ (1,0) [0|1] "" Vector__XXX
 SG_ PLUG_COVER_SENSOR_SIGNAL_LOW : 55|1@1+ (1,0) [0|1] "" Vector__XXX
 SG_ MOTOR_CONNECTION_TEST_FAILED : 56|1@1+ (1,0) [0|1] "" Vector__XXX
 SG_ POWERMODULE_IXT_WARNING : 57|1@1+ (1,0) [0|1] "" Vector__XXX
 SG_ ISOLATION_FAULT : 58|1@1+ (1,0) [0|1] "" Vector__XXX
 SG_ Inverter_A_Statusword_2 : 0|7@1+ (1,0) [0|127] "" Vector__XXX
 SG_ EVENTBUFFER_NEW_EVENT : 16|1@1+ (1,0) [0|1] "" Vector__XXX
 SG_ EVENTBUFFER_OVERFLOW : 17|1@1+ (1,0) [0|1] "" Vector__XXX
 SG_ POWERMODULE_TRIPZONE_OVERCURRE : 18|1@1+ (1,0) [0|1] "" Vector__XXX
 SG_ POWERMODULE_CURRENT_OFFSET_INI : 19|1@1+ (1,0) [0|1] "" Vector__XXX
 SG_ POWERMODULE_TEMPSENSOR_ERROR : 20|1@1+ (1,0) [0|1] "" Vector__XXX
 SG_ POWERMODULE_TEMPERATURE_WARNIN : 21|1@1+ (1,0) [0|1] "" Vector__XXX
 SG_ POWERMODULE_OVERTEMPERATURE : 22|1@1+ (1,0) [0|1] "" Vector__XXX
 SG_ POWERMODULE_IXT_FAULT : 23|1@1+ (1,0) [0|1] "" Vector__XXX
 SG_ POWERMODULE_SW_OVERCURRENT : 24|1@1+ (1,0) [0|1] "" Vector__XXX
 SG_ POWERMODULE_PATTERNDATA_INCONS : 25|1@1+ (1,0) [0|1] "" Vector__XXX
 SG_ DCBUS_TRIPZONE_OVERVOLTAGE : 26|1@1+ (1,0) [0|1] "" Vector__XXX
 SG_ DCBUS_SW_OVERVOLTAGE : 27|1@1+ (1,0) [0|1] "" Vector__XXX
 SG_ DCBUS_SW_UNDERVOLTAGE : 28|1@1+ (1,0) [0|1] "" Vector__XXX
 SG_ NEIGHBOUR_FAULT : 29|1@1+ (1,0) [0|1] "" Vector__XXX
 SG_ MOTOR_TEMPSENSOR_ERROR : 30|1@1+ (1,0) [0|1] "" Vector__XXX
 SG_ MOTOR_TEMPERATURE_WARNING : 31|1@1+ (1,0) [0|1] "" Vector__XXX
 SG_ MOTOR_OVERTEMPERATURE : 32|1@1+ (1,0) [0|1] "" Vector__XXX
 SG_ MOTOR_STATOR_FREQ_TO_HIGH : 33|1@1+ (1,0) [0|1] "" Vector__XXX
 SG_ SUPPLYVOLTAGE_ERROR : 34|1@1+ (1,0) [0|1] "" Vector__XXX
 SG_ RPDO_TIMEOUT : 35|1@1+ (1,0) [0|1] "" Vector__XXX
 SG_ NMT_NOT_OPERATIONAL : 36|1@1+ (1,0) [0|1] "" Vector__XXX
 SG_ TASKOVERRUN : 37|1@1+ (1,0) [0|1] "" Vector__XXX
 SG_ NETSYNC_ERROR : 38|1@1+ (1,0) [0|1] "" Vector__XXX
 SG_ POSDEVICE_SIGNAL_TO_LOW : 39|1@1+ (1,0) [0|1] "" Vector__XXX
 SG_ POSDEVICE_SIGNAL_TO_HIGH : 40|1@1+ (1,0) [0|1] "" Vector__XXX
 SG_ RESOLVER_CALIBRATION_FAILED : 41|1@1+ (1,0) [0|1] "" Vector__XXX
 SG_ SYSTEM_FAULT : 42|1@1+ (1,0) [0|1] "" Vector__XXX
 SG_ INTERLOCK_OPEN : 43|1@1+ (1,0) [0|1] "" Vector__XXX
 SG_ APPC_HAS_GATE_DRIVER_DISABLED : 44|1@1+ (1,0) [0|1] "" Vector__XXX
 SG_ MOTOR_STALL_ERROR : 45|1@1+ (1,0) [0|1] "" Vector__XXX
 SG_ AMBIENT_TEMPERATURE_WARNING : 46|1@1+ (1,0) [0|1] "" Vector__XXX
 SG_ AMBIENT_OVERTEMPERATURE : 47|1@1+ (1,0) [0|1] "" Vector__XXX
 SG_ AMBIENT_TEMPSENSOR_ERROR : 48|1@1+ (1,0) [0|1] "" Vector__XXX
 SG_ POWERMODULE_CLAMPING_TIMEOUT : 49|1@1+ (1,0) [0|1] "" Vector__XXX
 SG_ DCBUS_RIPPLE_TO_HIGH : 50|1@1+ (1,0) [0|1] "" Vector__XXX
 SG_ MOTOR_I2XT_WARNING : 51|1@1+ (1,0) [0|1] "" Vector__XXX
 SG_ MOTOR_I2XT_ERROR : 52|1@1+ (1,0) [0|1] "" Vector__XXX
 SG_ MOTOR_FIELDWEAKENING_ERROR : 53|1@1+ (1,0) [0|1] "" Vector__XXX
 SG_ INVALID_PARAMETER_COMBINATION : 54|1@1+ (1,0) [0|1] "" Vector__XXX
 SG_ PLUG_COVER_SENSOR_SIGNAL_LOW : 55|1@1+ (1,0) [0|1] "" Vector__XXX
 SG_ MOTOR_CONNECTION_TEST_FAILED : 56|1@1+ (1,0) [0|1] "" Vector__XXX
 SG_ POWERMODULE_IXT_WARNING : 57|1@1+ (1,0) [0|1] "" Vector__XXX
 SG_ ISOLATION_FAULT : 58|1@1+ (1,0) [0|1] "" Vector__XXX
 SG_ Inverter_A_Statusword_1 : 0|7@1+ (1,0) [0|127] "" Vector__XXX
 SG_ EVENTBUFFER_NEW_EVENT : 16|1@1+ (1,0) [0|1] "" Vector__XXX
 SG_ EVENTBUFFER_OVERFLOW : 17|1@1+ (1,0) [0|1] "" Vector__XXX
 SG_ POWERMODULE_TRIPZONE_OVERCURRE : 18|1@1+ (1,0) [0|1] "" Vector__XXX
 SG_ POWERMODULE_CURRENT_OFFSET_INI : 19|1@1+ (1,0) [0|1] "" Vector__XXX
 SG_ POWERMODULE_TEMPSENSOR_ERROR : 20|1@1+ (1,0) [0|1] "" Vector__XXX
 SG_ POWERMODULE_TEMPERATURE_WARNIN : 21|1@1+ (1,0) [0|1] "" Vector__XXX
 SG_ POWERMODULE_OVERTEMPERATURE : 22|1@1+ (1,0) [0|1] "" Vector__XXX
 SG_ POWERMODULE_IXT_FAULT : 23|1@1+ (1,0) [0|1] "" Vector__XXX
 SG_ POWERMODULE_SW_OVERCURRENT : 24|1@1+ (1,0) [0|1] "" Vector__XXX
 SG_ POWERMODULE_PATTERNDATA_INCONS : 25|1@1+ (1,0) [0|1] "" Vector__XXX
 SG_ DCBUS_TRIPZONE_OVERVOLTAGE : 26|1@1+ (1,0) [0|1] "" Vector__XXX
 SG_ DCBUS_SW_OVERVOLTAGE : 27|1@1+ (1,0) [0|1] "" Vector__XXX
 SG_ DCBUS_SW_UNDERVOLTAGE : 28|1@1+ (1,0) [0|1] "" Vector__XXX
 SG_ NEIGHBOUR_FAULT : 29|1@1+ (1,0) [0|1] "" Vector__XXX
 SG_ MOTOR_TEMPSENSOR_ERROR : 30|1@1+ (1,0) [0|1] "" Vector__XXX
 SG_ MOTOR_TEMPERATURE_WARNING : 31|1@1+ (1,0) [0|1] "" Vector__XXX
 SG_ MOTOR_OVERTEMPERATURE : 32|1@1+ (1,0) [0|1] "" Vector__XXX
 SG_ MOTOR_STATOR_FREQ_TO_HIGH : 33|1@1+ (1,0) [0|1] "" Vector__XXX
 SG_ SUPPLYVOLTAGE_ERROR : 34|1@1+ (1,0) [0|1] "" Vector__XXX
 SG_ RPDO_TIMEOUT : 35|1@1+ (1,0) [0|1] "" Vector__XXX
 SG_ NMT_NOT_OPERATIONAL : 36|1@1+ (1,0) [0|1] "" Vector__XXX
 SG_ TASKOVERRUN : 37|1@1+ (1,0) [0|1] "" Vector__XXX
 SG_ NETSYNC_ERROR : 38|1@1+ (1,0) [0|1] "" Vector__XXX
 SG_ POSDEVICE_SIGNAL_TO_LOW : 39|1@1+ (1,0) [0|1] "" Vector__XXX
 SG_ POSDEVICE_SIGNAL_TO_HIGH : 40|1@1+ (1,0) [0|1] "" Vector__XXX
 SG_ RESOLVER_CALIBRATION_FAILED : 41|1@1+ (1,0) [0|1] "" Vector__XXX
 SG_ SYSTEM_FAULT : 42|1@1+ (1,0) [0|1] "" Vector__XXX
 SG_ INTERLOCK_OPEN : 43|1@1+ (1,0) [0|1] "" Vector__XXX
 SG_ APPC_HAS_GATE_DRIVER_DISABLED : 44|1@1+ (1,0) [0|1] "" Vector__XXX
 SG_ MOTOR_STALL_ERROR : 45|1@1+ (1,0) [0|1] "" Vector__XXX
 SG_ AMBIENT_TEMPERATURE_WARNING : 46|1@1+ (1,0) [0|1] "" Vector__XXX
 SG_ AMBIENT_OVERTEMPERATURE : 47|1@1+ (1,0) [0|1] "" Vector__XXX
 SG_ AMBIENT_TEMPSENSOR_ERROR : 48|1@1+ (1,0) [0|1] "" Vector__XXX
 SG_ POWERMODULE_CLAMPING_TIMEOUT : 49|1@1+ (1,0) [0|1] "" Vector__XXX
 SG_ DCBUS_RIPPLE_TO_HIGH : 50|1@1+ (1,0) [0|1] "" Vector__XXX
 SG_ MOTOR_I2XT_WARNING : 51|1@1+ (1,0) [0|1] "" Vector__XXX
 SG_ MOTOR_I2XT_ERROR : 52|1@1+ (1,0) [0|1] "" Vector__XXX
 SG_ MOTOR_FIELDWEAKENING_ERROR : 53|1@1+ (1,0) [0|1] "" Vector__XXX
 SG_ INVALID_PARAMETER_COMBINATION : 54|1@1+ (1,0) [0|1] "" Vector__XXX
 SG_ PLUG_COVER_SENSOR_SIGNAL_LOW : 55|1@1+ (1,0) [0|1] "" Vector__XXX
 SG_ MOTOR_CONNECTION_TEST_FAILED : 56|1@1+ (1,0) [0|1] "" Vector__XXX
 SG_ POWERMODULE_IXT_WARNING : 57|1@1+ (1,0) [0|1] "" Vector__XXX
 SG_ ISOLATION_FAULT : 58|1@1+ (1,0) [0|1] "" Vector__XXX
 SG_ Inverter_A_Statusword_13 : 0|7@1+ (1,0) [0|127] "" Vector__XXX
 SG_ EVENTBUFFER_NEW_EVENT : 16|1@1+ (1,0) [0|1] "" Vector__XXX
 SG_ EVENTBUFFER_OVERFLOW : 17|1@1+ (1,0) [0|1] "" Vector__XXX
 SG_ POWERMODULE_TRIPZONE_OVERCURRE : 18|1@1+ (1,0) [0|1] "" Vector__XXX
 SG_ POWERMODULE_CURRENT_OFFSET_INI : 19|1@1+ (1,0) [0|1] "" Vector__XXX
 SG_ POWERMODULE_TEMPSENSOR_ERROR : 20|1@1+ (1,0) [0|1] "" Vector__XXX
 SG_ POWERMODULE_TEMPERATURE_WARNIN : 21|1@1+ (1,0) [0|1] "" Vector__XXX
 SG_ POWERMODULE_OVERTEMPERATURE : 22|1@1+ (1,0) [0|1] "" Vector__XXX
 SG_ POWERMODULE_IXT_FAULT : 23|1@1+ (1,0) [0|1] "" Vector__XXX
 SG_ POWERMODULE_SW_OVERCURRENT : 24|1@1+ (1,0) [0|1] "" Vector__XXX
 SG_ POWERMODULE_PATTERNDATA_INCONS : 25|1@1+ (1,0) [0|1] "" Vector__XXX
 SG_ DCBUS_TRIPZONE_OVERVOLTAGE : 26|1@1+ (1,0) [0|1] "" Vector__XXX
 SG_ DCBUS_SW_OVERVOLTAGE : 27|1@1+ (1,0) [0|1] "" Vector__XXX
 SG_ DCBUS_SW_UNDERVOLTAGE : 28|1@1+ (1,0) [0|1] "" Vector__XXX
 SG_ NEIGHBOUR_FAULT : 29|1@1+ (1,0) [0|1] "" Vector__XXX
 SG_ MOTOR_TEMPSENSOR_ERROR : 30|1@1+ (1,0) [0|1] "" Vector__XXX
 SG_ MOTOR_TEMPERATURE_WARNING : 31|1@1+ (1,0) [0|1] "" Vector__XXX
 SG_ MOTOR_OVERTEMPERATURE : 32|1@1+ (1,0) [0|1] "" Vector__XXX
 SG_ MOTOR_STATOR_FREQ_TO_HIGH : 33|1@1+ (1,0) [0|1] "" Vector__XXX
 SG_ SUPPLYVOLTAGE_ERROR : 34|1@1+ (1,0) [0|1] "" Vector__XXX
 SG_ RPDO_TIMEOUT : 35|1@1+ (1,0) [0|1] "" Vector__XXX
 SG_ NMT_NOT_OPERATIONAL : 36|1@1+ (1,0) [0|1] "" Vector__XXX
 SG_ TASKOVERRUN : 37|1@1+ (1,0) [0|1] "" Vector__XXX
 SG_ NETSYNC_ERROR : 38|1@1+ (1,0) [0|1] "" Vector__XXX
 SG_ POSDEVICE_SIGNAL_TO_LOW : 39|1@1+ (1,0) [0|1] "" Vector__XXX
 SG_ POSDEVICE_SIGNAL_TO_HIGH : 40|1@1+ (1,0) [0|1] "" Vector__XXX
 SG_ RESOLVER_CALIBRATION_FAILED : 41|1@1+ (1,0) [0|1] "" Vector__XXX
 SG_ SYSTEM_FAULT : 42|1@1+ (1,0) [0|1] "" Vector__XXX
 SG_ INTERLOCK_OPEN : 43|1@1+ (1,0) [0|1] "" Vector__XXX
 SG_ APPC_HAS_GATE_DRIVER_DISABLED : 44|1@1+ (1,0) [0|1] "" Vector__XXX
 SG_ MOTOR_STALL_ERROR : 45|1@1+ (1,0) [0|1] "" Vector__XXX
 SG_ AMBIENT_TEMPERATURE_WARNING : 46|1@1+ (1,0) [0|1] "" Vector__XXX
 SG_ AMBIENT_OVERTEMPERATURE : 47|1@1+ (1,0) [0|1] "" Vector__XXX
 SG_ AMBIENT_TEMPSENSOR_ERROR : 48|1@1+ (1,0) [0|1] "" Vector__XXX
 SG_ POWERMODULE_CLAMPING_TIMEOUT : 49|1@1+ (1,0) [0|1] "" Vector__XXX
 SG_ DCBUS_RIPPLE_TO_HIGH : 50|1@1+ (1,0) [0|1] "" Vector__XXX
 SG_ MOTOR_I2XT_WARNING : 51|1@1+ (1,0) [0|1] "" Vector__XXX
 SG_ MOTOR_I2XT_ERROR : 52|1@1+ (1,0) [0|1] "" Vector__XXX
 SG_ MOTOR_FIELDWEAKENING_ERROR : 53|1@1+ (1,0) [0|1] "" Vector__XXX
 SG_ INVALID_PARAMETER_COMBINATION : 54|1@1+ (1,0) [0|1] "" Vector__XXX
 SG_ PLUG_COVER_SENSOR_SIGNAL_LOW : 55|1@1+ (1,0) [0|1] "" Vector__XXX
 SG_ MOTOR_CONNECTION_TEST_FAILED : 56|1@1+ (1,0) [0|1] "" Vector__XXX
 SG_ POWERMODULE_IXT_WARNING : 57|1@1+ (1,0) [0|1] "" Vector__XXX
 SG_ ISOLATION_FAULT : 58|1@1+ (1,0) [0|1] "" Vector__XXX
 SG_ Inverter_A_Statusword_12 : 0|7@1+ (1,0) [0|127] "" Vector__XXX
 SG_ EVENTBUFFER_NEW_EVENT : 16|1@1+ (1,0) [0|1] "" Vector__XXX
 SG_ EVENTBUFFER_OVERFLOW : 17|1@1+ (1,0) [0|1] "" Vector__XXX
 SG_ POWERMODULE_TRIPZONE_OVERCURRE : 18|1@1+ (1,0) [0|1] "" Vector__XXX
 SG_ POWERMODULE_CURRENT_OFFSET_INI : 19|1@1+ (1,0) [0|1] "" Vector__XXX
 SG_ POWERMODULE_TEMPSENSOR_ERROR : 20|1@1+ (1,0) [0|1] "" Vector__XXX
 SG_ POWERMODULE_TEMPERATURE_WARNIN : 21|1@1+ (1,0) [0|1] "" Vector__XXX
 SG_ POWERMODULE_OVERTEMPERATURE : 22|1@1+ (1,0) [0|1] "" Vector__XXX
 SG_ POWERMODULE_IXT_FAULT : 23|1@1+ (1,0) [0|1] "" Vector__XXX
 SG_ POWERMODULE_SW_OVERCURRENT : 24|1@1+ (1,0) [0|1] "" Vector__XXX
 SG_ POWERMODULE_PATTERNDATA_INCONS : 25|1@1+ (1,0) [0|1] "" Vector__XXX
 SG_ DCBUS_TRIPZONE_OVERVOLTAGE : 26|1@1+ (1,0) [0|1] "" Vector__XXX
 SG_ DCBUS_SW_OVERVOLTAGE : 27|1@1+ (1,0) [0|1] "" Vector__XXX
 SG_ DCBUS_SW_UNDERVOLTAGE : 28|1@1+ (1,0) [0|1] "" Vector__XXX
 SG_ NEIGHBOUR_FAULT : 29|1@1+ (1,0) [0|1] "" Vector__XXX
 SG_ MOTOR_TEMPSENSOR_ERROR : 30|1@1+ (1,0) [0|1] "" Vector__XXX
 SG_ MOTOR_TEMPERATURE_WARNING : 31|1@1+ (1,0) [0|1] "" Vector__XXX
 SG_ MOTOR_OVERTEMPERATURE : 32|1@1+ (1,0) [0|1] "" Vector__XXX
 SG_ MOTOR_STATOR_FREQ_TO_HIGH : 33|1@1+ (1,0) [0|1] "" Vector__XXX
 SG_ SUPPLYVOLTAGE_ERROR : 34|1@1+ (1,0) [0|1] "" Vector__XXX
 SG_ RPDO_TIMEOUT : 35|1@1+ (1,0) [0|1] "" Vector__XXX
 SG_ NMT_NOT_OPERATIONAL : 36|1@1+ (1,0) [0|1] "" Vector__XXX
 SG_ TASKOVERRUN : 37|1@1+ (1,0) [0|1] "" Vector__XXX
 SG_ NETSYNC_ERROR : 38|1@1+ (1,0) [0|1] "" Vector__XXX
 SG_ POSDEVICE_SIGNAL_TO_LOW : 39|1@1+ (1,0) [0|1] "" Vector__XXX
 SG_ POSDEVICE_SIGNAL_TO_HIGH : 40|1@1+ (1,0) [0|1] "" Vector__XXX
 SG_ RESOLVER_CALIBRATION_FAILED : 41|1@1+ (1,0) [0|1] "" Vector__XXX
 SG_ SYSTEM_FAULT : 42|1@1+ (1,0) [0|1] "" Vector__XXX
 SG_ INTERLOCK_OPEN : 43|1@1+ (1,0) [0|1] "" Vector__XXX
 SG_ APPC_HAS_GATE_DRIVER_DISABLED : 44|1@1+ (1,0) [0|1] "" Vector__XXX
 SG_ MOTOR_STALL_ERROR : 45|1@1+ (1,0) [0|1] "" Vector__XXX
 SG_ AMBIENT_TEMPERATURE_WARNING : 46|1@1+ (1,0) [0|1] "" Vector__XXX
 SG_ AMBIENT_OVERTEMPERATURE : 47|1@1+ (1,0) [0|1] "" Vector__XXX
 SG_ AMBIENT_TEMPSENSOR_ERROR : 48|1@1+ (1,0) [0|1] "" Vector__XXX
 SG_ POWERMODULE_CLAMPING_TIMEOUT : 49|1@1+ (1,0) [0|1] "" Vector__XXX
 SG_ DCBUS_RIPPLE_TO_HIGH : 50|1@1+ (1,0) [0|1] "" Vector__XXX
 SG_ MOTOR_I2XT_WARNING : 51|1@1+ (1,0) [0|1] "" Vector__XXX
 SG_ MOTOR_I2XT_ERROR : 52|1@1+ (1,0) [0|1] "" Vector__XXX
 SG_ MOTOR_FIELDWEAKENING_ERROR : 53|1@1+ (1,0) [0|1] "" Vector__XXX
 SG_ INVALID_PARAMETER_COMBINATION : 54|1@1+ (1,0) [0|1] "" Vector__XXX
 SG_ PLUG_COVER_SENSOR_SIGNAL_LOW : 55|1@1+ (1,0) [0|1] "" Vector__XXX
 SG_ MOTOR_CONNECTION_TEST_FAILED : 56|1@1+ (1,0) [0|1] "" Vector__XXX
 SG_ POWERMODULE_IXT_WARNING : 57|1@1+ (1,0) [0|1] "" Vector__XXX
 SG_ ISOLATION_FAULT : 58|1@1+ (1,0) [0|1] "" Vector__XXX
 SG_ Inverter_A_Statusword_11 : 0|7@1+ (1,0) [0|127] "" Vector__XXX
 SG_ EVENTBUFFER_NEW_EVENT : 16|1@1+ (1,0) [0|1] "" Vector__XXX
 SG_ EVENTBUFFER_OVERFLOW : 17|1@1+ (1,0) [0|1] "" Vector__XXX
 SG_ POWERMODULE_TRIPZONE_OVERCURRE : 18|1@1+ (1,0) [0|1] "" Vector__XXX
 SG_ POWERMODULE_CURRENT_OFFSET_INI : 19|1@1+ (1,0) [0|1] "" Vector__XXX
 SG_ POWERMODULE_TEMPSENSOR_ERROR : 20|1@1+ (1,0) [0|1] "" Vector__XXX
 SG_ POWERMODULE_TEMPERATURE_WARNIN : 21|1@1+ (1,0) [0|1] "" Vector__XXX
 SG_ POWERMODULE_OVERTEMPERATURE : 22|1@1+ (1,0) [0|1] "" Vector__XXX
 SG_ POWERMODULE_IXT_FAULT : 23|1@1+ (1,0) [0|1] "" Vector__XXX
 SG_ POWERMODULE_SW_OVERCURRENT : 24|1@1+ (1,0) [0|1] "" Vector__XXX
 SG_ POWERMODULE_PATTERNDATA_INCONS : 25|1@1+ (1,0) [0|1] "" Vector__XXX
 SG_ DCBUS_TRIPZONE_OVERVOLTAGE : 26|1@1+ (1,0) [0|1] "" Vector__XXX
 SG_ DCBUS_SW_OVERVOLTAGE : 27|1@1+ (1,0) [0|1] "" Vector__XXX
 SG_ DCBUS_SW_UNDERVOLTAGE : 28|1@1+ (1,0) [0|1] "" Vector__XXX
 SG_ NEIGHBOUR_FAULT : 29|1@1+ (1,0) [0|1] "" Vector__XXX
 SG_ MOTOR_TEMPSENSOR_ERROR : 30|1@1+ (1,0) [0|1] "" Vector__XXX
 SG_ MOTOR_TEMPERATURE_WARNING : 31|1@1+ (1,0) [0|1] "" Vector__XXX
 SG_ MOTOR_OVERTEMPERATURE : 32|1@1+ (1,0) [0|1] "" Vector__XXX
 SG_ MOTOR_STATOR_FREQ_TO_HIGH : 33|1@1+ (1,0) [0|1] "" Vector__XXX
 SG_ SUPPLYVOLTAGE_ERROR : 34|1@1+ (1,0) [0|1] "" Vector__XXX
 SG_ RPDO_TIMEOUT : 35|1@1+ (1,0) [0|1] "" Vector__XXX
 SG_ NMT_NOT_OPERATIONAL : 36|1@1+ (1,0) [0|1] "" Vector__XXX
 SG_ TASKOVERRUN : 37|1@1+ (1,0) [0|1] "" Vector__XXX
 SG_ NETSYNC_ERROR : 38|1@1+ (1,0) [0|1] "" Vector__XXX
 SG_ POSDEVICE_SIGNAL_TO_LOW : 39|1@1+ (1,0) [0|1] "" Vector__XXX
 SG_ POSDEVICE_SIGNAL_TO_HIGH : 40|1@1+ (1,0) [0|1] "" Vector__XXX
 SG_ RESOLVER_CALIBRATION_FAILED : 41|1@1+ (1,0) [0|1] "" Vector__XXX
 SG_ SYSTEM_FAULT : 42|1@1+ (1,0) [0|1] "" Vector__XXX
 SG_ INTERLOCK_OPEN : 43|1@1+ (1,0) [0|1] "" Vector__XXX
 SG_ APPC_HAS_GATE_DRIVER_DISABLED : 44|1@1+ (1,0) [0|1] "" Vector__XXX
 SG_ MOTOR_STALL_ERROR : 45|1@1+ (1,0) [0|1] "" Vector__XXX
 SG_ AMBIENT_TEMPERATURE_WARNING : 46|1@1+ (1,0) [0|1] "" Vector__XXX
 SG_ AMBIENT_OVERTEMPERATURE : 47|1@1+ (1,0) [0|1] "" Vector__XXX
 SG_ AMBIENT_TEMPSENSOR_ERROR : 48|1@1+ (1,0) [0|1] "" Vector__XXX
 SG_ POWERMODULE_CLAMPING_TIMEOUT : 49|1@1+ (1,0) [0|1] "" Vector__XXX
 SG_ DCBUS_RIPPLE_TO_HIGH : 50|1@1+ (1,0) [0|1] "" Vector__XXX
 SG_ MOTOR_I2XT_WARNING : 51|1@1+ (1,0) [0|1] "" Vector__XXX
 SG_ MOTOR_I2XT_ERROR : 52|1@1+ (1,0) [0|1] "" Vector__XXX
 SG_ MOTOR_FIELDWEAKENING_ERROR : 53|1@1+ (1,0) [0|1] "" Vector__XXX
 SG_ INVALID_PARAMETER_COMBINATION : 54|1@1+ (1,0) [0|1] "" Vector__XXX
 SG_ PLUG_COVER_SENSOR_SIGNAL_LOW : 55|1@1+ (1,0) [0|1] "" Vector__XXX
 SG_ MOTOR_CONNECTION_TEST_FAILED : 56|1@1+ (1,0) [0|1] "" Vector__XXX
 SG_ POWERMODULE_IXT_WARNING : 57|1@1+ (1,0) [0|1] "" Vector__XXX
 SG_ ISOLATION_FAULT : 58|1@1+ (1,0) [0|1] "" Vector__XXX
 SG_ Inverter_A_Statusword_10 : 0|7@1+ (1,0) [0|127] "" Vector__XXX
 SG_ EVENTBUFFER_NEW_EVENT : 16|1@1+ (1,0) [0|1] "" Vector__XXX
 SG_ EVENTBUFFER_OVERFLOW : 17|1@1+ (1,0) [0|1] "" Vector__XXX
 SG_ POWERMODULE_TRIPZONE_OVERCURRE : 18|1@1+ (1,0) [0|1] "" Vector__XXX
 SG_ POWERMODULE_CURRENT_OFFSET_INI : 19|1@1+ (1,0) [0|1] "" Vector__XXX
 SG_ POWERMODULE_TEMPSENSOR_ERROR : 20|1@1+ (1,0) [0|1] "" Vector__XXX
 SG_ POWERMODULE_TEMPERATURE_WARNIN : 21|1@1+ (1,0) [0|1] "" Vector__XXX
 SG_ POWERMODULE_OVERTEMPERATURE : 22|1@1+ (1,0) [0|1] "" Vector__XXX
 SG_ POWERMODULE_IXT_FAULT : 23|1@1+ (1,0) [0|1] "" Vector__XXX
 SG_ POWERMODULE_SW_OVERCURRENT : 24|1@1+ (1,0) [0|1] "" Vector__XXX
 SG_ POWERMODULE_PATTERNDATA_INCONS : 25|1@1+ (1,0) [0|1] "" Vector__XXX
 SG_ DCBUS_TRIPZONE_OVERVOLTAGE : 26|1@1+ (1,0) [0|1] "" Vector__XXX
 SG_ DCBUS_SW_OVERVOLTAGE : 27|1@1+ (1,0) [0|1] "" Vector__XXX
 SG_ DCBUS_SW_UNDERVOLTAGE : 28|1@1+ (1,0) [0|1] "" Vector__XXX
 SG_ NEIGHBOUR_FAULT : 29|1@1+ (1,0) [0|1] "" Vector__XXX
 SG_ MOTOR_TEMPSENSOR_ERROR : 30|1@1+ (1,0) [0|1] "" Vector__XXX
 SG_ MOTOR_TEMPERATURE_WARNING : 31|1@1+ (1,0) [0|1] "" Vector__XXX
 SG_ MOTOR_OVERTEMPERATURE : 32|1@1+ (1,0) [0|1] "" Vector__XXX
 SG_ MOTOR_STATOR_FREQ_TO_HIGH : 33|1@1+ (1,0) [0|1] "" Vector__XXX
 SG_ SUPPLYVOLTAGE_ERROR : 34|1@1+ (1,0) [0|1] "" Vector__XXX
 SG_ RPDO_TIMEOUT : 35|1@1+ (1,0) [0|1] "" Vector__XXX
 SG_ NMT_NOT_OPERATIONAL : 36|1@1+ (1,0) [0|1] "" Vector__XXX
 SG_ TASKOVERRUN : 37|1@1+ (1,0) [0|1] "" Vector__XXX
 SG_ NETSYNC_ERROR : 38|1@1+ (1,0) [0|1] "" Vector__XXX
 SG_ POSDEVICE_SIGNAL_TO_LOW : 39|1@1+ (1,0) [0|1] "" Vector__XXX
 SG_ POSDEVICE_SIGNAL_TO_HIGH : 40|1@1+ (1,0) [0|1] "" Vector__XXX
 SG_ RESOLVER_CALIBRATION_FAILED : 41|1@1+ (1,0) [0|1] "" Vector__XXX
 SG_ SYSTEM_FAULT : 42|1@1+ (1,0) [0|1] "" Vector__XXX
 SG_ INTERLOCK_OPEN : 43|1@1+ (1,0) [0|1] "" Vector__XXX
 SG_ APPC_HAS_GATE_DRIVER_DISABLED : 44|1@1+ (1,0) [0|1] "" Vector__XXX
 SG_ MOTOR_STALL_ERROR : 45|1@1+ (1,0) [0|1] "" Vector__XXX
 SG_ AMBIENT_TEMPERATURE_WARNING : 46|1@1+ (1,0) [0|1] "" Vector__XXX
 SG_ AMBIENT_OVERTEMPERATURE : 47|1@1+ (1,0) [0|1] "" Vector__XXX
 SG_ AMBIENT_TEMPSENSOR_ERROR : 48|1@1+ (1,0) [0|1] "" Vector__XXX
 SG_ POWERMODULE_CLAMPING_TIMEOUT : 49|1@1+ (1,0) [0|1] "" Vector__XXX
 SG_ DCBUS_RIPPLE_TO_HIGH : 50|1@1+ (1,0) [0|1] "" Vector__XXX
 SG_ MOTOR_I2XT_WARNING : 51|1@1+ (1,0) [0|1] "" Vector__XXX
 SG_ MOTOR_I2XT_ERROR : 52|1@1+ (1,0) [0|1] "" Vector__XXX
 SG_ MOTOR_FIELDWEAKENING_ERROR : 53|1@1+ (1,0) [0|1] "" Vector__XXX
 SG_ INVALID_PARAMETER_COMBINATION : 54|1@1+ (1,0) [0|1] "" Vector__XXX
 SG_ PLUG_COVER_SENSOR_SIGNAL_LOW : 55|1@1+ (1,0) [0|1] "" Vector__XXX
 SG_ MOTOR_CONNECTION_TEST_FAILED : 56|1@1+ (1,0) [0|1] "" Vector__XXX
 SG_ POWERMODULE_IXT_WARNING : 57|1@1+ (1,0) [0|1] "" Vector__XXX
 SG_ ISOLATION_FAULT : 58|1@1+ (1,0) [0|1] "" Vector__XXX
 SG_ Inverter_A_Statusword_9 : 0|7@1+ (1,0) [0|127] "" Vector__XXX
 SG_ EVENTBUFFER_NEW_EVENT : 16|1@1+ (1,0) [0|1] "" Vector__XXX
 SG_ EVENTBUFFER_OVERFLOW : 17|1@1+ (1,0) [0|1] "" Vector__XXX
 SG_ POWERMODULE_TRIPZONE_OVERCURRE : 18|1@1+ (1,0) [0|1] "" Vector__XXX
 SG_ POWERMODULE_CURRENT_OFFSET_INI : 19|1@1+ (1,0) [0|1] "" Vector__XXX
 SG_ POWERMODULE_TEMPSENSOR_ERROR : 20|1@1+ (1,0) [0|1] "" Vector__XXX
 SG_ POWERMODULE_TEMPERATURE_WARNIN : 21|1@1+ (1,0) [0|1] "" Vector__XXX
 SG_ POWERMODULE_OVERTEMPERATURE : 22|1@1+ (1,0) [0|1] "" Vector__XXX
 SG_ POWERMODULE_IXT_FAULT : 23|1@1+ (1,0) [0|1] "" Vector__XXX
 SG_ POWERMODULE_SW_OVERCURRENT : 24|1@1+ (1,0) [0|1] "" Vector__XXX
 SG_ POWERMODULE_PATTERNDATA_INCONS : 25|1@1+ (1,0) [0|1] "" Vector__XXX
 SG_ DCBUS_TRIPZONE_OVERVOLTAGE : 26|1@1+ (1,0) [0|1] "" Vector__XXX
 SG_ DCBUS_SW_OVERVOLTAGE : 27|1@1+ (1,0) [0|1] "" Vector__XXX
 SG_ DCBUS_SW_UNDERVOLTAGE : 28|1@1+ (1,0) [0|1] "" Vector__XXX
 SG_ NEIGHBOUR_FAULT : 29|1@1+ (1,0) [0|1] "" Vector__XXX
 SG_ MOTOR_TEMPSENSOR_ERROR : 30|1@1+ (1,0) [0|1] "" Vector__XXX
 SG_ MOTOR_TEMPERATURE_WARNING : 31|1@1+ (1,0) [0|1] "" Vector__XXX
 SG_ MOTOR_OVERTEMPERATURE : 32|1@1+ (1,0) [0|1] "" Vector__XXX
 SG_ MOTOR_STATOR_FREQ_TO_HIGH : 33|1@1+ (1,0) [0|1] "" Vector__XXX
 SG_ SUPPLYVOLTAGE_ERROR : 34|1@1+ (1,0) [0|1] "" Vector__XXX
 SG_ RPDO_TIMEOUT : 35|1@1+ (1,0) [0|1] "" Vector__XXX
 SG_ NMT_NOT_OPERATIONAL : 36|1@1+ (1,0) [0|1] "" Vector__XXX
 SG_ TASKOVERRUN : 37|1@1+ (1,0) [0|1] "" Vector__XXX
 SG_ NETSYNC_ERROR : 38|1@1+ (1,0) [0|1] "" Vector__XXX
 SG_ POSDEVICE_SIGNAL_TO_LOW : 39|1@1+ (1,0) [0|1] "" Vector__XXX
 SG_ POSDEVICE_SIGNAL_TO_HIGH : 40|1@1+ (1,0) [0|1] "" Vector__XXX
 SG_ RESOLVER_CALIBRATION_FAILED : 41|1@1+ (1,0) [0|1] "" Vector__XXX
 SG_ SYSTEM_FAULT : 42|1@1+ (1,0) [0|1] "" Vector__XXX
 SG_ INTERLOCK_OPEN : 43|1@1+ (1,0) [0|1] "" Vector__XXX
 SG_ APPC_HAS_GATE_DRIVER_DISABLED : 44|1@1+ (1,0) [0|1] "" Vector__XXX
 SG_ MOTOR_STALL_ERROR : 45|1@1+ (1,0) [0|1] "" Vector__XXX
 SG_ AMBIENT_TEMPERATURE_WARNING : 46|1@1+ (1,0) [0|1] "" Vector__XXX
 SG_ AMBIENT_OVERTEMPERATURE : 47|1@1+ (1,0) [0|1] "" Vector__XXX
 SG_ AMBIENT_TEMPSENSOR_ERROR : 48|1@1+ (1,0) [0|1] "" Vector__XXX
 SG_ POWERMODULE_CLAMPING_TIMEOUT : 49|1@1+ (1,0) [0|1] "" Vector__XXX
 SG_ DCBUS_RIPPLE_TO_HIGH : 50|1@1+ (1,0) [0|1] "" Vector__XXX
 SG_ MOTOR_I2XT_WARNING : 51|1@1+ (1,0) [0|1] "" Vector__XXX
 SG_ MOTOR_I2XT_ERROR : 52|1@1+ (1,0) [0|1] "" Vector__XXX
 SG_ MOTOR_FIELDWEAKENING_ERROR : 53|1@1+ (1,0) [0|1] "" Vector__XXX
 SG_ INVALID_PARAMETER_COMBINATION : 54|1@1+ (1,0) [0|1] "" Vector__XXX
 SG_ PLUG_COVER_SENSOR_SIGNAL_LOW : 55|1@1+ (1,0) [0|1] "" Vector__XXX
 SG_ MOTOR_CONNECTION_TEST_FAILED : 56|1@1+ (1,0) [0|1] "" Vector__XXX
 SG_ POWERMODULE_IXT_WARNING : 57|1@1+ (1,0) [0|1] "" Vector__XXX
 SG_ ISOLATION_FAULT : 58|1@1+ (1,0) [0|1] "" Vector__XXX
 SG_ Inverter_A_Statusword_8 : 0|7@1+ (1,0) [0|127] "" Vector__XXX
 SG_ EVENTBUFFER_NEW_EVENT : 16|1@1+ (1,0) [0|1] "" Vector__XXX
 SG_ EVENTBUFFER_OVERFLOW : 17|1@1+ (1,0) [0|1] "" Vector__XXX
 SG_ POWERMODULE_TRIPZONE_OVERCURRE : 18|1@1+ (1,0) [0|1] "" Vector__XXX
 SG_ POWERMODULE_CURRENT_OFFSET_INI : 19|1@1+ (1,0) [0|1] "" Vector__XXX
 SG_ POWERMODULE_TEMPSENSOR_ERROR : 20|1@1+ (1,0) [0|1] "" Vector__XXX
 SG_ POWERMODULE_TEMPERATURE_WARNIN : 21|1@1+ (1,0) [0|1] "" Vector__XXX
 SG_ POWERMODULE_OVERTEMPERATURE : 22|1@1+ (1,0) [0|1] "" Vector__XXX
 SG_ POWERMODULE_IXT_FAULT : 23|1@1+ (1,0) [0|1] "" Vector__XXX
 SG_ POWERMODULE_SW_OVERCURRENT : 24|1@1+ (1,0) [0|1] "" Vector__XXX
 SG_ POWERMODULE_PATTERNDATA_INCONS : 25|1@1+ (1,0) [0|1] "" Vector__XXX
 SG_ DCBUS_TRIPZONE_OVERVOLTAGE : 26|1@1+ (1,0) [0|1] "" Vector__XXX
 SG_ DCBUS_SW_OVERVOLTAGE : 27|1@1+ (1,0) [0|1] "" Vector__XXX
 SG_ DCBUS_SW_UNDERVOLTAGE : 28|1@1+ (1,0) [0|1] "" Vector__XXX
 SG_ NEIGHBOUR_FAULT : 29|1@1+ (1,0) [0|1] "" Vector__XXX
 SG_ MOTOR_TEMPSENSOR_ERROR : 30|1@1+ (1,0) [0|1] "" Vector__XXX
 SG_ MOTOR_TEMPERATURE_WARNING : 31|1@1+ (1,0) [0|1] "" Vector__XXX
 SG_ MOTOR_OVERTEMPERATURE : 32|1@1+ (1,0) [0|1] "" Vector__XXX
 SG_ MOTOR_STATOR_FREQ_TO_HIGH : 33|1@1+ (1,0) [0|1] "" Vector__XXX
 SG_ SUPPLYVOLTAGE_ERROR : 34|1@1+ (1,0) [0|1] "" Vector__XXX
 SG_ RPDO_TIMEOUT : 35|1@1+ (1,0) [0|1] "" Vector__XXX
 SG_ NMT_NOT_OPERATIONAL : 36|1@1+ (1,0) [0|1] "" Vector__XXX
 SG_ TASKOVERRUN : 37|1@1+ (1,0) [0|1] "" Vector__XXX
 SG_ NETSYNC_ERROR : 38|1@1+ (1,0) [0|1] "" Vector__XXX
 SG_ POSDEVICE_SIGNAL_TO_LOW : 39|1@1+ (1,0) [0|1] "" Vector__XXX
 SG_ POSDEVICE_SIGNAL_TO_HIGH : 40|1@1+ (1,0) [0|1] "" Vector__XXX
 SG_ RESOLVER_CALIBRATION_FAILED : 41|1@1+ (1,0) [0|1] "" Vector__XXX
 SG_ SYSTEM_FAULT : 42|1@1+ (1,0) [0|1] "" Vector__XXX
 SG_ INTERLOCK_OPEN : 43|1@1+ (1,0) [0|1] "" Vector__XXX
 SG_ APPC_HAS_GATE_DRIVER_DISABLED : 44|1@1+ (1,0) [0|1] "" Vector__XXX
 SG_ MOTOR_STALL_ERROR : 45|1@1+ (1,0) [0|1] "" Vector__XXX
 SG_ AMBIENT_TEMPERATURE_WARNING : 46|1@1+ (1,0) [0|1] "" Vector__XXX
 SG_ AMBIENT_OVERTEMPERATURE : 47|1@1+ (1,0) [0|1] "" Vector__XXX
 SG_ AMBIENT_TEMPSENSOR_ERROR : 48|1@1+ (1,0) [0|1] "" Vector__XXX
 SG_ POWERMODULE_CLAMPING_TIMEOUT : 49|1@1+ (1,0) [0|1] "" Vector__XXX
 SG_ DCBUS_RIPPLE_TO_HIGH : 50|1@1+ (1,0) [0|1] "" Vector__XXX
 SG_ MOTOR_I2XT_WARNING : 51|1@1+ (1,0) [0|1] "" Vector__XXX
 SG_ MOTOR_I2XT_ERROR : 52|1@1+ (1,0) [0|1] "" Vector__XXX
 SG_ MOTOR_FIELDWEAKENING_ERROR : 53|1@1+ (1,0) [0|1] "" Vector__XXX
 SG_ INVALID_PARAMETER_COMBINATION : 54|1@1+ (1,0) [0|1] "" Vector__XXX
 SG_ PLUG_COVER_SENSOR_SIGNAL_LOW : 55|1@1+ (1,0) [0|1] "" Vector__XXX
 SG_ MOTOR_CONNECTION_TEST_FAILED : 56|1@1+ (1,0) [0|1] "" Vector__XXX
 SG_ POWERMODULE_IXT_WARNING : 57|1@1+ (1,0) [0|1] "" Vector__XXX
 SG_ ISOLATION_FAULT : 58|1@1+ (1,0) [0|1] "" Vector__XXX
 SG_ Inverter_A_Statusword_7 : 0|7@1+ (1,0) [0|127] "" Vector__XXX
 SG_ EVENTBUFFER_NEW_EVENT : 16|1@1+ (1,0) [0|1] "" Vector__XXX
 SG_ EVENTBUFFER_OVERFLOW : 17|1@1+ (1,0) [0|1] "" Vector__XXX
 SG_ POWERMODULE_TRIPZONE_OVERCURRE : 18|1@1+ (1,0) [0|1] "" Vector__XXX
 SG_ POWERMODULE_CURRENT_OFFSET_INI : 19|1@1+ (1,0) [0|1] "" Vector__XXX
 SG_ POWERMODULE_TEMPSENSOR_ERROR : 20|1@1+ (1,0) [0|1] "" Vector__XXX
 SG_ POWERMODULE_TEMPERATURE_WARNIN : 21|1@1+ (1,0) [0|1] "" Vector__XXX
 SG_ POWERMODULE_OVERTEMPERATURE : 22|1@1+ (1,0) [0|1] "" Vector__XXX
 SG_ POWERMODULE_IXT_FAULT : 23|1@1+ (1,0) [0|1] "" Vector__XXX
 SG_ POWERMODULE_SW_OVERCURRENT : 24|1@1+ (1,0) [0|1] "" Vector__XXX
 SG_ POWERMODULE_PATTERNDATA_INCONS : 25|1@1+ (1,0) [0|1] "" Vector__XXX
 SG_ DCBUS_TRIPZONE_OVERVOLTAGE : 26|1@1+ (1,0) [0|1] "" Vector__XXX
 SG_ DCBUS_SW_OVERVOLTAGE : 27|1@1+ (1,0) [0|1] "" Vector__XXX
 SG_ DCBUS_SW_UNDERVOLTAGE : 28|1@1+ (1,0) [0|1] "" Vector__XXX
 SG_ NEIGHBOUR_FAULT : 29|1@1+ (1,0) [0|1] "" Vector__XXX
 SG_ MOTOR_TEMPSENSOR_ERROR : 30|1@1+ (1,0) [0|1] "" Vector__XXX
 SG_ MOTOR_TEMPERATURE_WARNING : 31|1@1+ (1,0) [0|1] "" Vector__XXX
 SG_ MOTOR_OVERTEMPERATURE : 32|1@1+ (1,0) [0|1] "" Vector__XXX
 SG_ MOTOR_STATOR_FREQ_TO_HIGH : 33|1@1+ (1,0) [0|1] "" Vector__XXX
 SG_ SUPPLYVOLTAGE_ERROR : 34|1@1+ (1,0) [0|1] "" Vector__XXX
 SG_ RPDO_TIMEOUT : 35|1@1+ (1,0) [0|1] "" Vector__XXX
 SG_ NMT_NOT_OPERATIONAL : 36|1@1+ (1,0) [0|1] "" Vector__XXX
 SG_ TASKOVERRUN : 37|1@1+ (1,0) [0|1] "" Vector__XXX
 SG_ NETSYNC_ERROR : 38|1@1+ (1,0) [0|1] "" Vector__XXX
 SG_ POSDEVICE_SIGNAL_TO_LOW : 39|1@1+ (1,0) [0|1] "" Vector__XXX
 SG_ POSDEVICE_SIGNAL_TO_HIGH : 40|1@1+ (1,0) [0|1] "" Vector__XXX
 SG_ RESOLVER_CALIBRATION_FAILED : 41|1@1+ (1,0) [0|1] "" Vector__XXX
 SG_ SYSTEM_FAULT : 42|1@1+ (1,0) [0|1] "" Vector__XXX
 SG_ INTERLOCK_OPEN : 43|1@1+ (1,0) [0|1] "" Vector__XXX
 SG_ APPC_HAS_GATE_DRIVER_DISABLED : 44|1@1+ (1,0) [0|1] "" Vector__XXX
 SG_ MOTOR_STALL_ERROR : 45|1@1+ (1,0) [0|1] "" Vector__XXX
 SG_ AMBIENT_TEMPERATURE_WARNING : 46|1@1+ (1,0) [0|1] "" Vector__XXX
 SG_ AMBIENT_OVERTEMPERATURE : 47|1@1+ (1,0) [0|1] "" Vector__XXX
 SG_ AMBIENT_TEMPSENSOR_ERROR : 48|1@1+ (1,0) [0|1] "" Vector__XXX
 SG_ POWERMODULE_CLAMPING_TIMEOUT : 49|1@1+ (1,0) [0|1] "" Vector__XXX
 SG_ DCBUS_RIPPLE_TO_HIGH : 50|1@1+ (1,0) [0|1] "" Vector__XXX
 SG_ MOTOR_I2XT_WARNING : 51|1@1+ (1,0) [0|1] "" Vector__XXX
 SG_ MOTOR_I2XT_ERROR : 52|1@1+ (1,0) [0|1] "" Vector__XXX
 SG_ MOTOR_FIELDWEAKENING_ERROR : 53|1@1+ (1,0) [0|1] "" Vector__XXX
 SG_ INVALID_PARAMETER_COMBINATION : 54|1@1+ (1,0) [0|1] "" Vector__XXX
 SG_ PLUG_COVER_SENSOR_SIGNAL_LOW : 55|1@1+ (1,0) [0|1] "" Vector__XXX
 SG_ MOTOR_CONNECTION_TEST_FAILED : 56|1@1+ (1,0) [0|1] "" Vector__XXX
 SG_ POWERMODULE_IXT_WARNING : 57|1@1+ (1,0) [0|1] "" Vector__XXX
 SG_ ISOLATION_FAULT : 58|1@1+ (1,0) [0|1] "" Vector__XXX
 SG_ Motor_A_act_velocity_5 : 0|32@1- (6.103515625e-05,0) [-131072|131071.99994] "rpm" Vector__XXX
 SG_ Motor_A_act_torque_5 : 32|16@1- (0.1,0) [-3276.8|3276.7] "%" Vector__XXX
 SG_ Motor_A_act_current_5 : 48|16@1- (0.015625,0) [-512|511.984375] "A" Vector__XXX
 SG_ Motor_A_act_velocity_4 : 0|32@1- (6.103515625e-05,0) [-131072|131071.99994] "rpm" Vector__XXX
 SG_ Motor_A_act_torque_4 : 32|16@1- (0.1,0) [-3276.8|3276.7] "%" Vector__XXX
 SG_ Motor_A_act_current_4 : 48|16@1- (0.015625,0) [-512|511.984375] "A" Vector__XXX
 SG_ Motor_A_act_velocity_3 : 0|32@1- (6.103515625e-05,0) [-131072|131071.99994] "rpm" Vector__XXX
 SG_ Motor_A_act_torque_3 : 32|16@1- (0.1,0) [-3276.8|3276.7] "%" Vector__XXX
 SG_ Motor_A_act_current_3 : 48|16@1- (0.015625,0) [-512|511.984375] "A" Vector__XXX
 SG_ Motor_A_act_velocity_2 : 0|32@1- (6.103515625e-05,0) [-131072|131071.99994] "rpm" Vector__XXX
 SG_ Motor_A_act_torque_2 : 32|16@1- (0.1,0) [-3276.8|3276.7] "%" Vector__XXX
 SG_ Motor_A_act_current_2 : 48|16@1- (0.015625,0) [-512|511.984375] "A" Vector__XXX
 SG_ Motor_A_act_velocity_1 : 0|32@1- (6.103515625e-05,0) [-131072|131071.99994] "rpm" Vector__XXX
 SG_ Motor_A_act_torque_1 : 32|16@1- (0.1,0) [-3276.8|3276.7] "%" Vector__XXX
 SG_ Motor_A_act_current_1 : 48|16@1- (0.015625,0) [-512|511.984375] "A" Vector__XXX
 SG_ Motor_A_act_velocity_13 : 0|32@1- (6.103515625e-05,0) [-131072|131071.99994] "rpm" Vector__XXX
 SG_ Motor_A_act_torque_13 : 32|16@1- (0.1,0) [-3276.8|3276.7] "%" Vector__XXX
 SG_ Motor_A_act_current_13 : 48|16@1- (0.015625,0) [-512|511.984375] "A" Vector__XXX
 SG_ Motor_A_act_velocity_12 : 0|32@1- (6.103515625e-05,0) [-131072|131071.99994] "rpm" Vector__XXX
 SG_ Motor_A_act_torque_12 : 32|16@1- (0.1,0) [-3276.8|3276.7] "%" Vector__XXX
 SG_ Motor_A_act_current_12 : 48|16@1- (0.015625,0) [-512|511.984375] "A" Vector__XXX
 SG_ Motor_A_act_velocity_11 : 0|32@1- (6.103515625e-05,0) [-131072|131071.99994] "rpm" Vector__XXX
 SG_ Motor_A_act_torque_11 : 32|16@1- (0.1,0) [-3276.8|3276.7] "%" Vector__XXX
 SG_ Motor_A_act_current_11 : 48|16@1- (0.015625,0) [-512|511.984375] "A" Vector__XXX
 SG_ Motor_A_act_velocity_10 : 0|32@1- (6.103515625e-05,0) [-131072|131071.99994] "rpm" Vector__XXX
 SG_ Motor_A_act_torque_10 : 32|16@1- (0.1,0) [-3276.8|3276.7] "%" Vector__XXX
 SG_ Motor_A_act_current_10 : 48|16@1- (0.015625,0) [-512|511.984375] "A" Vector__XXX
 SG_ Motor_A_act_velocity_9 : 0|32@1- (6.103515625e-05,0) [-131072|131071.99994] "rpm" Vector__XXX
 SG_ Motor_A_act_torque_9 : 32|16@1- (0.1,0) [-3276.8|3276.7] "%" Vector__XXX
 SG_ Motor_A_act_current_9 : 48|16@1- (0.015625,0) [-512|511.984375] "A" Vector__XXX
 SG_ Motor_A_act_velocity_8 : 0|32@1- (6.103515625e-05,0) [-131072|131071.99994] "rpm" Vector__XXX
 SG_ Motor_A_act_torque_8 : 32|16@1- (0.1,0) [-3276.8|3276.7] "%" Vector__XXX
 SG_ Motor_A_act_current_8 : 48|16@1- (0.015625,0) [-512|511.984375] "A" Vector__XXX
 SG_ Motor_A_act_velocity_7 : 0|32@1- (6.103515625e-05,0) [-131072|131071.99994] "rpm" Vector__XXX
 SG_ Motor_A_act_torque_7 : 32|16@1- (0.1,0) [-3276.8|3276.7] "%" Vector__XXX
 SG_ Motor_A_act_current_7 : 48|16@1- (0.015625,0) [-512|511.984375] "A" Vector__XXX
 SG_ Motor_A_act_temp_5 : 0|16@1- (0.0625,0) [-2048|2047.9375] "�C" Vector__XXX
 SG_ Motor_A_act_power_5 : 16|16@1- (0.016,0) [-524.288|524.272] "kW" Vector__XXX
 SG_ Motor_A_act_voltage_5 : 32|16@1- (0.0625,0) [-2048|2047.9375] "V" Vector__XXX
 SG_ Inverter_A_act_module_temp_5 : 48|16@1- (0.0625,0) [-2048|2047.9375] "�C" Vector__XXX
 SG_ Motor_A_act_temp_4 : 0|16@1- (0.0625,0) [-2048|2047.9375] "�C" Vector__XXX
 SG_ Motor_A_act_power_4 : 16|16@1- (0.016,0) [-524.288|524.272] "kW" Vector__XXX
 SG_ Motor_A_act_voltage_4 : 32|16@1- (0.0625,0) [-2048|2047.9375] "V" Vector__XXX
 SG_ Inverter_A_act_module_temp_4 : 48|16@1- (0.0625,0) [-2048|2047.9375] "�C" Vector__XXX
 SG_ Motor_A_act_temp_3 : 0|16@1- (0.0625,0) [-2048|2047.9375] "�C" Vector__XXX
 SG_ Motor_A_act_power_3 : 16|16@1- (0.016,0) [-524.288|524.272] "kW" Vector__XXX
 SG_ Motor_A_act_voltage_3 : 32|16@1- (0.0625,0) [-2048|2047.9375] "V" Vector__XXX
 SG_ Inverter_A_act_module_temp_3 : 48|16@1- (0.0625,0) [-2048|2047.9375] "�C" Vector__XXX
 SG_ Motor_A_act_temp_2 : 0|16@1- (0.0625,0) [-2048|2047.9375] "�C" Vector__XXX
 SG_ Motor_A_act_power_2 : 16|16@1- (0.016,0) [-524.288|524.272] "kW" Vector__XXX
 SG_ Motor_A_act_voltage_2 : 32|16@1- (0.0625,0) [-2048|2047.9375] "V" Vector__XXX
 SG_ Inverter_A_act_module_temp_2 : 48|16@1- (0.0625,0) [-2048|2047.9375] "�C" Vector__XXX
 SG_ Motor_A_act_temp_1 : 0|16@1- (0.0625,0) [-2048|2047.9375] "�C" Vector__XXX
 SG_ Motor_A_act_power_1 : 16|16@1- (0.016,0) [-524.288|524.272] "kW" Vector__XXX
 SG_ Motor_A_act_voltage_1 : 32|16@1- (0.0625,0) [-2048|2047.9375] "V" Vector__XXX
 SG_ Inverter_A_act_module_temp_1 : 48|16@1- (0.0625,0) [-2048|2047.9375] "�C" Vector__XXX
 SG_ Motor_A_act_temp_13 : 0|16@1- (0.0625,0) [-2048|2047.9375] "�C" Vector__XXX
 SG_ Motor_A_act_power_13 : 16|16@1- (0.016,0) [-524.288|524.272] "kW" Vector__XXX
 SG_ Motor_A_act_voltage_13 : 32|16@1- (0.0625,0) [-2048|2047.9375] "V" Vector__XXX
 SG_ Inverter_A_act_module_temp_13 : 48|16@1- (0.0625,0) [-2048|2047.9375] "�C" Vector__XXX
 SG_ Motor_A_act_temp_12 : 0|16@1- (0.0625,0) [-2048|2047.9375] "�C" Vector__XXX
 SG_ Motor_A_act_power_12 : 16|16@1- (0.016,0) [-524.288|524.272] "kW" Vector__XXX
 SG_ Motor_A_act_voltage_12 : 32|16@1- (0.0625,0) [-2048|2047.9375] "V" Vector__XXX
 SG_ Inverter_A_act_module_temp_12 : 48|16@1- (0.0625,0) [-2048|2047.9375] "�C" Vector__XXX
 SG_ Motor_A_act_temp_11 : 0|16@1- (0.0625,0) [-2048|2047.9375] "�C" Vector__XXX
 SG_ Motor_A_act_power_11 : 16|16@1- (0.016,0) [-524.288|524.272] "kW" Vector__XXX
 SG_ Motor_A_act_voltage_11 : 32|16@1- (0.0625,0) [-2048|2047.9375] "V" Vector__XXX
 SG_ Inverter_A_act_module_temp_11 : 48|16@1- (0.0625,0) [-2048|2047.9375] "�C" Vector__XXX
 SG_ Motor_A_act_temp_10 : 0|16@1- (0.0625,0) [-2048|2047.9375] "�C" Vector__XXX
 SG_ Motor_A_act_power_10 : 16|16@1- (0.016,0) [-524.288|524.272] "kW" Vector__XXX
 SG_ Motor_A_act_voltage_10 : 32|16@1- (0.0625,0) [-2048|2047.9375] "V" Vector__XXX
 SG_ Inverter_A_act_module_temp_10 : 48|16@1- (0.0625,0) [-2048|2047.9375] "�C" Vector__XXX
 SG_ Motor_A_act_temp_9 : 0|16@1- (0.0625,0) [-2048|2047.9375] "�C" Vector__XXX
 SG_ Motor_A_act_power_9 : 16|16@1- (0.016,0) [-524.288|524.272] "kW" Vector__XXX
 SG_ Motor_A_act_voltage_9 : 32|16@1- (0.0625,0) [-2048|2047.9375] "V" Vector__XXX
 SG_ Inverter_A_act_module_temp_9 : 48|16@1- (0.0625,0) [-2048|2047.9375] "�C" Vector__XXX
 SG_ Motor_A_act_temp_8 : 0|16@1- (0.0625,0) [-2048|2047.9375] "�C" Vector__XXX
 SG_ Motor_A_act_power_8 : 16|16@1- (0.016,0) [-524.288|524.272] "kW" Vector__XXX
 SG_ Motor_A_act_voltage_8 : 32|16@1- (0.0625,0) [-2048|2047.9375] "V" Vector__XXX
 SG_ Inverter_A_act_module_temp_8 : 48|16@1- (0.0625,0) [-2048|2047.9375] "�C" Vector__XXX
 SG_ Motor_A_act_temp_7 : 0|16@1- (0.0625,0) [-2048|2047.9375] "�C" Vector__XXX
 SG_ Motor_A_act_power_7 : 16|16@1- (0.016,0) [-524.288|524.272] "kW" Vector__XXX
 SG_ Motor_A_act_voltage_7 : 32|16@1- (0.0625,0) [-2048|2047.9375] "V" Vector__XXX
 SG_ Inverter_A_act_module_temp_7 : 48|16@1- (0.0625,0) [-2048|2047.9375] "�C" Vector__XXX
 SG_ Inverter_B_Statusword_5 : 0|7@1+ (1,0) [0|127] "" Vector__XXX
 SG_ EVENTBUFFER_NEW_EVENT : 16|1@1+ (1,0) [0|1] "" Vector__XXX
 SG_ EVENTBUFFER_OVERFLOW : 17|1@1+ (1,0) [0|1] "" Vector__XXX
 SG_ POWERMODULE_TRIPZONE_OVERCURRE : 18|1@1+ (1,0) [0|1] "" Vector__XXX
 SG_ POWERMODULE_CURRENT_OFFSET_INI : 19|1@1+ (1,0) [0|1] "" Vector__XXX
 SG_ POWERMODULE_TEMPSENSOR_ERROR : 20|1@1+ (1,0) [0|1] "" Vector__XXX
 SG_ POWERMODULE_TEMPERATURE_WARNIN : 21|1@1+ (1,0) [0|1] "" Vector__XXX
 SG_ POWERMODULE_OVERTEMPERATURE : 22|1@1+ (1,0) [0|1] "" Vector__XXX
 SG_ POWERMODULE_IXT_FAULT : 23|1@1+ (1,0) [0|1] "" Vector__XXX
 SG_ POWERMODULE_SW_OVERCURRENT : 24|1@1+ (1,0) [0|1] "" Vector__XXX
 SG_ POWERMODULE_PATTERNDATA_INCONS : 25|1@1+ (1,0) [0|1] "" Vector__XXX
 SG_ DCBUS_TRIPZONE_OVERVOLTAGE : 26|1@1+ (1,0) [0|1] "" Vector__XXX
 SG_ DCBUS_SW_OVERVOLTAGE : 27|1@1+ (1,0) [0|1] "" Vector__XXX
 SG_ DCBUS_SW_UNDERVOLTAGE : 28|1@1+ (1,0) [0|1] "" Vector__XXX
 SG_ NEIGHBOUR_FAULT : 29|1@1+ (1,0) [0|1] "" Vector__XXX
 SG_ MOTOR_TEMPSENSOR_ERROR : 30|1@1+ (1,0) [0|1] "" Vector__XXX
 SG_ MOTOR_TEMPERATURE_WARNING : 31|1@1+ (1,0) [0|1] "" Vector__XXX
 SG_ MOTOR_OVERTEMPERATURE : 32|1@1+ (1,0) [0|1] "" Vector__XXX
 SG_ MOTOR_STATOR_FREQ_TO_HIGH : 33|1@1+ (1,0) [0|1] "" Vector__XXX
 SG_ SUPPLYVOLTAGE_ERROR : 34|1@1+ (1,0) [0|1] "" Vector__XXX
 SG_ RPDO_TIMEOUT : 35|1@1+ (1,0) [0|1] "" Vector__XXX
 SG_ NMT_NOT_OPERATIONAL : 36|1@1+ (1,0) [0|1] "" Vector__XXX
 SG_ TASKOVERRUN : 37|1@1+ (1,0) [0|1] "" Vector__XXX
 SG_ NETSYNC_ERROR : 38|1@1+ (1,0) [0|1] "" Vector__XXX
 SG_ POSDEVICE_SIGNAL_TO_LOW : 39|1@1+ (1,0) [0|1] "" Vector__XXX
 SG_ POSDEVICE_SIGNAL_TO_HIGH : 40|1@1+ (1,0) [0|1] "" Vector__XXX
 SG_ RESOLVER_CALIBRATION_FAILED : 41|1@1+ (1,0) [0|1] "" Vector__XXX
 SG_ SYSTEM_FAULT : 42|1@1+ (1,0) [0|1] "" Vector__XXX
 SG_ INTERLOCK_OPEN : 43|1@1+ (1,0) [0|1] "" Vector__XXX
 SG_ APPC_HAS_GATE_DRIVER_DISABLED : 44|1@1+ (1,0) [0|1] "" Vector__XXX
 SG_ MOTOR_STALL_ERROR : 45|1@1+ (1,0) [0|1] "" Vector__XXX
 SG_ AMBIENT_TEMPERATURE_WARNING : 46|1@1+ (1,0) [0|1] "" Vector__XXX
 SG_ AMBIENT_OVERTEMPERATURE : 47|1@1+ (1,0) [0|1] "" Vector__XXX
 SG_ AMBIENT_TEMPSENSOR_ERROR : 48|1@1+ (1,0) [0|1] "" Vector__XXX
 SG_ POWERMODULE_CLAMPING_TIMEOUT : 49|1@1+ (1,0) [0|1] "" Vector__XXX
 SG_ DCBUS_RIPPLE_TO_HIGH : 50|1@1+ (1,0) [0|1] "" Vector__XXX
 SG_ MOTOR_I2XT_WARNING : 51|1@1+ (1,0) [0|1] "" Vector__XXX
 SG_ MOTOR_I2XT_ERROR : 52|1@1+ (1,0) [0|1] "" Vector__XXX
 SG_ MOTOR_FIELDWEAKENING_ERROR : 53|1@1+ (1,0) [0|1] "" Vector__XXX
 SG_ INVALID_PARAMETER_COMBINATION : 54|1@1+ (1,0) [0|1] "" Vector__XXX
 SG_ PLUG_COVER_SENSOR_SIGNAL_LOW : 55|1@1+ (1,0) [0|1] "" Vector__XXX
 SG_ MOTOR_CONNECTION_TEST_FAILED : 56|1@1+ (1,0) [0|1] "" Vector__XXX
 SG_ POWERMODULE_IXT_WARNING : 57|1@1+ (1,0) [0|1] "" Vector__XXX
 SG_ ISOLATION_FAULT : 58|1@1+ (1,0) [0|1] "" Vector__XXX
 SG_ Inverter_B_Statusword_4 : 0|7@1+ (1,0) [0|127] "" Vector__XXX
 SG_ EVENTBUFFER_NEW_EVENT : 16|1@1+ (1,0) [0|1] "" Vector__XXX
 SG_ EVENTBUFFER_OVERFLOW : 17|1@1+ (1,0) [0|1] "" Vector__XXX
 SG_ POWERMODULE_TRIPZONE_OVERCURRE : 18|1@1+ (1,0) [0|1] "" Vector__XXX
 SG_ POWERMODULE_CURRENT_OFFSET_INI : 19|1@1+ (1,0) [0|1] "" Vector__XXX
 SG_ POWERMODULE_TEMPSENSOR_ERROR : 20|1@1+ (1,0) [0|1] "" Vector__XXX
 SG_ POWERMODULE_TEMPERATURE_WARNIN : 21|1@1+ (1,0) [0|1] "" Vector__XXX
 SG_ POWERMODULE_OVERTEMPERATURE : 22|1@1+ (1,0) [0|1] "" Vector__XXX
 SG_ POWERMODULE_IXT_FAULT : 23|1@1+ (1,0) [0|1] "" Vector__XXX
 SG_ POWERMODULE_SW_OVERCURRENT : 24|1@1+ (1,0) [0|1] "" Vector__XXX
 SG_ POWERMODULE_PATTERNDATA_INCONS : 25|1@1+ (1,0) [0|1] "" Vector__XXX
 SG_ DCBUS_TRIPZONE_OVERVOLTAGE : 26|1@1+ (1,0) [0|1] "" Vector__XXX
 SG_ DCBUS_SW_OVERVOLTAGE : 27|1@1+ (1,0) [0|1] "" Vector__XXX
 SG_ DCBUS_SW_UNDERVOLTAGE : 28|1@1+ (1,0) [0|1] "" Vector__XXX
 SG_ NEIGHBOUR_FAULT : 29|1@1+ (1,0) [0|1] "" Vector__XXX
 SG_ MOTOR_TEMPSENSOR_ERROR : 30|1@1+ (1,0) [0|1] "" Vector__XXX
 SG_ MOTOR_TEMPERATURE_WARNING : 31|1@1+ (1,0) [0|1] "" Vector__XXX
 SG_ MOTOR_OVERTEMPERATURE : 32|1@1+ (1,0) [0|1] "" Vector__XXX
 SG_ MOTOR_STATOR_FREQ_TO_HIGH : 33|1@1+ (1,0) [0|1] "" Vector__XXX
 SG_ SUPPLYVOLTAGE_ERROR : 34|1@1+ (1,0) [0|1] "" Vector__XXX
 SG_ RPDO_TIMEOUT : 35|1@1+ (1,0) [0|1] "" Vector__XXX
 SG_ NMT_NOT_OPERATIONAL : 36|1@1+ (1,0) [0|1] "" Vector__XXX
 SG_ TASKOVERRUN : 37|1@1+ (1,0) [0|1] "" Vector__XXX
 SG_ NETSYNC_ERROR : 38|1@1+ (1,0) [0|1] "" Vector__XXX
 SG_ POSDEVICE_SIGNAL_TO_LOW : 39|1@1+ (1,0) [0|1] "" Vector__XXX
 SG_ POSDEVICE_SIGNAL_TO_HIGH : 40|1@1+ (1,0) [0|1] "" Vector__XXX
 SG_ RESOLVER_CALIBRATION_FAILED : 41|1@1+ (1,0) [0|1] "" Vector__XXX
 SG_ SYSTEM_FAULT : 42|1@1+ (1,0) [0|1] "" Vector__XXX
 SG_ INTERLOCK_OPEN : 43|1@1+ (1,0) [0|1] "" Vector__XXX
 SG_ APPC_HAS_GATE_DRIVER_DISABLED : 44|1@1+ (1,0) [0|1] "" Vector__XXX
 SG_ MOTOR_STALL_ERROR : 45|1@1+ (1,0) [0|1] "" Vector__XXX
 SG_ AMBIENT_TEMPERATURE_WARNING : 46|1@1+ (1,0) [0|1] "" Vector__XXX
 SG_ AMBIENT_OVERTEMPERATURE : 47|1@1+ (1,0) [0|1] "" Vector__XXX
 SG_ AMBIENT_TEMPSENSOR_ERROR : 48|1@1+ (1,0) [0|1] "" Vector__XXX
 SG_ POWERMODULE_CLAMPING_TIMEOUT : 49|1@1+ (1,0) [0|1] "" Vector__XXX
 SG_ DCBUS_RIPPLE_TO_HIGH : 50|1@1+ (1,0) [0|1] "" Vector__XXX
 SG_ MOTOR_I2XT_WARNING : 51|1@1+ (1,0) [0|1] "" Vector__XXX
 SG_ MOTOR_I2XT_ERROR : 52|1@1+ (1,0) [0|1] "" Vector__XXX
 SG_ MOTOR_FIELDWEAKENING_ERROR : 53|1@1+ (1,0) [0|1] "" Vector__XXX
 SG_ INVALID_PARAMETER_COMBINATION : 54|1@1+ (1,0) [0|1] "" Vector__XXX
 SG_ PLUG_COVER_SENSOR_SIGNAL_LOW : 55|1@1+ (1,0) [0|1] "" Vector__XXX
 SG_ MOTOR_CONNECTION_TEST_FAILED : 56|1@1+ (1,0) [0|1] "" Vector__XXX
 SG_ POWERMODULE_IXT_WARNING : 57|1@1+ (1,0) [0|1] "" Vector__XXX
 SG_ ISOLATION_FAULT : 58|1@1+ (1,0) [0|1] "" Vector__XXX
 SG_ Inverter_B_Statusword_3 : 0|7@1+ (1,0) [0|127] "" Vector__XXX
 SG_ EVENTBUFFER_NEW_EVENT : 16|1@1+ (1,0) [0|1] "" Vector__XXX
 SG_ EVENTBUFFER_OVERFLOW : 17|1@1+ (1,0) [0|1] "" Vector__XXX
 SG_ POWERMODULE_TRIPZONE_OVERCURRE : 18|1@1+ (1,0) [0|1] "" Vector__XXX
 SG_ POWERMODULE_CURRENT_OFFSET_INI : 19|1@1+ (1,0) [0|1] "" Vector__XXX
 SG_ POWERMODULE_TEMPSENSOR_ERROR : 20|1@1+ (1,0) [0|1] "" Vector__XXX
 SG_ POWERMODULE_TEMPERATURE_WARNIN : 21|1@1+ (1,0) [0|1] "" Vector__XXX
 SG_ POWERMODULE_OVERTEMPERATURE : 22|1@1+ (1,0) [0|1] "" Vector__XXX
 SG_ POWERMODULE_IXT_FAULT : 23|1@1+ (1,0) [0|1] "" Vector__XXX
 SG_ POWERMODULE_SW_OVERCURRENT : 24|1@1+ (1,0) [0|1] "" Vector__XXX
 SG_ POWERMODULE_PATTERNDATA_INCONS : 25|1@1+ (1,0) [0|1] "" Vector__XXX
 SG_ DCBUS_TRIPZONE_OVERVOLTAGE : 26|1@1+ (1,0) [0|1] "" Vector__XXX
 SG_ DCBUS_SW_OVERVOLTAGE : 27|1@1+ (1,0) [0|1] "" Vector__XXX
 SG_ DCBUS_SW_UNDERVOLTAGE : 28|1@1+ (1,0) [0|1] "" Vector__XXX
 SG_ NEIGHBOUR_FAULT : 29|1@1+ (1,0) [0|1] "" Vector__XXX
 SG_ MOTOR_TEMPSENSOR_ERROR : 30|1@1+ (1,0) [0|1] "" Vector__XXX
 SG_ MOTOR_TEMPERATURE_WARNING : 31|1@1+ (1,0) [0|1] "" Vector__XXX
 SG_ MOTOR_OVERTEMPERATURE : 32|1@1+ (1,0) [0|1] "" Vector__XXX
 SG_ MOTOR_STATOR_FREQ_TO_HIGH : 33|1@1+ (1,0) [0|1] "" Vector__XXX
 SG_ SUPPLYVOLTAGE_ERROR : 34|1@1+ (1,0) [0|1] "" Vector__XXX
 SG_ RPDO_TIMEOUT : 35|1@1+ (1,0) [0|1] "" Vector__XXX
 SG_ NMT_NOT_OPERATIONAL : 36|1@1+ (1,0) [0|1] "" Vector__XXX
 SG_ TASKOVERRUN : 37|1@1+ (1,0) [0|1] "" Vector__XXX
 SG_ NETSYNC_ERROR : 38|1@1+ (1,0) [0|1] "" Vector__XXX
 SG_ POSDEVICE_SIGNAL_TO_LOW : 39|1@1+ (1,0) [0|1] "" Vector__XXX
 SG_ POSDEVICE_SIGNAL_TO_HIGH : 40|1@1+ (1,0) [0|1] "" Vector__XXX
 SG_ RESOLVER_CALIBRATION_FAILED : 41|1@1+ (1,0) [0|1] "" Vector__XXX
 SG_ SYSTEM_FAULT : 42|1@1+ (1,0) [0|1] "" Vector__XXX
 SG_ INTERLOCK_OPEN : 43|1@1+ (1,0) [0|1] "" Vector__XXX
 SG_ APPC_HAS_GATE_DRIVER_DISABLED : 44|1@1+ (1,0) [0|1] "" Vector__XXX
 SG_ MOTOR_STALL_ERROR : 45|1@1+ (1,0) [0|1] "" Vector__XXX
 SG_ AMBIENT_TEMPERATURE_WARNING : 46|1@1+ (1,0) [0|1] "" Vector__XXX
 SG_ AMBIENT_OVERTEMPERATURE : 47|1@1+ (1,0) [0|1] "" Vector__XXX
 SG_ AMBIENT_TEMPSENSOR_ERROR : 48|1@1+ (1,0) [0|1] "" Vector__XXX
 SG_ POWERMODULE_CLAMPING_TIMEOUT : 49|1@1+ (1,0) [0|1] "" Vector__XXX
 SG_ DCBUS_RIPPLE_TO_HIGH : 50|1@1+ (1,0) [0|1] "" Vector__XXX
 SG_ MOTOR_I2XT_WARNING : 51|1@1+ (1,0) [0|1] "" Vector__XXX
 SG_ MOTOR_I2XT_ERROR : 52|1@1+ (1,0) [0|1] "" Vector__XXX
 SG_ MOTOR_FIELDWEAKENING_ERROR : 53|1@1+ (1,0) [0|1] "" Vector__XXX
 SG_ INVALID_PARAMETER_COMBINATION : 54|1@1+ (1,0) [0|1] "" Vector__XXX
 SG_ PLUG_COVER_SENSOR_SIGNAL_LOW : 55|1@1+ (1,0) [0|1] "" Vector__XXX
 SG_ MOTOR_CONNECTION_TEST_FAILED : 56|1@1+ (1,0) [0|1] "" Vector__XXX
 SG_ POWERMODULE_IXT_WARNING : 57|1@1+ (1,0) [0|1] "" Vector__XXX
 SG_ ISOLATION_FAULT : 58|1@1+ (1,0) [0|1] "" Vector__XXX
 SG_ Inverter_B_Statusword_2 : 0|7@1+ (1,0) [0|127] "" Vector__XXX
 SG_ EVENTBUFFER_NEW_EVENT : 16|1@1+ (1,0) [0|1] "" Vector__XXX
 SG_ EVENTBUFFER_OVERFLOW : 17|1@1+ (1,0) [0|1] "" Vector__XXX
 SG_ POWERMODULE_TRIPZONE_OVERCURRE : 18|1@1+ (1,0) [0|1] "" Vector__XXX
 SG_ POWERMODULE_CURRENT_OFFSET_INI : 19|1@1+ (1,0) [0|1] "" Vector__XXX
 SG_ POWERMODULE_TEMPSENSOR_ERROR : 20|1@1+ (1,0) [0|1] "" Vector__XXX
 SG_ POWERMODULE_TEMPERATURE_WARNIN : 21|1@1+ (1,0) [0|1] "" Vector__XXX
 SG_ POWERMODULE_OVERTEMPERATURE : 22|1@1+ (1,0) [0|1] "" Vector__XXX
 SG_ POWERMODULE_IXT_FAULT : 23|1@1+ (1,0) [0|1] "" Vector__XXX
 SG_ POWERMODULE_SW_OVERCURRENT : 24|1@1+ (1,0) [0|1] "" Vector__XXX
 SG_ POWERMODULE_PATTERNDATA_INCONS : 25|1@1+ (1,0) [0|1] "" Vector__XXX
 SG_ DCBUS_TRIPZONE_OVERVOLTAGE : 26|1@1+ (1,0) [0|1] "" Vector__XXX
 SG_ DCBUS_SW_OVERVOLTAGE : 27|1@1+ (1,0) [0|1] "" Vector__XXX
 SG_ _B1_Resp_Trigger_Mask : 0|16@0+ (1,0) [0|0] "" Vector__XXX
 SG_ _B9_Resp_Device_spare : 0|8@0+ (1,0) [0|0] "" Vector__XXX
 SG_ Device_dc_link_vol_5 : 0|16@1- (0.0625,0) [-2048|2047.9375] "V" Vector__XXX
 SG_ Device_ambient_temp_5 : 16|16@1- (0.0625,0) [-2048|2047.9375] "�C" Vector__XXX
 SG_ Device_dc_link_power_5 : 32|16@1- (0.016,0) [-524.288|524.272] "kW" Vector__XXX
 SG_ Device_dc_link_vol_4 : 0|16@1- (0.0625,0) [-2048|2047.9375] "V" Vector__XXX
 SG_ Device_ambient_temp_4 : 16|16@1- (0.0625,0) [-2048|2047.9375] "�C" Vector__XXX
 SG_ Device_dc_link_power_4 : 32|16@1- (0.016,0) [-524.288|524.272] "kW" Vector__XXX
 SG_ Device_dc_link_vol_3 : 0|16@1- (0.0625,0) [-2048|2047.9375] "V" Vector__XXX
 SG_ Device_ambient_temp_3 : 16|16@1- (0.0625,0) [-2048|2047.9375] "�C" Vector__XXX
 SG_ Device_dc_link_power_3 : 32|16@1- (0.016,0) [-524.288|524.272] "kW" Vector__XXX
 SG_ Device_dc_link_vol_2 : 0|16@1- (0.0625,0) [-2048|2047.9375] "V" Vector__XXX
 SG_ Device_ambient_temp_2 : 16|16@1- (0.0625,0) [-2048|2047.9375] "�C" Vector__XXX
 SG_ Device_dc_link_power_2 : 32|16@1- (0.016,0) [-524.288|524.272] "kW" Vector__XXX
 SG_ Device_dc_link_vol_1 : 0|16@1- (0.0625,0) [-2048|2047.9375] "V" Vector__XXX
 SG_ Device_ambient_temp_1 : 16|16@1- (0.0625,0) [-2048|2047.9375] "�C" Vector__XXX
 SG_ Device_dc_link_power_1 : 32|16@1- (0.016,0) [-524.288|524.272] "kW" Vector__XXX
 SG_ Device_dc_link_vol_13 : 0|16@1- (0.0625,0) [-2048|2047.9375] "V" Vector__XXX
 SG_ Device_ambient_temp_13 : 16|16@1- (0.0625,0) [-2048|2047.9375] "�C" Vector__XXX
 SG_ Device_dc_link_power_13 : 32|16@1- (0.016,0) [-524.288|524.272] "kW" Vector__XXX
 SG_ Device_dc_link_vol_12 : 0|16@1- (0.0625,0) [-2048|2047.9375] "V" Vector__XXX
 SG_ Device_ambient_temp_12 : 16|16@1- (0.0625,0) [-2048|2047.9375] "�C" Vector__XXX
 SG_ Device_dc_link_power_12 : 32|16@1- (0.016,0) [-524.288|524.272] "kW" Vector__XXX
 SG_ Device_dc_link_vol_11 : 0|16@1- (0.0625,0) [-2048|2047.9375] "V" Vector__XXX
 SG_ Device_ambient_temp_11 : 16|16@1- (0.0625,0) [-2048|2047.9375] "�C" Vector__XXX
 SG_ Device_dc_link_power_11 : 32|16@1- (0.016,0) [-524.288|524.272] "kW" Vector__XXX
 SG_ Device_dc_link_vol_10 : 0|16@1- (0.0625,0) [-2048|2047.9375] "V" Vector__XXX
 SG_ Device_ambient_temp_10 : 16|16@1- (0.0625,0) [-2048|2047.9375] "�C" Vector__XXX
 SG_ Device_dc_link_power_10 : 32|16@1- (0.016,0) [-524.288|524.272] "kW" Vector__XXX
 SG_ Device_dc_link_vol_9 : 0|16@1- (0.0625,0) [-2048|2047.9375] "V" Vector__XXX
 SG_ Device_ambient_temp_9 : 16|16@1- (0.0625,0) [-2048|2047.9375] "�C" Vector__XXX
 SG_ Device_dc_link_power_9 : 32|16@1- (0.016,0) [-524.288|524.272] "kW" Vector__XXX
 SG_ Device_dc_link_vol_8 : 0|16@1- (0.0625,0) [-2048|2047.9375] "V" Vector__XXX
 SG_ Device_ambient_temp_8 : 16|16@1- (0.0625,0) [-2048|2047.9375] "�C" Vector__XXX
 SG_ Device_dc_link_power_8 : 32|16@1- (0.016,0) [-524.288|524.272] "kW" Vector__XXX
 SG_ Device_dc_link_vol_7 : 0|16@1- (0.0625,0) [-2048|2047.9375] "V" Vector__XXX
 SG_ Device_ambient_temp_7 : 16|16@1- (0.0625,0) [-2048|2047.9375] "�C" Vector__XXX
 SG_ Device_dc_link_power_7 : 32|16@1- (0.016,0) [-524.288|524.272] "kW" Vector__XXX
 SG_ Inverter_A_Statusword_5 : 0|7@1+ (1,0) [0|127] "" Vector__XXX
 SG_ EVENTBUFFER_NEW_EVENT : 16|1@1+ (1,0) [0|1] "" Vector__XXX
 SG_ EVENTBUFFER_OVERFLOW : 17|1@1+ (1,0) [0|1] "" Vector__XXX
 SG_ POWERMODULE_TRIPZONE_OVERCURRE : 18|1@1+ (1,0) [0|1] "" Vector__XXX
 SG_ POWERMODULE_CURRENT_OFFSET_INI : 19|1@1+ (1,0) [0|1] "" Vector__XXX
 SG_ POWERMODULE_TEMPSENSOR_ERROR : 20|1@1+ (1,0) [0|1] "" Vector__XXX
 SG_ POWERMODULE_TEMPERATURE_WARNIN : 21|1@1+ (1,0) [0|1] "" Vector__XXX
 SG_ POWERMODULE_OVERTEMPERATURE : 22|1@1+ (1,0) [0|1] "" Vector__XXX
 SG_ POWERMODULE_IXT_FAULT : 23|1@1+ (1,0) [0|1] "" Vector__XXX
 SG_ POWERMODULE_SW_OVERCURRENT : 24|1@1+ (1,0) [0|1] "" Vector__XXX
 SG_ POWERMODULE_PATTERNDATA_INCONS : 25|1@1+ (1,0) [0|1] "" Vector__XXX
 SG_ DCBUS_TRIPZONE_OVERVOLTAGE : 26|1@1+ (1,0) [0|1] "" Vector__XXX
 SG_ DCBUS_SW_OVERVOLTAGE : 27|1@1+ (1,0) [0|1] "" Vector__XXX
 SG_ DCBUS_SW_UNDERVOLTAGE : 28|1@1+ (1,0) [0|1] "" Vector__XXX
 SG_ NEIGHBOUR_FAULT : 29|1@1+ (1,0) [0|1] "" Vector__XXX
 SG_ MOTOR_TEMPSENSOR_ERROR : 30|1@1+ (1,0) [0|1] "" Vector__XXX
 SG_ MOTOR_TEMPERATURE_WARNING : 31|1@1+ (1,0) [0|1] "" Vector__XXX
 SG_ MOTOR_OVERTEMPERATURE : 32|1@1+ (1,0) [0|1] "" Vector__XXX
 SG_ MOTOR_STATOR_FREQ_TO_HIGH : 33|1@1+ (1,0) [0|1] "" Vector__XXX
 SG_ SUPPLYVOLTAGE_ERROR : 34|1@1+ (1,0) [0|1] "" Vector__XXX
 SG_ RPDO_TIMEOUT : 35|1@1+ (1,0) [0|1] "" Vector__XXX
 SG_ NMT_NOT_OPERATIONAL : 36|1@1+ (1,0) [0|1] "" Vector__XXX
 SG_ TASKOVERRUN : 37|1@1+ (1,0) [0|1] "" Vector__XXX
 SG_ NETSYNC_ERROR : 38|1@1+ (1,0) [0|1] "" Vector__XXX
 SG_ POSDEVICE_SIGNAL_TO_LOW : 39|1@1+ (1,0) [0|1] "" Vector__XXX
 SG_ POSDEVICE_SIGNAL_TO_HIGH : 40|1@1+ (1,0) [0|1] "" Vector__XXX
 SG_ RESOLVER_CALIBRATION_FAILED : 41|1@1+ (1,0) [0|1] "" Vector__XXX
 SG_ SYSTEM_FAULT : 42|1@1+ (1,0) [0|1] "" Vector__XXX
 SG_ INTERLOCK_OPEN : 43|1@1+ (1,0) [0|1] "" Vector__XXX
 SG_ APPC_HAS_GATE_DRIVER_DISABLED : 44|1@1+ (1,0) [0|1] "" Vector__XXX
 SG_ MOTOR_STALL_ERROR : 45|1@1+ (1,0) [0|1] "" Vector__XXX
 SG_ AMBIENT_TEMPERATURE_WARNING : 46|1@1+ (1,0) [0|1] "" Vector__XXX
 SG_ AMBIENT_OVERTEMPERATURE : 47|1@1+ (1,0) [0|1] "" Vector__XXX
 SG_ AMBIENT_TEMPSENSOR_ERROR : 48|1@1+ (1,0) [0|1] "" Vector__XXX
 SG_ POWERMODULE_CLAMPING_TIMEOUT : 49|1@1+ (1,0) [0|1] "" Vector__XXX
 SG_ DCBUS_RIPPLE_TO_HIGH : 50|1@1+ (1,0) [0|1] "" Vector__XXX
 SG_ MOTOR_I2XT_WARNING : 51|1@1+ (1,0) [0|1] "" Vector__XXX
 SG_ MOTOR_I2XT_ERROR : 52|1@1+ (1,0) [0|1] "" Vector__XXX
 SG_ MOTOR_FIELDWEAKENING_ERROR : 53|1@1+ (1,0) [0|1] "" Vector__XXX
 SG_ INVALID_PARAMETER_COMBINATION : 54|1@1+ (1,0) [0|1] "" Vector__XXX
 SG_ PLUG_COVER_SENSOR_SIGNAL_LOW : 55|1@1+ (1,0) [0|1] "" Vector__XXX
 SG_ MOTOR_CONNECTION_TEST_FAILED : 56|1@1+ (1,0) [0|1] "" Vector__XXX
 SG_ POWERMODULE_IXT_WARNING : 57|1@1+ (1,0) [0|1] "" Vector__XXX
 SG_ ISOLATION_FAULT : 58|1@1+ (1,0) [0|1] "" Vector__XXX
 SG_ Inverter_A_Statusword_4 : 0|7@1+ (1,0) [0|127] "" Vector__XXX
 SG_ EVENTBUFFER_NEW_EVENT : 16|1@1+ (1,0) [0|1] "" Vector__XXX
 SG_ EVENTBUFFER_OVERFLOW : 17|1@1+ (1,0) [0|1] "" Vector__XXX
 SG_ POWERMODULE_TRIPZONE_OVERCURRE : 18|1@1+ (1,0) [0|1] "" Vector__XXX
 SG_ POWERMODULE_CURRENT_OFFSET_INI : 19|1@1+ (1,0) [0|1] "" Vector__XXX
 SG_ POWERMODULE_TEMPSENSOR_ERROR : 20|1@1+ (1,0) [0|1] "" Vector__XXX
 SG_ POWERMODULE_TEMPERATURE_WARNIN : 21|1@1+ (1,0) [0|1] "" Vector__XXX
 SG_ POWERMODULE_OVERTEMPERATURE : 22|1@1+ (1,0) [0|1] "" Vector__XXX
 SG_ POWERMODULE_IXT_FAULT : 23|1@1+ (1,0) [0|1] "" Vector__XXX
 SG_ POWERMODULE_SW_OVERCURRENT : 24|1@1+ (1,0) [0|1] "" Vector__XXX
 SG_ POWERMODULE_PATTERNDATA_INCONS : 25|1@1+ (1,0) [0|1] "" Vector__XXX
 SG_ DCBUS_TRIPZONE_OVERVOLTAGE : 26|1@1+ (1,0) [0|1] "" Vector__XXX
 SG_ DCBUS_SW_OVERVOLTAGE : 27|1@1+ (1,0) [0|1] "" Vector__XXX
 SG_ DCBUS_SW_UNDERVOLTAGE : 28|1@1+ (1,0) [0|1] "" Vector__XXX
 SG_ NEIGHBOUR_FAULT : 29|1@1+ (1,0) [0|1] "" Vector__XXX
 SG_ MOTOR_TEMPSENSOR_ERROR : 30|1@1+ (1,0) [0|1] "" Vector__XXX
 SG_ MOTOR_TEMPERATURE_WARNING : 31|1@1+ (1,0) [0|1] "" Vector__XXX
 SG_ MOTOR_OVERTEMPERATURE : 32|1@1+ (1,0) [0|1] "" Vector__XXX
 SG_ MOTOR_STATOR_FREQ_TO_HIGH : 33|1@1+ (1,0) [0|1] "" Vector__XXX
 SG_ SUPPLYVOLTAGE_ERROR : 34|1@1+ (1,0) [0|1] "" Vector__XXX
 SG_ RPDO_TIMEOUT : 35|1@1+ (1,0) [0|1] "" Vector__XXX
 SG_ NMT_NOT_OPERATIONAL : 36|1@1+ (1,0) [0|1] "" Vector__XXX
 SG_ TASKOVERRUN : 37|1@1+ (1,0) [0|1] "" Vector__XXX
 SG_ NETSYNC_ERROR : 38|1@1+ (1,0) [0|1] "" Vector__XXX
 SG_ POSDEVICE_SIGNAL_TO_LOW : 39|1@1+ (1,0) [0|1] "" Vector__XXX
 SG_ POSDEVICE_SIGNAL_TO_HIGH : 40|1@1+ (1,0) [0|1] "" Vector__XXX
 SG_ RESOLVER_CALIBRATION_FAILED : 41|1@1+ (1,0) [0|1] "" Vector__XXX
 SG_ SYSTEM_FAULT : 42|1@1+ (1,0) [0|1] "" Vector__XXX
 SG_ INTERLOCK_OPEN : 43|1@1+ (1,0) [0|1] "" Vector__XXX
 SG_ APPC_HAS_GATE_DRIVER_DISABLED : 44|1@1+ (1,0) [0|1] "" Vector__XXX
 SG_ MOTOR_STALL_ERROR : 45|1@1+ (1,0) [0|1] "" Vector__XXX
 SG_ AMBIENT_TEMPERATURE_WARNING : 46|1@1+ (1,0) [0|1] "" Vector__XXX
 SG_ AMBIENT_OVERTEMPERATURE : 47|1@1+ (1,0) [0|1] "" Vector__XXX
 SG_ AMBIENT_TEMPSENSOR_ERROR : 48|1@1+ (1,0) [0|1] "" Vector__XXX
 SG_ POWERMODULE_CLAMPING_TIMEOUT : 49|1@1+ (1,0) [0|1] "" Vector__XXX
 SG_ DCBUS_RIPPLE_TO_HIGH : 50|1@1+ (1,0) [0|1] "" Vector__XXX
 SG_ MOTOR_I2XT_WARNING : 51|1@1+ (1,0) [0|1] "" Vector__XXX
 SG_ MOTOR_I2XT_ERROR : 52|1@1+ (1,0) [0|1] "" Vector__XXX
 SG_ MOTOR_FIELDWEAKENING_ERROR : 53|1@1+ (1,0) [0|1] "" Vector__XXX
 SG_ INVALID_PARAMETER_COMBINATION : 54|1@1+ (1,0) [0|1] "" Vector__XXX
 SG_ PLUG_COVER_SENSOR_SIGNAL_LOW : 55|1@1+ (1,0) [0|1] "" Vector__XXX
 SG_ MOTOR_CONNECTION_TEST_FAILED : 56|1@1+ (1,0) [0|1] "" Vector__XXX
 SG_ POWERMODULE_IXT_WARNING : 57|1@1+ (1,0) [0|1] "" Vector__XXX
 SG_ ISOLATION_FAULT : 58|1@1+ (1,0) [0|1] "" Vector__XXX
 SG_ Inverter_A_Statusword_3 : 0|7@1+ (1,0) [0|127] "" Vector__XXX
 SG_ EVENTBUFFER_NEW_EVENT : 16|1@1+ (1,0) [0|1] "" Vector__XXX
 SG_ EVENTBUFFER_OVERFLOW : 17|1@1+ (1,0) [0|1] "" Vector__XXX
 SG_ POWERMODULE_TRIPZONE_OVERCURRE : 18|1@1+ (1,0) [0|1] "" Vector__XXX
 SG_ POWERMODULE_CURRENT_OFFSET_INI : 19|1@1+ (1,0) [0|1] "" Vector__XXX
 SG_ POWERMODULE_TEMPSENSOR_ERROR : 20|1@1+ (1,0) [0|1] "" Vector__XXX
 SG_ POWERMODULE_TEMPERATURE_WARNIN : 21|1@1+ (1,0) [0|1] "" Vector__XXX
 SG_ POWERMODULE_OVERTEMPERATURE : 22|1@1+ (1,0) [0|1] "" Vector__XXX
 SG_ POWERMODULE_IXT_FAULT : 23|1@1+ (1,0) [0|1] "" Vector__XXX
 SG_ POWERMODULE_SW_OVERCURRENT : 24|1@1+ (1,0) [0|1] "" Vector__XXX
 SG_ POWERMODULE_PATTERNDATA_INCONS : 25|1@1+ (1,0) [0|1] "" Vector__XXX
 SG_ DCBUS_TRIPZONE_OVERVOLTAGE : 26|1@1+ (1,0) [0|1] "" Vector__XXX
 SG_ DCBUS_SW_OVERVOLTAGE : 27|1@1+ (1,0) [0|1] "" Vector__XXX
 SG_ DCBUS_SW_UNDERVOLTAGE : 28|1@1+ (1,0) [0|1] "" Vector__XXX
 SG_ NEIGHBOUR_FAULT : 29|1@1+ (1,0) [0|1] "" Vector__XXX
 SG_ MOTOR_TEMPSENSOR_ERROR : 30|1@1+ (1,0) [0|1] "" Vector__XXX
 SG_ MOTOR_TEMPERATURE_WARNING : 31|1@1+ (1,0) [0|1] "" Vector__XXX
 SG_ MOTOR_OVERTEMPERATURE : 32|1@1+ (1,0) [0|1] "" Vector__XXX
 SG_ MOTOR_STATOR_FREQ_TO_HIGH : 33|1@1+ (1,0) [0|1] "" Vector__XXX
 SG_ SUPPLYVOLTAGE_ERROR : 34|1@1+ (1,0) [0|1] "" Vector__XXX
 SG_ RPDO_TIMEOUT : 35|1@1+ (1,0) [0|1] "" Vector__XXX
 SG_ NMT_NOT_OPERATIONAL : 36|1@1+ (1,0) [0|1] "" Vector__XXX
 SG_ TASKOVERRUN : 37|1@1+ (1,0) [0|1] "" Vector__XXX
 SG_ NETSYNC_ERROR : 38|1@1+ (1,0) [0|1] "" Vector__XXX
 SG_ POSDEVICE_SIGNAL_TO_LOW : 39|1@1+ (1,0) [0|1] "" Vector__XXX
 SG_ POSDEVICE_SIGNAL_TO_HIGH : 40|1@1+ (1,0) [0|1] "" Vector__XXX
 SG_ RESOLVER_CALIBRATION_FAILED : 41|1@1+ (1,0) [0|1] "" Vector__XXX
 SG_ SYSTEM_FAULT : 42|1@1+ (1,0) [0|1] "" Vector__XXX
 SG_ INTERLOCK_OPEN : 43|1@1+ (1,0) [0|1] "" Vector__XXX
 SG_ APPC_HAS_GATE_DRIVER_DISABLED : 44|1@1+ (1,0) [0|1] "" Vector__XXX
 SG_ MOTOR_STALL_ERROR : 45|1@1+ (1,0) [0|1] "" Vector__XXX
 SG_ AMBIENT_TEMPERATURE_WARNING : 46|1@1+ (1,0) [0|1] "" Vector__XXX
 SG_ AMBIENT_OVERTEMPERATURE : 47|1@1+ (1,0) [0|1] "" Vector__XXX
 SG_ AMBIENT_TEMPSENSOR_ERROR : 48|1@1+ (1,0) [0|1] "" Vector__XXX
 SG_ POWERMODULE_CLAMPING_TIMEOUT : 49|1@1+ (1,0) [0|1] "" Vector__XXX
 SG_ DCBUS_RIPPLE_TO_HIGH : 50|1@1+ (1,0) [0|1] "" Vector__XXX
 SG_ MOTOR_I2XT_WARNING : 51|1@1+ (1,0) [0|1] "" Vector__XXX
 SG_ MOTOR_I2XT_ERROR : 52|1@1+ (1,0) [0|1] "" Vector__XXX
 SG_ MOTOR_FIELDWEAKENING_ERROR : 53|1@1+ (1,0) [0|1] "" Vector__XXX
 SG_ INVALID_PARAMETER_COMBINATION : 54|1@1+ (1,0) [0|1] "" Vector__XXX
 SG_ PLUG_COVER_SENSOR_SIGNAL_LOW : 55|1@1+ (1,0) [0|1] "" Vector__XXX
 SG_ MOTOR_CONNECTION_TEST_FAILED : 56|1@1+ (1,0) [0|1] "" Vector__XXX
 SG_ POWERMODULE_IXT_WARNING : 57|1@1+ (1,0) [0|1] "" Vector__XXX
 SG_ ISOLATION_FAULT : 58|1@1+ (1,0) [0|1] "" Vector__XXX
 SG_ Inverter_A_Statusword_2 : 0|7@1+ (1,0) [0|127] "" Vector__XXX
 SG_ EVENTBUFFER_NEW_EVENT : 16|1@1+ (1,0) [0|1] "" Vector__XXX
 SG_ EVENTBUFFER_OVERFLOW : 17|1@1+ (1,0) [0|1] "" Vector__XXX
 SG_ POWERMODULE_TRIPZONE_OVERCURRE : 18|1@1+ (1,0) [0|1] "" Vector__XXX
 SG_ POWERMODULE_CURRENT_OFFSET_INI : 19|1@1+ (1,0) [0|1] "" Vector__XXX
 SG_ POWERMODULE_TEMPSENSOR_ERROR : 20|1@1+ (1,0) [0|1] "" Vector__XXX
 SG_ POWERMODULE_TEMPERATURE_WARNIN : 21|1@1+ (1,0) [0|1] "" Vector__XXX
 SG_ POWERMODULE_OVERTEMPERATURE : 22|1@1+ (1,0) [0|1] "" Vector__XXX
 SG_ POWERMODULE_IXT_FAULT : 23|1@1+ (1,0) [0|1] "" Vector__XXX
 SG_ POWERMODULE_SW_OVERCURRENT : 24|1@1+ (1,0) [0|1] "" Vector__XXX
 SG_ POWERMODULE_PATTERNDATA_INCONS : 25|1@1+ (1,0) [0|1] "" Vector__XXX
 SG_ DCBUS_TRIPZONE_OVERVOLTAGE : 26|1@1+ (1,0) [0|1] "" Vector__XXX
 SG_ DCBUS_SW_OVERVOLTAGE : 27|1@1+ (1,0) [0|1] "" Vector__XXX
 SG_ DCBUS_SW_UNDERVOLTAGE : 28|1@1+ (1,0) [0|1] "" Vector__XXX
 SG_ NEIGHBOUR_FAULT : 29|1@1+ (1,0) [0|1] "" Vector__XXX
 SG_ MOTOR_TEMPSENSOR_ERROR : 30|1@1+ (1,0) [0|1] "" Vector__XXX
 SG_ MOTOR_TEMPERATURE_WARNING : 31|1@1+ (1,0) [0|1] "" Vector__XXX
 SG_ MOTOR_OVERTEMPERATURE : 32|1@1+ (1,0) [0|1] "" Vector__XXX
 SG_ MOTOR_STATOR_FREQ_TO_HIGH : 33|1@1+ (1,0) [0|1] "" Vector__XXX
 SG_ SUPPLYVOLTAGE_ERROR : 34|1@1+ (1,0) [0|1] "" Vector__XXX
 SG_ RPDO_TIMEOUT : 35|1@1+ (1,0) [0|1] "" Vector__XXX
 SG_ NMT_NOT_OPERATIONAL : 36|1@1+ (1,0) [0|1] "" Vector__XXX
 SG_ TASKOVERRUN : 37|1@1+ (1,0) [0|1] "" Vector__XXX
 SG_ NETSYNC_ERROR : 38|1@1+ (1,0) [0|1] "" Vector__XXX
 SG_ POSDEVICE_SIGNAL_TO_LOW : 39|1@1+ (1,0) [0|1] "" Vector__XXX
 SG_ POSDEVICE_SIGNAL_TO_HIGH : 40|1@1+ (1,0) [0|1] "" Vector__XXX
 SG_ RESOLVER_CALIBRATION_FAILED : 41|1@1+ (1,0) [0|1] "" Vector__XXX
 SG_ SYSTEM_FAULT : 42|1@1+ (1,0) [0|1] "" Vector__XXX
 SG_ INTERLOCK_OPEN : 43|1@1+ (1,0) [0|1] "" Vector__XXX
 SG_ APPC_HAS_GATE_DRIVER_DISABLED : 44|1@1+ (1,0) [0|1] "" Vector__XXX
 SG_ MOTOR_STALL_ERROR : 45|1@1+ (1,0) [0|1] "" Vector__XXX
 SG_ AMBIENT_TEMPERATURE_WARNING : 46|1@1+ (1,0) [0|1] "" Vector__XXX
 SG_ AMBIENT_OVERTEMPERATURE : 47|1@1+ (1,0) [0|1] "" Vector__XXX
 SG_ AMBIENT_TEMPSENSOR_ERROR : 48|1@1+ (1,0) [0|1] "" Vector__XXX
 SG_ POWERMODULE_CLAMPING_TIMEOUT : 49|1@1+ (1,0) [0|1] "" Vector__XXX
 SG_ DCBUS_RIPPLE_TO_HIGH : 50|1@1+ (1,0) [0|1] "" Vector__XXX
 SG_ MOTOR_I2XT_WARNING : 51|1@1+ (1,0) [0|1] "" Vector__XXX
 SG_ MOTOR_I2XT_ERROR : 52|1@1+ (1,0) [0|1] "" Vector__XXX
 SG_ MOTOR_FIELDWEAKENING_ERROR : 53|1@1+ (1,0) [0|1] "" Vector__XXX
 SG_ INVALID_PARAMETER_COMBINATION : 54|1@1+ (1,0) [0|1] "" Vector__XXX
 SG_ PLUG_COVER_SENSOR_SIGNAL_LOW : 55|1@1+ (1,0) [0|1] "" Vector__XXX
 SG_ MOTOR_CONNECTION_TEST_FAILED : 56|1@1+ (1,0) [0|1] "" Vector__XXX
 SG_ POWERMODULE_IXT_WARNING : 57|1@1+ (1,0) [0|1] "" Vector__XXX
 SG_ ISOLATION_FAULT : 58|1@1+ (1,0) [0|1] "" Vector__XXX
 SG_ Inverter_A_Statusword_1 : 0|7@1+ (1,0) [0|127] "" Vector__XXX
 SG_ EVENTBUFFER_NEW_EVENT : 16|1@1+ (1,0) [0|1] "" Vector__XXX
 SG_ EVENTBUFFER_OVERFLOW : 17|1@1+ (1,0) [0|1] "" Vector__XXX
 SG_ POWERMODULE_TRIPZONE_OVERCURRE : 18|1@1+ (1,0) [0|1] "" Vector__XXX
 SG_ POWERMODULE_CURRENT_OFFSET_INI : 19|1@1+ (1,0) [0|1] "" Vector__XXX
 SG_ POWERMODULE_TEMPSENSOR_ERROR : 20|1@1+ (1,0) [0|1] "" Vector__XXX
 SG_ POWERMODULE_TEMPERATURE_WARNIN : 21|1@1+ (1,0) [0|1] "" Vector__XXX
 SG_ POWERMODULE_OVERTEMPERATURE : 22|1@1+ (1,0) [0|1] "" Vector__XXX
 SG_ POWERMODULE_IXT_FAULT : 23|1@1+ (1,0) [0|1] "" Vector__XXX
 SG_ POWERMODULE_SW_OVERCURRENT : 24|1@1+ (1,0) [0|1] "" Vector__XXX
 SG_ POWERMODULE_PATTERNDATA_INCONS : 25|1@1+ (1,0) [0|1] "" Vector__XXX
 SG_ DCBUS_TRIPZONE_OVERVOLTAGE : 26|1@1+ (1,0) [0|1] "" Vector__XXX
 SG_ DCBUS_SW_OVERVOLTAGE : 27|1@1+ (1,0) [0|1] "" Vector__XXX
 SG_ DCBUS_SW_UNDERVOLTAGE : 28|1@1+ (1,0) [0|1] "" Vector__XXX
 SG_ NEIGHBOUR_FAULT : 29|1@1+ (1,0) [0|1] "" Vector__XXX
 SG_ MOTOR_TEMPSENSOR_ERROR : 30|1@1+ (1,0) [0|1] "" Vector__XXX
 SG_ MOTOR_TEMPERATURE_WARNING : 31|1@1+ (1,0) [0|1] "" Vector__XXX
 SG_ MOTOR_OVERTEMPERATURE : 32|1@1+ (1,0) [0|1] "" Vector__XXX
 SG_ MOTOR_STATOR_FREQ_TO_HIGH : 33|1@1+ (1,0) [0|1] "" Vector__XXX
 SG_ SUPPLYVOLTAGE_ERROR : 34|1@1+ (1,0) [0|1] "" Vector__XXX
 SG_ RPDO_TIMEOUT : 35|1@1+ (1,0) [0|1] "" Vector__XXX
 SG_ NMT_NOT_OPERATIONAL : 36|1@1+ (1,0) [0|1] "" Vector__XXX
 SG_ TASKOVERRUN : 37|1@1+ (1,0) [0|1] "" Vector__XXX
 SG_ NETSYNC_ERROR : 38|1@1+ (1,0) [0|1] "" Vector__XXX
 SG_ POSDEVICE_SIGNAL_TO_LOW : 39|1@1+ (1,0) [0|1] "" Vector__XXX
 SG_ POSDEVICE_SIGNAL_TO_HIGH : 40|1@1+ (1,0) [0|1] "" Vector__XXX
 SG_ RESOLVER_CALIBRATION_FAILED : 41|1@1+ (1,0) [0|1] "" Vector__XXX
 SG_ SYSTEM_FAULT : 42|1@1+ (1,0) [0|1] "" Vector__XXX
 SG_ INTERLOCK_OPEN : 43|1@1+ (1,0) [0|1] "" Vector__XXX
 SG_ APPC_HAS_GATE_DRIVER_DISABLED : 44|1@1+ (1,0) [0|1] "" Vector__XXX
 SG_ MOTOR_STALL_ERROR : 45|1@1+ (1,0) [0|1] "" Vector__XXX
 SG_ AMBIENT_TEMPERATURE_WARNING : 46|1@1+ (1,0) [0|1] "" Vector__XXX
 SG_ AMBIENT_OVERTEMPERATURE : 47|1@1+ (1,0) [0|1] "" Vector__XXX
 SG_ AMBIENT_TEMPSENSOR_ERROR : 48|1@1+ (1,0) [0|1] "" Vector__XXX
 SG_ POWERMODULE_CLAMPING_TIMEOUT : 49|1@1+ (1,0) [0|1] "" Vector__XXX
 SG_ DCBUS_RIPPLE_TO_HIGH : 50|1@1+ (1,0) [0|1] "" Vector__XXX
 SG_ MOTOR_I2XT_WARNING : 51|1@1+ (1,0) [0|1] "" Vector__XXX
 SG_ MOTOR_I2XT_ERROR : 52|1@1+ (1,0) [0|1] "" Vector__XXX
 SG_ MOTOR_FIELDWEAKENING_ERROR : 53|1@1+ (1,0) [0|1] "" Vector__XXX
 SG_ INVALID_PARAMETER_COMBINATION : 54|1@1+ (1,0) [0|1] "" Vector__XXX
 SG_ PLUG_COVER_SENSOR_SIGNAL_LOW : 55|1@1+ (1,0) [0|1] "" Vector__XXX
 SG_ MOTOR_CONNECTION_TEST_FAILED : 56|1@1+ (1,0) [0|1] "" Vector__XXX
 SG_ POWERMODULE_IXT_WARNING : 57|1@1+ (1,0) [0|1] "" Vector__XXX
 SG_ ISOLATION_FAULT : 58|1@1+ (1,0) [0|1] "" Vector__XXX
 SG_ Inverter_A_Statusword_13 : 0|7@1+ (1,0) [0|127] "" Vector__XXX
 SG_ EVENTBUFFER_NEW_EVENT : 16|1@1+ (1,0) [0|1] "" Vector__XXX
 SG_ EVENTBUFFER_OVERFLOW : 17|1@1+ (1,0) [0|1] "" Vector__XXX
 SG_ POWERMODULE_TRIPZONE_OVERCURRE : 18|1@1+ (1,0) [0|1] "" Vector__XXX
 SG_ POWERMODULE_CURRENT_OFFSET_INI : 19|1@1+ (1,0) [0|1] "" Vector__XXX
 SG_ POWERMODULE_TEMPSENSOR_ERROR : 20|1@1+ (1,0) [0|1] "" Vector__XXX
 SG_ POWERMODULE_TEMPERATURE_WARNIN : 21|1@1+ (1,0) [0|1] "" Vector__XXX
 SG_ POWERMODULE_OVERTEMPERATURE : 22|1@1+ (1,0) [0|1] "" Vector__XXX
 SG_ POWERMODULE_IXT_FAULT : 23|1@1+ (1,0) [0|1] "" Vector__XXX
 SG_ POWERMODULE_SW_OVERCURRENT : 24|1@1+ (1,0) [0|1] "" Vector__XXX
 SG_ POWERMODULE_PATTERNDATA_INCONS : 25|1@1+ (1,0) [0|1] "" Vector__XXX
 SG_ DCBUS_TRIPZONE_OVERVOLTAGE : 26|1@1+ (1,0) [0|1] "" Vector__XXX
 SG_ DCBUS_SW_OVERVOLTAGE : 27|1@1+ (1,0) [0|1] "" Vector__XXX
 SG_ DCBUS_SW_UNDERVOLTAGE : 28|1@1+ (1,0) [0|1] "" Vector__XXX
 SG_ NEIGHBOUR_FAULT : 29|1@1+ (1,0) [0|1] "" Vector__XXX
 SG_ MOTOR_TEMPSENSOR_ERROR : 30|1@1+ (1,0) [0|1] "" Vector__XXX
 SG_ MOTOR_TEMPERATURE_WARNING : 31|1@1+ (1,0) [0|1] "" Vector__XXX
 SG_ MOTOR_OVERTEMPERATURE : 32|1@1+ (1,0) [0|1] "" Vector__XXX
 SG_ MOTOR_STATOR_FREQ_TO_HIGH : 33|1@1+ (1,0) [0|1] "" Vector__XXX
 SG_ SUPPLYVOLTAGE_ERROR : 34|1@1+ (1,0) [0|1] "" Vector__XXX
 SG_ RPDO_TIMEOUT : 35|1@1+ (1,0) [0|1] "" Vector__XXX
 SG_ NMT_NOT_OPERATIONAL : 36|1@1+ (1,0) [0|1] "" Vector__XXX
 SG_ TASKOVERRUN : 37|1@1+ (1,0) [0|1] "" Vector__XXX
 SG_ NETSYNC_ERROR : 38|1@1+ (1,0) [0|1] "" Vector__XXX
 SG_ POSDEVICE_SIGNAL_TO_LOW : 39|1@1+ (1,0) [0|1] "" Vector__XXX
 SG_ POSDEVICE_SIGNAL_TO_HIGH : 40|1@1+ (1,0) [0|1] "" Vector__XXX
 SG_ RESOLVER_CALIBRATION_FAILED : 41|1@1+ (1,0) [0|1] "" Vector__XXX
 SG_ SYSTEM_FAULT : 42|1@1+ (1,0) [0|1] "" Vector__XXX
 SG_ INTERLOCK_OPEN : 43|1@1+ (1,0) [0|1] "" Vector__XXX
 SG_ APPC_HAS_GATE_DRIVER_DISABLED : 44|1@1+ (1,0) [0|1] "" Vector__XXX
 SG_ MOTOR_STALL_ERROR : 45|1@1+ (1,0) [0|1] "" Vector__XXX
 SG_ AMBIENT_TEMPERATURE_WARNING : 46|1@1+ (1,0) [0|1] "" Vector__XXX
 SG_ AMBIENT_OVERTEMPERATURE : 47|1@1+ (1,0) [0|1] "" Vector__XXX
 SG_ AMBIENT_TEMPSENSOR_ERROR : 48|1@1+ (1,0) [0|1] "" Vector__XXX
 SG_ POWERMODULE_CLAMPING_TIMEOUT : 49|1@1+ (1,0) [0|1] "" Vector__XXX
 SG_ DCBUS_RIPPLE_TO_HIGH : 50|1@1+ (1,0) [0|1] "" Vector__XXX
 SG_ MOTOR_I2XT_WARNING : 51|1@1+ (1,0) [0|1] "" Vector__XXX
 SG_ MOTOR_I2XT_ERROR : 52|1@1+ (1,0) [0|1] "" Vector__XXX
 SG_ MOTOR_FIELDWEAKENING_ERROR : 53|1@1+ (1,0) [0|1] "" Vector__XXX
 SG_ INVALID_PARAMETER_COMBINATION : 54|1@1+ (1,0) [0|1] "" Vector__XXX
 SG_ PLUG_COVER_SENSOR_SIGNAL_LOW : 55|1@1+ (1,0) [0|1] "" Vector__XXX
 SG_ MOTOR_CONNECTION_TEST_FAILED : 56|1@1+ (1,0) [0|1] "" Vector__XXX
 SG_ POWERMODULE_IXT_WARNING : 57|1@1+ (1,0) [0|1] "" Vector__XXX
 SG_ ISOLATION_FAULT : 58|1@1+ (1,0) [0|1] "" Vector__XXX
 SG_ Inverter_A_Statusword_12 : 0|7@1+ (1,0) [0|127] "" Vector__XXX
 SG_ EVENTBUFFER_NEW_EVENT : 16|1@1+ (1,0) [0|1] "" Vector__XXX
 SG_ EVENTBUFFER_OVERFLOW : 17|1@1+ (1,0) [0|1] "" Vector__XXX
 SG_ POWERMODULE_TRIPZONE_OVERCURRE : 18|1@1+ (1,0) [0|1] "" Vector__XXX
 SG_ POWERMODULE_CURRENT_OFFSET_INI : 19|1@1+ (1,0) [0|1] "" Vector__XXX
 SG_ POWERMODULE_TEMPSENSOR_ERROR : 20|1@1+ (1,0) [0|1] "" Vector__XXX
 SG_ POWERMODULE_TEMPERATURE_WARNIN : 21|1@1+ (1,0) [0|1] "" Vector__XXX
 SG_ POWERMODULE_OVERTEMPERATURE : 22|1@1+ (1,0) [0|1] "" Vector__XXX
 SG_ POWERMODULE_IXT_FAULT : 23|1@1+ (1,0) [0|1] "" Vector__XXX
 SG_ POWERMODULE_SW_OVERCURRENT : 24|1@1+ (1,0) [0|1] "" Vector__XXX
 SG_ POWERMODULE_PATTERNDATA_INCONS : 25|1@1+ (1,0) [0|1] "" Vector__XXX
 SG_ DCBUS_TRIPZONE_OVERVOLTAGE : 26|1@1+ (1,0) [0|1] "" Vector__XXX
 SG_ DCBUS_SW_OVERVOLTAGE : 27|1@1+ (1,0) [0|1] "" Vector__XXX
 SG_ DCBUS_SW_UNDERVOLTAGE : 28|1@1+ (1,0) [0|1] "" Vector__XXX
 SG_ NEIGHBOUR_FAULT : 29|1@1+ (1,0) [0|1] "" Vector__XXX
 SG_ MOTOR_TEMPSENSOR_ERROR : 30|1@1+ (1,0) [0|1] "" Vector__XXX
 SG_ MOTOR_TEMPERATURE_WARNING : 31|1@1+ (1,0) [0|1] "" Vector__XXX
 SG_ MOTOR_OVERTEMPERATURE : 32|1@1+ (1,0) [0|1] "" Vector__XXX
 SG_ MOTOR_STATOR_FREQ_TO_HIGH : 33|1@1+ (1,0) [0|1] "" Vector__XXX
 SG_ SUPPLYVOLTAGE_ERROR : 34|1@1+ (1,0) [0|1] "" Vector__XXX
 SG_ RPDO_TIMEOUT : 35|1@1+ (1,0) [0|1] "" Vector__XXX
 SG_ NMT_NOT_OPERATIONAL : 36|1@1+ (1,0) [0|1] "" Vector__XXX
 SG_ TASKOVERRUN : 37|1@1+ (1,0) [0|1] "" Vector__XXX
 SG_ NETSYNC_ERROR : 38|1@1+ (1,0) [0|1] "" Vector__XXX
 SG_ POSDEVICE_SIGNAL_TO_LOW : 39|1@1+ (1,0) [0|1] "" Vector__XXX
 SG_ POSDEVICE_SIGNAL_TO_HIGH : 40|1@1+ (1,0) [0|1] "" Vector__XXX
 SG_ RESOLVER_CALIBRATION_FAILED : 41|1@1+ (1,0) [0|1] "" Vector__XXX
 SG_ SYSTEM_FAULT : 42|1@1+ (1,0) [0|1] "" Vector__XXX
 SG_ INTERLOCK_OPEN : 43|1@1+ (1,0) [0|1] "" Vector__XXX
 SG_ APPC_HAS_GATE_DRIVER_DISABLED : 44|1@1+ (1,0) [0|1] "" Vector__XXX
 SG_ MOTOR_STALL_ERROR : 45|1@1+ (1,0) [0|1] "" Vector__XXX
 SG_ AMBIENT_TEMPERATURE_WARNING : 46|1@1+ (1,0) [0|1] "" Vector__XXX
 SG_ AMBIENT_OVERTEMPERATURE : 47|1@1+ (1,0) [0|1] "" Vector__XXX
 SG_ AMBIENT_TEMPSENSOR_ERROR : 48|1@1+ (1,0) [0|1] "" Vector__XXX
 SG_ POWERMODULE_CLAMPING_TIMEOUT : 49|1@1+ (1,0) [0|1] "" Vector__XXX
 SG_ DCBUS_RIPPLE_TO_HIGH : 50|1@1+ (1,0) [0|1] "" Vector__XXX
 SG_ MOTOR_I2XT_WARNING : 51|1@1+ (1,0) [0|1] "" Vector__XXX
 SG_ MOTOR_I2XT_ERROR : 52|1@1+ (1,0) [0|1] "" Vector__XXX
 SG_ MOTOR_FIELDWEAKENING_ERROR : 53|1@1+ (1,0) [0|1] "" Vector__XXX
 SG_ INVALID_PARAMETER_COMBINATION : 54|1@1+ (1,0) [0|1] "" Vector__XXX
 SG_ PLUG_COVER_SENSOR_SIGNAL_LOW : 55|1@1+ (1,0) [0|1] "" Vector__XXX
 SG_ MOTOR_CONNECTION_TEST_FAILED : 56|1@1+ (1,0) [0|1] "" Vector__XXX
 SG_ POWERMODULE_IXT_WARNING : 57|1@1+ (1,0) [0|1] "" Vector__XXX
 SG_ ISOLATION_FAULT : 58|1@1+ (1,0) [0|1] "" Vector__XXX
 SG_ Inverter_A_Statusword_11 : 0|7@1+ (1,0) [0|127] "" Vector__XXX
 SG_ EVENTBUFFER_NEW_EVENT : 16|1@1+ (1,0) [0|1] "" Vector__XXX
 SG_ EVENTBUFFER_OVERFLOW : 17|1@1+ (1,0) [0|1] "" Vector__XXX
 SG_ POWERMODULE_TRIPZONE_OVERCURRE : 18|1@1+ (1,0) [0|1] "" Vector__XXX
 SG_ POWERMODULE_CURRENT_OFFSET_INI : 19|1@1+ (1,0) [0|1] "" Vector__XXX
 SG_ POWERMODULE_TEMPSENSOR_ERROR : 20|1@1+ (1,0) [0|1] "" Vector__XXX
 SG_ POWERMODULE_TEMPERATURE_WARNIN : 21|1@1+ (1,0) [0|1] "" Vector__XXX
 SG_ POWERMODULE_OVERTEMPERATURE : 22|1@1+ (1,0) [0|1] "" Vector__XXX
 SG_ POWERMODULE_IXT_FAULT : 23|1@1+ (1,0) [0|1] "" Vector__XXX
 SG_ POWERMODULE_SW_OVERCURRENT : 24|1@1+ (1,0) [0|1] "" Vector__XXX
 SG_ POWERMODULE_PATTERNDATA_INCONS : 25|1@1+ (1,0) [0|1] "" Vector__XXX
 SG_ DCBUS_TRIPZONE_OVERVOLTAGE : 26|1@1+ (1,0) [0|1] "" Vector__XXX
 SG_ DCBUS_SW_OVERVOLTAGE : 27|1@1+ (1,0) [0|1] "" Vector__XXX
 SG_ DCBUS_SW_UNDERVOLTAGE : 28|1@1+ (1,0) [0|1] "" Vector__XXX
 SG_ NEIGHBOUR_FAULT : 29|1@1+ (1,0) [0|1] "" Vector__XXX
 SG_ MOTOR_TEMPSENSOR_ERROR : 30|1@1+ (1,0) [0|1] "" Vector__XXX
 SG_ MOTOR_TEMPERATURE_WARNING : 31|1@1+ (1,0) [0|1] "" Vector__XXX
 SG_ MOTOR_OVERTEMPERATURE : 32|1@1+ (1,0) [0|1] "" Vector__XXX
 SG_ MOTOR_STATOR_FREQ_TO_HIGH : 33|1@1+ (1,0) [0|1] "" Vector__XXX
 SG_ SUPPLYVOLTAGE_ERROR : 34|1@1+ (1,0) [0|1] "" Vector__XXX
 SG_ RPDO_TIMEOUT : 35|1@1+ (1,0) [0|1] "" Vector__XXX
 SG_ NMT_NOT_OPERATIONAL : 36|1@1+ (1,0) [0|1] "" Vector__XXX
 SG_ TASKOVERRUN : 37|1@1+ (1,0) [0|1] "" Vector__XXX
 SG_ NETSYNC_ERROR : 38|1@1+ (1,0) [0|1] "" Vector__XXX
 SG_ POSDEVICE_SIGNAL_TO_LOW : 39|1@1+ (1,0) [0|1] "" Vector__XXX
 SG_ POSDEVICE_SIGNAL_TO_HIGH : 40|1@1+ (1,0) [0|1] "" Vector__XXX
 SG_ RESOLVER_CALIBRATION_FAILED : 41|1@1+ (1,0) [0|1] "" Vector__XXX
 SG_ SYSTEM_FAULT : 42|1@1+ (1,0) [0|1] "" Vector__XXX
 SG_ INTERLOCK_OPEN : 43|1@1+ (1,0) [0|1] "" Vector__XXX
 SG_ APPC_HAS_GATE_DRIVER_DISABLED : 44|1@1+ (1,0) [0|1] "" Vector__XXX
 SG_ MOTOR_STALL_ERROR : 45|1@1+ (1,0) [0|1] "" Vector__XXX
 SG_ AMBIENT_TEMPERATURE_WARNING : 46|1@1+ (1,0) [0|1] "" Vector__XXX
 SG_ AMBIENT_OVERTEMPERATURE : 47|1@1+ (1,0) [0|1] "" Vector__XXX
 SG_ AMBIENT_TEMPSENSOR_ERROR : 48|1@1+ (1,0) [0|1] "" Vector__XXX
 SG_ POWERMODULE_CLAMPING_TIMEOUT : 49|1@1+ (1,0) [0|1] "" Vector__XXX
 SG_ DCBUS_RIPPLE_TO_HIGH : 50|1@1+ (1,0) [0|1] "" Vector__XXX
 SG_ MOTOR_I2XT_WARNING : 51|1@1+ (1,0) [0|1] "" Vector__XXX
 SG_ MOTOR_I2XT_ERROR : 52|1@1+ (1,0) [0|1] "" Vector__XXX
 SG_ MOTOR_FIELDWEAKENING_ERROR : 53|1@1+ (1,0) [0|1] "" Vector__XXX
 SG_ INVALID_PARAMETER_COMBINATION : 54|1@1+ (1,0) [0|1] "" Vector__XXX
 SG_ PLUG_COVER_SENSOR_SIGNAL_LOW : 55|1@1+ (1,0) [0|1] "" Vector__XXX
 SG_ MOTOR_CONNECTION_TEST_FAILED : 56|1@1+ (1,0) [0|1] "" Vector__XXX
 SG_ POWERMODULE_IXT_WARNING : 57|1@1+ (1,0) [0|1] "" Vector__XXX
 SG_ ISOLATION_FAULT : 58|1@1+ (1,0) [0|1] "" Vector__XXX
 SG_ Inverter_A_Statusword_10 : 0|7@1+ (1,0) [0|127] "" Vector__XXX
 SG_ EVENTBUFFER_NEW_EVENT : 16|1@1+ (1,0) [0|1] "" Vector__XXX
 SG_ EVENTBUFFER_OVERFLOW : 17|1@1+ (1,0) [0|1] "" Vector__XXX
 SG_ POWERMODULE_TRIPZONE_OVERCURRE : 18|1@1+ (1,0) [0|1] "" Vector__XXX
 SG_ POWERMODULE_CURRENT_OFFSET_INI : 19|1@1+ (1,0) [0|1] "" Vector__XXX
 SG_ POWERMODULE_TEMPSENSOR_ERROR : 20|1@1+ (1,0) [0|1] "" Vector__XXX
 SG_ POWERMODULE_TEMPERATURE_WARNIN : 21|1@1+ (1,0) [0|1] "" Vector__XXX
 SG_ POWERMODULE_OVERTEMPERATURE : 22|1@1+ (1,0) [0|1] "" Vector__XXX
 SG_ POWERMODULE_IXT_FAULT : 23|1@1+ (1,0) [0|1] "" Vector__XXX
 SG_ POWERMODULE_SW_OVERCURRENT : 24|1@1+ (1,0) [0|1] "" Vector__XXX
 SG_ POWERMODULE_PATTERNDATA_INCONS : 25|1@1+ (1,0) [0|1] "" Vector__XXX
 SG_ DCBUS_TRIPZONE_OVERVOLTAGE : 26|1@1+ (1,0) [0|1] "" Vector__XXX
 SG_ DCBUS_SW_OVERVOLTAGE : 27|1@1+ (1,0) [0|1] "" Vector__XXX
 SG_ DCBUS_SW_UNDERVOLTAGE : 28|1@1+ (1,0) [0|1] "" Vector__XXX
 SG_ NEIGHBOUR_FAULT : 29|1@1+ (1,0) [0|1] "" Vector__XXX
 SG_ MOTOR_TEMPSENSOR_ERROR : 30|1@1+ (1,0) [0|1] "" Vector__XXX
 SG_ MOTOR_TEMPERATURE_WARNING : 31|1@1+ (1,0) [0|1] "" Vector__XXX
 SG_ MOTOR_OVERTEMPERATURE : 32|1@1+ (1,0) [0|1] "" Vector__XXX
 SG_ MOTOR_STATOR_FREQ_TO_HIGH : 33|1@1+ (1,0) [0|1] "" Vector__XXX
 SG_ SUPPLYVOLTAGE_ERROR : 34|1@1+ (1,0) [0|1] "" Vector__XXX
 SG_ RPDO_TIMEOUT : 35|1@1+ (1,0) [0|1] "" Vector__XXX
 SG_ NMT_NOT_OPERATIONAL : 36|1@1+ (1,0) [0|1] "" Vector__XXX
 SG_ TASKOVERRUN : 37|1@1+ (1,0) [0|1] "" Vector__XXX
 SG_ NETSYNC_ERROR : 38|1@1+ (1,0) [0|1] "" Vector__XXX
 SG_ POSDEVICE_SIGNAL_TO_LOW : 39|1@1+ (1,0) [0|1] "" Vector__XXX
 SG_ POSDEVICE_SIGNAL_TO_HIGH : 40|1@1+ (1,0) [0|1] "" Vector__XXX
 SG_ RESOLVER_CALIBRATION_FAILED : 41|1@1+ (1,0) [0|1] "" Vector__XXX
 SG_ SYSTEM_FAULT : 42|1@1+ (1,0) [0|1] "" Vector__XXX
 SG_ INTERLOCK_OPEN : 43|1@1+ (1,0) [0|1] "" Vector__XXX
 SG_ APPC_HAS_GATE_DRIVER_DISABLED : 44|1@1+ (1,0) [0|1] "" Vector__XXX
 SG_ MOTOR_STALL_ERROR : 45|1@1+ (1,0) [0|1] "" Vector__XXX
 SG_ AMBIENT_TEMPERATURE_WARNING : 46|1@1+ (1,0) [0|1] "" Vector__XXX
 SG_ AMBIENT_OVERTEMPERATURE : 47|1@1+ (1,0) [0|1] "" Vector__XXX
 SG_ AMBIENT_TEMPSENSOR_ERROR : 48|1@1+ (1,0) [0|1] "" Vector__XXX
 SG_ POWERMODULE_CLAMPING_TIMEOUT : 49|1@1+ (1,0) [0|1] "" Vector__XXX
 SG_ DCBUS_RIPPLE_TO_HIGH : 50|1@1+ (1,0) [0|1] "" Vector__XXX
 SG_ MOTOR_I2XT_WARNING : 51|1@1+ (1,0) [0|1] "" Vector__XXX
 SG_ MOTOR_I2XT_ERROR : 52|1@1+ (1,0) [0|1] "" Vector__XXX
 SG_ MOTOR_FIELDWEAKENING_ERROR : 53|1@1+ (1,0) [0|1] "" Vector__XXX
 SG_ INVALID_PARAMETER_COMBINATION : 54|1@1+ (1,0) [0|1] "" Vector__XXX
 SG_ PLUG_COVER_SENSOR_SIGNAL_LOW : 55|1@1+ (1,0) [0|1] "" Vector__XXX
 SG_ MOTOR_CONNECTION_TEST_FAILED : 56|1@1+ (1,0) [0|1] "" Vector__XXX
 SG_ POWERMODULE_IXT_WARNING : 57|1@1+ (1,0) [0|1] "" Vector__XXX
 SG_ ISOLATION_FAULT : 58|1@1+ (1,0) [0|1] "" Vector__XXX
 SG_ Inverter_A_Statusword_9 : 0|7@1+ (1,0) [0|127] "" Vector__XXX
 SG_ EVENTBUFFER_NEW_EVENT : 16|1@1+ (1,0) [0|1] "" Vector__XXX
 SG_ EVENTBUFFER_OVERFLOW : 17|1@1+ (1,0) [0|1] "" Vector__XXX
 SG_ POWERMODULE_TRIPZONE_OVERCURRE : 18|1@1+ (1,0) [0|1] "" Vector__XXX
 SG_ POWERMODULE_CURRENT_OFFSET_INI : 19|1@1+ (1,0) [0|1] "" Vector__XXX
 SG_ POWERMODULE_TEMPSENSOR_ERROR : 20|1@1+ (1,0) [0|1] "" Vector__XXX
 SG_ POWERMODULE_TEMPERATURE_WARNIN : 21|1@1+ (1,0) [0|1] "" Vector__XXX
 SG_ POWERMODULE_OVERTEMPERATURE : 22|1@1+ (1,0) [0|1] "" Vector__XXX
 SG_ POWERMODULE_IXT_FAULT : 23|1@1+ (1,0) [0|1] "" Vector__XXX
 SG_ POWERMODULE_SW_OVERCURRENT : 24|1@1+ (1,0) [0|1] "" Vector__XXX
 SG_ POWERMODULE_PATTERNDATA_INCONS : 25|1@1+ (1,0) [0|1] "" Vector__XXX
 SG_ DCBUS_TRIPZONE_OVERVOLTAGE : 26|1@1+ (1,0) [0|1] "" Vector__XXX
 SG_ DCBUS_SW_OVERVOLTAGE : 27|1@1+ (1,0) [0|1] "" Vector__XXX
 SG_ DCBUS_SW_UNDERVOLTAGE : 28|1@1+ (1,0) [0|1] "" Vector__XXX
 SG_ NEIGHBOUR_FAULT : 29|1@1+ (1,0) [0|1] "" Vector__XXX
 SG_ MOTOR_TEMPSENSOR_ERROR : 30|1@1+ (1,0) [0|1] "" Vector__XXX
 SG_ MOTOR_TEMPERATURE_WARNING : 31|1@1+ (1,0) [0|1] "" Vector__XXX
 SG_ MOTOR_OVERTEMPERATURE : 32|1@1+ (1,0) [0|1] "" Vector__XXX
 SG_ MOTOR_STATOR_FREQ_TO_HIGH : 33|1@1+ (1,0) [0|1] "" Vector__XXX
 SG_ SUPPLYVOLTAGE_ERROR : 34|1@1+ (1,0) [0|1] "" Vector__XXX
 SG_ RPDO_TIMEOUT : 35|1@1+ (1,0) [0|1] "" Vector__XXX
 SG_ NMT_NOT_OPERATIONAL : 36|1@1+ (1,0) [0|1] "" Vector__XXX
 SG_ TASKOVERRUN : 37|1@1+ (1,0) [0|1] "" Vector__XXX
 SG_ NETSYNC_ERROR : 38|1@1+ (1,0) [0|1] "" Vector__XXX
 SG_ POSDEVICE_SIGNAL_TO_LOW : 39|1@1+ (1,0) [0|1] "" Vector__XXX
 SG_ POSDEVICE_SIGNAL_TO_HIGH : 40|1@1+ (1,0) [0|1] "" Vector__XXX
 SG_ RESOLVER_CALIBRATION_FAILED : 41|1@1+ (1,0) [0|1] "" Vector__XXX
 SG_ SYSTEM_FAULT : 42|1@1+ (1,0) [0|1] "" Vector__XXX
 SG_ INTERLOCK_OPEN : 43|1@1+ (1,0) [0|1] "" Vector__XXX
 SG_ APPC_HAS_GATE_DRIVER_DISABLED : 44|1@1+ (1,0) [0|1] "" Vector__XXX
 SG_ MOTOR_STALL_ERROR : 45|1@1+ (1,0) [0|1] "" Vector__XXX
 SG_ AMBIENT_TEMPERATURE_WARNING : 46|1@1+ (1,0) [0|1] "" Vector__XXX
 SG_ AMBIENT_OVERTEMPERATURE : 47|1@1+ (1,0) [0|1] "" Vector__XXX
 SG_ AMBIENT_TEMPSENSOR_ERROR : 48|1@1+ (1,0) [0|1] "" Vector__XXX
 SG_ POWERMODULE_CLAMPING_TIMEOUT : 49|1@1+ (1,0) [0|1] "" Vector__XXX
 SG_ DCBUS_RIPPLE_TO_HIGH : 50|1@1+ (1,0) [0|1] "" Vector__XXX
 SG_ MOTOR_I2XT_WARNING : 51|1@1+ (1,0) [0|1] "" Vector__XXX
 SG_ MOTOR_I2XT_ERROR : 52|1@1+ (1,0) [0|1] "" Vector__XXX
 SG_ MOTOR_FIELDWEAKENING_ERROR : 53|1@1+ (1,0) [0|1] "" Vector__XXX
 SG_ INVALID_PARAMETER_COMBINATION : 54|1@1+ (1,0) [0|1] "" Vector__XXX
 SG_ PLUG_COVER_SENSOR_SIGNAL_LOW : 55|1@1+ (1,0) [0|1] "" Vector__XXX
 SG_ MOTOR_CONNECTION_TEST_FAILED : 56|1@1+ (1,0) [0|1] "" Vector__XXX
 SG_ POWERMODULE_IXT_WARNING : 57|1@1+ (1,0) [0|1] "" Vector__XXX
 SG_ ISOLATION_FAULT : 58|1@1+ (1,0) [0|1] "" Vector__XXX
 SG_ Inverter_A_Statusword_8 : 0|7@1+ (1,0) [0|127] "" Vector__XXX
 SG_ EVENTBUFFER_NEW_EVENT : 16|1@1+ (1,0) [0|1] "" Vector__XXX
 SG_ EVENTBUFFER_OVERFLOW : 17|1@1+ (1,0) [0|1] "" Vector__XXX
 SG_ POWERMODULE_TRIPZONE_OVERCURRE : 18|1@1+ (1,0) [0|1] "" Vector__XXX
 SG_ POWERMODULE_CURRENT_OFFSET_INI : 19|1@1+ (1,0) [0|1] "" Vector__XXX
 SG_ POWERMODULE_TEMPSENSOR_ERROR : 20|1@1+ (1,0) [0|1] "" Vector__XXX
 SG_ POWERMODULE_TEMPERATURE_WARNIN : 21|1@1+ (1,0) [0|1] "" Vector__XXX
 SG_ POWERMODULE_OVERTEMPERATURE : 22|1@1+ (1,0) [0|1] "" Vector__XXX
 SG_ POWERMODULE_IXT_FAULT : 23|1@1+ (1,0) [0|1] "" Vector__XXX
 SG_ POWERMODULE_SW_OVERCURRENT : 24|1@1+ (1,0) [0|1] "" Vector__XXX
 SG_ POWERMODULE_PATTERNDATA_INCONS : 25|1@1+ (1,0) [0|1] "" Vector__XXX
 SG_ DCBUS_TRIPZONE_OVERVOLTAGE : 26|1@1+ (1,0) [0|1] "" Vector__XXX
 SG_ DCBUS_SW_OVERVOLTAGE : 27|1@1+ (1,0) [0|1] "" Vector__XXX
 SG_ DCBUS_SW_UNDERVOLTAGE : 28|1@1+ (1,0) [0|1] "" Vector__XXX
 SG_ NEIGHBOUR_FAULT : 29|1@1+ (1,0) [0|1] "" Vector__XXX
 SG_ MOTOR_TEMPSENSOR_ERROR : 30|1@1+ (1,0) [0|1] "" Vector__XXX
 SG_ MOTOR_TEMPERATURE_WARNING : 31|1@1+ (1,0) [0|1] "" Vector__XXX
 SG_ MOTOR_OVERTEMPERATURE : 32|1@1+ (1,0) [0|1] "" Vector__XXX
 SG_ MOTOR_STATOR_FREQ_TO_HIGH : 33|1@1+ (1,0) [0|1] "" Vector__XXX
 SG_ SUPPLYVOLTAGE_ERROR : 34|1@1+ (1,0) [0|1] "" Vector__XXX
 SG_ RPDO_TIMEOUT : 35|1@1+ (1,0) [0|1] "" Vector__XXX
 SG_ NMT_NOT_OPERATIONAL : 36|1@1+ (1,0) [0|1] "" Vector__XXX
 SG_ TASKOVERRUN : 37|1@1+ (1,0) [0|1] "" Vector__XXX
 SG_ NETSYNC_ERROR : 38|1@1+ (1,0) [0|1] "" Vector__XXX
 SG_ POSDEVICE_SIGNAL_TO_LOW : 39|1@1+ (1,0) [0|1] "" Vector__XXX
 SG_ POSDEVICE_SIGNAL_TO_HIGH : 40|1@1+ (1,0) [0|1] "" Vector__XXX
 SG_ RESOLVER_CALIBRATION_FAILED : 41|1@1+ (1,0) [0|1] "" Vector__XXX
 SG_ SYSTEM_FAULT : 42|1@1+ (1,0) [0|1] "" Vector__XXX
 SG_ INTERLOCK_OPEN : 43|1@1+ (1,0) [0|1] "" Vector__XXX
 SG_ APPC_HAS_GATE_DRIVER_DISABLED : 44|1@1+ (1,0) [0|1] "" Vector__XXX
 SG_ MOTOR_STALL_ERROR : 45|1@1+ (1,0) [0|1] "" Vector__XXX
 SG_ AMBIENT_TEMPERATURE_WARNING : 46|1@1+ (1,0) [0|1] "" Vector__XXX
 SG_ AMBIENT_OVERTEMPERATURE : 47|1@1+ (1,0) [0|1] "" Vector__XXX
 SG_ AMBIENT_TEMPSENSOR_ERROR : 48|1@1+ (1,0) [0|1] "" Vector__XXX
 SG_ POWERMODULE_CLAMPING_TIMEOUT : 49|1@1+ (1,0) [0|1] "" Vector__XXX
 SG_ DCBUS_RIPPLE_TO_HIGH : 50|1@1+ (1,0) [0|1] "" Vector__XXX
 SG_ MOTOR_I2XT_WARNING : 51|1@1+ (1,0) [0|1] "" Vector__XXX
 SG_ MOTOR_I2XT_ERROR : 52|1@1+ (1,0) [0|1] "" Vector__XXX
 SG_ MOTOR_FIELDWEAKENING_ERROR : 53|1@1+ (1,0) [0|1] "" Vector__XXX
 SG_ INVALID_PARAMETER_COMBINATION : 54|1@1+ (1,0) [0|1] "" Vector__XXX
 SG_ PLUG_COVER_SENSOR_SIGNAL_LOW : 55|1@1+ (1,0) [0|1] "" Vector__XXX
 SG_ MOTOR_CONNECTION_TEST_FAILED : 56|1@1+ (1,0) [0|1] "" Vector__XXX
 SG_ POWERMODULE_IXT_WARNING : 57|1@1+ (1,0) [0|1] "" Vector__XXX
 SG_ ISOLATION_FAULT : 58|1@1+ (1,0) [0|1] "" Vector__XXX
 SG_ Inverter_A_Statusword_7 : 0|7@1+ (1,0) [0|127] "" Vector__XXX
 SG_ EVENTBUFFER_NEW_EVENT : 16|1@1+ (1,0) [0|1] "" Vector__XXX
 SG_ EVENTBUFFER_OVERFLOW : 17|1@1+ (1,0) [0|1] "" Vector__XXX
 SG_ POWERMODULE_TRIPZONE_OVERCURRE : 18|1@1+ (1,0) [0|1] "" Vector__XXX
 SG_ POWERMODULE_CURRENT_OFFSET_INI : 19|1@1+ (1,0) [0|1] "" Vector__XXX
 SG_ POWERMODULE_TEMPSENSOR_ERROR : 20|1@1+ (1,0) [0|1] "" Vector__XXX
 SG_ POWERMODULE_TEMPERATURE_WARNIN : 21|1@1+ (1,0) [0|1] "" Vector__XXX
 SG_ POWERMODULE_OVERTEMPERATURE : 22|1@1+ (1,0) [0|1] "" Vector__XXX
 SG_ POWERMODULE_IXT_FAULT : 23|1@1+ (1,0) [0|1] "" Vector__XXX
 SG_ POWERMODULE_SW_OVERCURRENT : 24|1@1+ (1,0) [0|1] "" Vector__XXX
 SG_ POWERMODULE_PATTERNDATA_INCONS : 25|1@1+ (1,0) [0|1] "" Vector__XXX
 SG_ DCBUS_TRIPZONE_OVERVOLTAGE : 26|1@1+ (1,0) [0|1] "" Vector__XXX
 SG_ DCBUS_SW_OVERVOLTAGE : 27|1@1+ (1,0) [0|1] "" Vector__XXX
 SG_ DCBUS_SW_UNDERVOLTAGE : 28|1@1+ (1,0) [0|1] "" Vector__XXX
 SG_ NEIGHBOUR_FAULT : 29|1@1+ (1,0) [0|1] "" Vector__XXX
 SG_ MOTOR_TEMPSENSOR_ERROR : 30|1@1+ (1,0) [0|1] "" Vector__XXX
 SG_ MOTOR_TEMPERATURE_WARNING : 31|1@1+ (1,0) [0|1] "" Vector__XXX
 SG_ MOTOR_OVERTEMPERATURE : 32|1@1+ (1,0) [0|1] "" Vector__XXX
 SG_ MOTOR_STATOR_FREQ_TO_HIGH : 33|1@1+ (1,0) [0|1] "" Vector__XXX
 SG_ SUPPLYVOLTAGE_ERROR : 34|1@1+ (1,0) [0|1] "" Vector__XXX
 SG_ RPDO_TIMEOUT : 35|1@1+ (1,0) [0|1] "" Vector__XXX
 SG_ NMT_NOT_OPERATIONAL : 36|1@1+ (1,0) [0|1] "" Vector__XXX
 SG_ TASKOVERRUN : 37|1@1+ (1,0) [0|1] "" Vector__XXX
 SG_ NETSYNC_ERROR : 38|1@1+ (1,0) [0|1] "" Vector__XXX
 SG_ POSDEVICE_SIGNAL_TO_LOW : 39|1@1+ (1,0) [0|1] "" Vector__XXX
 SG_ POSDEVICE_SIGNAL_TO_HIGH : 40|1@1+ (1,0) [0|1] "" Vector__XXX
 SG_ RESOLVER_CALIBRATION_FAILED : 41|1@1+ (1,0) [0|1] "" Vector__XXX
 SG_ SYSTEM_FAULT : 42|1@1+ (1,0) [0|1] "" Vector__XXX
 SG_ INTERLOCK_OPEN : 43|1@1+ (1,0) [0|1] "" Vector__XXX
 SG_ APPC_HAS_GATE_DRIVER_DISABLED : 44|1@1+ (1,0) [0|1] "" Vector__XXX
 SG_ MOTOR_STALL_ERROR : 45|1@1+ (1,0) [0|1] "" Vector__XXX
 SG_ AMBIENT_TEMPERATURE_WARNING : 46|1@1+ (1,0) [0|1] "" Vector__XXX
 SG_ AMBIENT_OVERTEMPERATURE : 47|1@1+ (1,0) [0|1] "" Vector__XXX
 SG_ AMBIENT_TEMPSENSOR_ERROR : 48|1@1+ (1,0) [0|1] "" Vector__XXX
 SG_ POWERMODULE_CLAMPING_TIMEOUT : 49|1@1+ (1,0) [0|1] "" Vector__XXX
 SG_ DCBUS_RIPPLE_TO_HIGH : 50|1@1+ (1,0) [0|1] "" Vector__XXX
 SG_ MOTOR_I2XT_WARNING : 51|1@1+ (1,0) [0|1] "" Vector__XXX
 SG_ MOTOR_I2XT_ERROR : 52|1@1+ (1,0) [0|1] "" Vector__XXX
 SG_ MOTOR_FIELDWEAKENING_ERROR : 53|1@1+ (1,0) [0|1] "" Vector__XXX
 SG_ INVALID_PARAMETER_COMBINATION : 54|1@1+ (1,0) [0|1] "" Vector__XXX
 SG_ PLUG_COVER_SENSOR_SIGNAL_LOW : 55|1@1+ (1,0) [0|1] "" Vector__XXX
 SG_ MOTOR_CONNECTION_TEST_FAILED : 56|1@1+ (1,0) [0|1] "" Vector__XXX
 SG_ POWERMODULE_IXT_WARNING : 57|1@1+ (1,0) [0|1] "" Vector__XXX
 SG_ ISOLATION_FAULT : 58|1@1+ (1,0) [0|1] "" Vector__XXX
 SG_ Motor_A_act_velocity_5 : 0|32@1- (6.103515625e-05,0) [-131072|131071.99994] "rpm" Vector__XXX
 SG_ Motor_A_act_torque_5 : 32|16@1- (0.1,0) [-3276.8|3276.7] "%" Vector__XXX
 SG_ Motor_A_act_current_5 : 48|16@1- (0.015625,0) [-512|511.984375] "A" Vector__XXX
 SG_ Motor_A_act_velocity_4 : 0|32@1- (6.103515625e-05,0) [-131072|131071.99994] "rpm" Vector__XXX
 SG_ Motor_A_act_torque_4 : 32|16@1- (0.1,0) [-3276.8|3276.7] "%" Vector__XXX
 SG_ Motor_A_act_current_4 : 48|16@1- (0.015625,0) [-512|511.984375] "A" Vector__XXX
 SG_ Motor_A_act_velocity_3 : 0|32@1- (6.103515625e-05,0) [-131072|131071.99994] "rpm" Vector__XXX
 SG_ Motor_A_act_torque_3 : 32|16@1- (0.1,0) [-3276.8|3276.7] "%" Vector__XXX
 SG_ Motor_A_act_current_3 : 48|16@1- (0.015625,0) [-512|511.984375] "A" Vector__XXX
 SG_ Motor_A_act_velocity_2 : 0|32@1- (6.103515625e-05,0) [-131072|131071.99994] "rpm" Vector__XXX
 SG_ Motor_A_act_torque_2 : 32|16@1- (0.1,0) [-3276.8|3276.7] "%" Vector__XXX
 SG_ Motor_A_act_current_2 : 48|16@1- (0.015625,0) [-512|511.984375] "A" Vector__XXX
 SG_ Motor_A_act_velocity_1 : 0|32@1- (6.103515625e-05,0) [-131072|131071.99994] "rpm" Vector__XXX
 SG_ Motor_A_act_torque_1 : 32|16@1- (0.1,0) [-3276.8|3276.7] "%" Vector__XXX
 SG_ Motor_A_act_current_1 : 48|16@1- (0.015625,0) [-512|511.984375] "A" Vector__XXX
 SG_ Motor_A_act_velocity_13 : 0|32@1- (6.103515625e-05,0) [-131072|131071.99994] "rpm" Vector__XXX
 SG_ Motor_A_act_torque_13 : 32|16@1- (0.1,0) [-3276.8|3276.7] "%" Vector__XXX
 SG_ Motor_A_act_current_13 : 48|16@1- (0.015625,0) [-512|511.984375] "A" Vector__XXX
 SG_ Motor_A_act_velocity_12 : 0|32@1- (6.103515625e-05,0) [-131072|131071.99994] "rpm" Vector__XXX
 SG_ Motor_A_act_torque_12 : 32|16@1- (0.1,0) [-3276.8|3276.7] "%" Vector__XXX
 SG_ Motor_A_act_current_12 : 48|16@1- (0.015625,0) [-512|511.984375] "A" Vector__XXX
 SG_ Motor_A_act_velocity_11 : 0|32@1- (6.103515625e-05,0) [-131072|131071.99994] "rpm" Vector__XXX
 SG_ Motor_A_act_torque_11 : 32|16@1- (0.1,0) [-3276.8|3276.7] "%" Vector__XXX
 SG_ Motor_A_act_current_11 : 48|16@1- (0.015625,0) [-512|511.984375] "A" Vector__XXX
 SG_ Motor_A_act_velocity_10 : 0|32@1- (6.103515625e-05,0) [-131072|131071.99994] "rpm" Vector__XXX
 SG_ Motor_A_act_torque_10 : 32|16@1- (0.1,0) [-3276.8|3276.7] "%" Vector__XXX
 SG_ Motor_A_act_current_10 : 48|16@1- (0.015625,0) [-512|511.984375] "A" Vector__XXX
 SG_ Motor_A_act_velocity_9 : 0|32@1- (6.103515625e-05,0) [-131072|131071.99994] "rpm" Vector__XXX
 SG_ Motor_A_act_torque_9 : 32|16@1- (0.1,0) [-3276.8|3276.7] "%" Vector__XXX
 SG_ Motor_A_act_current_9 : 48|16@1- (0.015625,0) [-512|511.984375] "A" Vector__XXX
 SG_ Motor_A_act_velocity_8 : 0|32@1- (6.103515625e-05,0) [-131072|131071.99994] "rpm" Vector__XXX
 SG_ Motor_A_act_torque_8 : 32|16@1- (0.1,0) [-3276.8|3276.7] "%" Vector__XXX
 SG_ Motor_A_act_current_8 : 48|16@1- (0.015625,0) [-512|511.984375] "A" Vector__XXX
 SG_ Motor_A_act_velocity_7 : 0|32@1- (6.103515625e-05,0) [-131072|131071.99994] "rpm" Vector__XXX
 SG_ Motor_A_act_torque_7 : 32|16@1- (0.1,0) [-3276.8|3276.7] "%" Vector__XXX
 SG_ Motor_A_act_current_7 : 48|16@1- (0.015625,0) [-512|511.984375] "A" Vector__XXX
 SG_ Motor_A_act_temp_5 : 0|16@1- (0.0625,0) [-2048|2047.9375] "�C" Vector__XXX
 SG_ Motor_A_act_power_5 : 16|16@1- (0.016,0) [-524.288|524.272] "kW" Vector__XXX
 SG_ Motor_A_act_voltage_5 : 32|16@1- (0.0625,0) [-2048|2047.9375] "V" Vector__XXX
 SG_ Inverter_A_act_module_temp_5 : 48|16@1- (0.0625,0) [-2048|2047.9375] "�C" Vector__XXX
 SG_ Motor_A_act_temp_4 : 0|16@1- (0.0625,0) [-2048|2047.9375] "�C" Vector__XXX
 SG_ Motor_A_act_power_4 : 16|16@1- (0.016,0) [-524.288|524.272] "kW" Vector__XXX
 SG_ Motor_A_act_voltage_4 : 32|16@1- (0.0625,0) [-2048|2047.9375] "V" Vector__XXX
 SG_ Inverter_A_act_module_temp_4 : 48|16@1- (0.0625,0) [-2048|2047.9375] "�C" Vector__XXX
 SG_ Motor_A_act_temp_3 : 0|16@1- (0.0625,0) [-2048|2047.9375] "�C" Vector__XXX
 SG_ Motor_A_act_power_3 : 16|16@1- (0.016,0) [-524.288|524.272] "kW" Vector__XXX
 SG_ Motor_A_act_voltage_3 : 32|16@1- (0.0625,0) [-2048|2047.9375] "V" Vector__XXX
 SG_ Inverter_A_act_module_temp_3 : 48|16@1- (0.0625,0) [-2048|2047.9375] "�C" Vector__XXX
 SG_ Motor_A_act_temp_2 : 0|16@1- (0.0625,0) [-2048|2047.9375] "�C" Vector__XXX
 SG_ Motor_A_act_power_2 : 16|16@1- (0.016,0) [-524.288|524.272] "kW" Vector__XXX
 SG_ Motor_A_act_voltage_2 : 32|16@1- (0.0625,0) [-2048|2047.9375] "V" Vector__XXX
 SG_ Inverter_A_act_module_temp_2 : 48|16@1- (0.0625,0) [-2048|2047.9375] "�C" Vector__XXX
 SG_ Motor_A_act_temp_1 : 0|16@1- (0.0625,0) [-2048|2047.9375] "�C" Vector__XXX
 SG_ Motor_A_act_power_1 : 16|16@1- (0.016,0) [-524.288|524.272] "kW" Vector__XXX
 SG_ Motor_A_act_voltage_1 : 32|16@1- (0.0625,0) [-2048|2047.9375] "V" Vector__XXX
 SG_ Inverter_A_act_module_temp_1 : 48|16@1- (0.0625,0) [-2048|2047.9375] "�C" Vector__XXX
 SG_ Motor_A_act_temp_13 : 0|16@1- (0.0625,0) [-2048|2047.9375] "�C" Vector__XXX
 SG_ Motor_A_act_power_13 : 16|16@1- (0.016,0) [-524.288|524.272] "kW" Vector__XXX
 SG_ Motor_A_act_voltage_13 : 32|16@1- (0.0625,0) [-2048|2047.9375] "V" Vector__XXX
 SG_ Inverter_A_act_module_temp_13 : 48|16@1- (0.0625,0) [-2048|2047.9375] "�C" Vector__XXX
 SG_ Motor_A_act_temp_12 : 0|16@1- (0.0625,0) [-2048|2047.9375] "�C" Vector__XXX
 SG_ Motor_A_act_power_12 : 16|16@1- (0.016,0) [-524.288|524.272] "kW" Vector__XXX
 SG_ Motor_A_act_voltage_12 : 32|16@1- (0.0625,0) [-2048|2047.9375] "V" Vector__XXX
 SG_ Inverter_A_act_module_temp_12 : 48|16@1- (0.0625,0) [-2048|2047.9375] "�C" Vector__XXX
 SG_ Motor_A_act_temp_11 : 0|16@1- (0.0625,0) [-2048|2047.9375] "�C" Vector__XXX
 SG_ Motor_A_act_power_11 : 16|16@1- (0.016,0) [-524.288|524.272] "kW" Vector__XXX
 SG_ Motor_A_act_voltage_11 : 32|16@1- (0.0625,0) [-2048|2047.9375] "V" Vector__XXX
 SG_ Inverter_A_act_module_temp_11 : 48|16@1- (0.0625,0) [-2048|2047.9375] "�C" Vector__XXX
 SG_ Motor_A_act_temp_10 : 0|16@1- (0.0625,0) [-2048|2047.9375] "�C" Vector__XXX
 SG_ Motor_A_act_power_10 : 16|16@1- (0.016,0) [-524.288|524.272] "kW" Vector__XXX
 SG_ Motor_A_act_voltage_10 : 32|16@1- (0.0625,0) [-2048|2047.9375] "V" Vector__XXX
 SG_ Inverter_A_act_module_temp_10 : 48|16@1- (0.0625,0) [-2048|2047.9375] "�C" Vector__XXX
 SG_ Motor_A_act_temp_9 : 0|16@1- (0.0625,0) [-2048|2047.9375] "�C" Vector__XXX
 SG_ Motor_A_act_power_9 : 16|16@1- (0.016,0) [-524.288|524.272] "kW" Vector__XXX
 SG_ Motor_A_act_voltage_9 : 32|16@1- (0.0625,0) [-2048|2047.9375] "V" Vector__XXX
 SG_ Inverter_A_act_module_temp_9 : 48|16@1- (0.0625,0) [-2048|2047.9375] "�C" Vector__XXX
 SG_ Motor_A_act_temp_8 : 0|16@1- (0.0625,0) [-2048|2047.9375] "�C" Vector__XXX
 SG_ Motor_A_act_power_8 : 16|16@1- (0.016,0) [-524.288|524.272] "kW" Vector__XXX
 SG_ Motor_A_act_voltage_8 : 32|16@1- (0.0625,0) [-2048|2047.9375] "V" Vector__XXX
 SG_ Inverter_A_act_module_temp_8 : 48|16@1- (0.0625,0) [-2048|2047.9375] "�C" Vector__XXX
 SG_ Motor_A_act_temp_7 : 0|16@1- (0.0625,0) [-2048|2047.9375] "�C" Vector__XXX
 SG_ Motor_A_act_power_7 : 16|16@1- (0.016,0) [-524.288|524.272] "kW" Vector__XXX
 SG_ Motor_A_act_voltage_7 : 32|16@1- (0.0625,0) [-2048|2047.9375] "V" Vector__XXX
 SG_ Inverter_A_act_module_temp_7 : 48|16@1- (0.0625,0) [-2048|2047.9375] "�C" Vector__XXX
 SG_ Inverter_B_Statusword_5 : 0|7@1+ (1,0) [0|127] "" Vector__XXX
 SG_ EVENTBUFFER_NEW_EVENT : 16|1@1+ (1,0) [0|1] "" Vector__XXX
 SG_ EVENTBUFFER_OVERFLOW : 17|1@1+ (1,0) [0|1] "" Vector__XXX
 SG_ POWERMODULE_TRIPZONE_OVERCURRE : 18|1@1+ (1,0) [0|1] "" Vector__XXX
 SG_ POWERMODULE_CURRENT_OFFSET_INI : 19|1@1+ (1,0) [0|1] "" Vector__XXX
 SG_ POWERMODULE_TEMPSENSOR_ERROR : 20|1@1+ (1,0) [0|1] "" Vector__XXX
 SG_ POWERMODULE_TEMPERATURE_WARNIN : 21|1@1+ (1,0) [0|1] "" Vector__XXX
 SG_ POWERMODULE_OVERTEMPERATURE : 22|1@1+ (1,0) [0|1] "" Vector__XXX
 SG_ POWERMODULE_IXT_FAULT : 23|1@1+ (1,0) [0|1] "" Vector__XXX
 SG_ POWERMODULE_SW_OVERCURRENT : 24|1@1+ (1,0) [0|1] "" Vector__XXX
 SG_ POWERMODULE_PATTERNDATA_INCONS : 25|1@1+ (1,0) [0|1] "" Vector__XXX
 SG_ DCBUS_TRIPZONE_OVERVOLTAGE : 26|1@1+ (1,0) [0|1] "" Vector__XXX
 SG_ DCBUS_SW_OVERVOLTAGE : 27|1@1+ (1,0) [0|1] "" Vector__XXX
 SG_ DCBUS_SW_UNDERVOLTAGE : 28|1@1+ (1,0) [0|1] "" Vector__XXX
 SG_ NEIGHBOUR_FAULT : 29|1@1+ (1,0) [0|1] "" Vector__XXX
 SG_ MOTOR_TEMPSENSOR_ERROR : 30|1@1+ (1,0) [0|1] "" Vector__XXX
 SG_ MOTOR_TEMPERATURE_WARNING : 31|1@1+ (1,0) [0|1] "" Vector__XXX
 SG_ MOTOR_OVERTEMPERATURE : 32|1@1+ (1,0) [0|1] "" Vector__XXX
 SG_ MOTOR_STATOR_FREQ_TO_HIGH : 33|1@1+ (1,0) [0|1] "" Vector__XXX
 SG_ SUPPLYVOLTAGE_ERROR : 34|1@1+ (1,0) [0|1] "" Vector__XXX
 SG_ RPDO_TIMEOUT : 35|1@1+ (1,0) [0|1] "" Vector__XXX
 SG_ NMT_NOT_OPERATIONAL : 36|1@1+ (1,0) [0|1] "" Vector__XXX
 SG_ TASKOVERRUN : 37|1@1+ (1,0) [0|1] "" Vector__XXX
 SG_ NETSYNC_ERROR : 38|1@1+ (1,0) [0|1] "" Vector__XXX
 SG_ POSDEVICE_SIGNAL_TO_LOW : 39|1@1+ (1,0) [0|1] "" Vector__XXX
 SG_ POSDEVICE_SIGNAL_TO_HIGH : 40|1@1+ (1,0) [0|1] "" Vector__XXX
 SG_ RESOLVER_CALIBRATION_FAILED : 41|1@1+ (1,0) [0|1] "" Vector__XXX
 SG_ SYSTEM_FAULT : 42|1@1+ (1,0) [0|1] "" Vector__XXX
 SG_ INTERLOCK_OPEN : 43|1@1+ (1,0) [0|1] "" Vector__XXX
 SG_ APPC_HAS_GATE_DRIVER_DISABLED : 44|1@1+ (1,0) [0|1] "" Vector__XXX
 SG_ MOTOR_STALL_ERROR : 45|1@1+ (1,0) [0|1] "" Vector__XXX
 SG_ AMBIENT_TEMPERATURE_WARNING : 46|1@1+ (1,0) [0|1] "" Vector__XXX
 SG_ AMBIENT_OVERTEMPERATURE : 47|1@1+ (1,0) [0|1] "" Vector__XXX
 SG_ AMBIENT_TEMPSENSOR_ERROR : 48|1@1+ (1,0) [0|1] "" Vector__XXX
 SG_ POWERMODULE_CLAMPING_TIMEOUT : 49|1@1+ (1,0) [0|1] "" Vector__XXX
 SG_ DCBUS_RIPPLE_TO_HIGH : 50|1@1+ (1,0) [0|1] "" Vector__XXX
 SG_ MOTOR_I2XT_WARNING : 51|1@1+ (1,0) [0|1] "" Vector__XXX
 SG_ MOTOR_I2XT_ERROR : 52|1@1+ (1,0) [0|1] "" Vector__XXX
 SG_ MOTOR_FIELDWEAKENING_ERROR : 53|1@1+ (1,0) [0|1] "" Vector__XXX
 SG_ INVALID_PARAMETER_COMBINATION : 54|1@1+ (1,0) [0|1] "" Vector__XXX
 SG_ PLUG_COVER_SENSOR_SIGNAL_LOW : 55|1@1+ (1,0) [0|1] "" Vector__XXX
 SG_ MOTOR_CONNECTION_TEST_FAILED : 56|1@1+ (1,0) [0|1] "" Vector__XXX
 SG_ POWERMODULE_IXT_WARNING : 57|1@1+ (1,0) [0|1] "" Vector__XXX
 SG_ ISOLATION_FAULT : 58|1@1+ (1,0) [0|1] "" Vector__XXX
 SG_ Inverter_B_Statusword_4 : 0|7@1+ (1,0) [0|127] "" Vector__XXX
 SG_ EVENTBUFFER_NEW_EVENT : 16|1@1+ (1,0) [0|1] "" Vector__XXX
 SG_ EVENTBUFFER_OVERFLOW : 17|1@1+ (1,0) [0|1] "" Vector__XXX
 SG_ POWERMODULE_TRIPZONE_OVERCURRE : 18|1@1+ (1,0) [0|1] "" Vector__XXX
 SG_ POWERMODULE_CURRENT_OFFSET_INI : 19|1@1+ (1,0) [0|1] "" Vector__XXX
 SG_ POWERMODULE_TEMPSENSOR_ERROR : 20|1@1+ (1,0) [0|1] "" Vector__XXX
 SG_ POWERMODULE_TEMPERATURE_WARNIN : 21|1@1+ (1,0) [0|1] "" Vector__XXX
 SG_ POWERMODULE_OVERTEMPERATURE : 22|1@1+ (1,0) [0|1] "" Vector__XXX
 SG_ POWERMODULE_IXT_FAULT : 23|1@1+ (1,0) [0|1] "" Vector__XXX
 SG_ POWERMODULE_SW_OVERCURRENT : 24|1@1+ (1,0) [0|1] "" Vector__XXX
 SG_ POWERMODULE_PATTERNDATA_INCONS : 25|1@1+ (1,0) [0|1] "" Vector__XXX
 SG_ DCBUS_TRIPZONE_OVERVOLTAGE : 26|1@1+ (1,0) [0|1] "" Vector__XXX
 SG_ DCBUS_SW_OVERVOLTAGE : 27|1@1+ (1,0) [0|1] "" Vector__XXX
 SG_ DCBUS_SW_UNDERVOLTAGE : 28|1@1+ (1,0) [0|1] "" Vector__XXX
 SG_ NEIGHBOUR_FAULT : 29|1@1+ (1,0) [0|1] "" Vector__XXX
 SG_ MOTOR_TEMPSENSOR_ERROR : 30|1@1+ (1,0) [0|1] "" Vector__XXX
 SG_ MOTOR_TEMPERATURE_WARNING : 31|1@1+ (1,0) [0|1] "" Vector__XXX
 SG_ MOTOR_OVERTEMPERATURE : 32|1@1+ (1,0) [0|1] "" Vector__XXX
 SG_ MOTOR_STATOR_FREQ_TO_HIGH : 33|1@1+ (1,0) [0|1] "" Vector__XXX
 SG_ SUPPLYVOLTAGE_ERROR : 34|1@1+ (1,0) [0|1] "" Vector__XXX
 SG_ RPDO_TIMEOUT : 35|1@1+ (1,0) [0|1] "" Vector__XXX
 SG_ NMT_NOT_OPERATIONAL : 36|1@1+ (1,0) [0|1] "" Vector__XXX
 SG_ TASKOVERRUN : 37|1@1+ (1,0) [0|1] "" Vector__XXX
 SG_ NETSYNC_ERROR : 38|1@1+ (1,0) [0|1] "" Vector__XXX
 SG_ POSDEVICE_SIGNAL_TO_LOW : 39|1@1+ (1,0) [0|1] "" Vector__XXX
 SG_ POSDEVICE_SIGNAL_TO_HIGH : 40|1@1+ (1,0) [0|1] "" Vector__XXX
 SG_ RESOLVER_CALIBRATION_FAILED : 41|1@1+ (1,0) [0|1] "" Vector__XXX
 SG_ SYSTEM_FAULT : 42|1@1+ (1,0) [0|1] "" Vector__XXX
 SG_ INTERLOCK_OPEN : 43|1@1+ (1,0) [0|1] "" Vector__XXX
 SG_ APPC_HAS_GATE_DRIVER_DISABLED : 44|1@1+ (1,0) [0|1] "" Vector__XXX
 SG_ MOTOR_STALL_ERROR : 45|1@1+ (1,0) [0|1] "" Vector__XXX
 SG_ AMBIENT_TEMPERATURE_WARNING : 46|1@1+ (1,0) [0|1] "" Vector__XXX
 SG_ AMBIENT_OVERTEMPERATURE : 47|1@1+ (1,0) [0|1] "" Vector__XXX
 SG_ AMBIENT_TEMPSENSOR_ERROR : 48|1@1+ (1,0) [0|1] "" Vector__XXX
 SG_ POWERMODULE_CLAMPING_TIMEOUT : 49|1@1+ (1,0) [0|1] "" Vector__XXX
 SG_ DCBUS_RIPPLE_TO_HIGH : 50|1@1+ (1,0) [0|1] "" Vector__XXX
 SG_ MOTOR_I2XT_WARNING : 51|1@1+ (1,0) [0|1] "" Vector__XXX
 SG_ MOTOR_I2XT_ERROR : 52|1@1+ (1,0) [0|1] "" Vector__XXX
 SG_ MOTOR_FIELDWEAKENING_ERROR : 53|1@1+ (1,0) [0|1] "" Vector__XXX
 SG_ INVALID_PARAMETER_COMBINATION : 54|1@1+ (1,0) [0|1] "" Vector__XXX
 SG_ PLUG_COVER_SENSOR_SIGNAL_LOW : 55|1@1+ (1,0) [0|1] "" Vector__XXX
 SG_ MOTOR_CONNECTION_TEST_FAILED : 56|1@1+ (1,0) [0|1] "" Vector__XXX
 SG_ POWERMODULE_IXT_WARNING : 57|1@1+ (1,0) [0|1] "" Vector__XXX
 SG_ ISOLATION_FAULT : 58|1@1+ (1,0) [0|1] "" Vector__XXX
 SG_ Inverter_B_Statusword_3 : 0|7@1+ (1,0) [0|127] "" Vector__XXX
 SG_ EVENTBUFFER_NEW_EVENT : 16|1@1+ (1,0) [0|1] "" Vector__XXX
 SG_ EVENTBUFFER_OVERFLOW : 17|1@1+ (1,0) [0|1] "" Vector__XXX
 SG_ POWERMODULE_TRIPZONE_OVERCURRE : 18|1@1+ (1,0) [0|1] "" Vector__XXX
 SG_ POWERMODULE_CURRENT_OFFSET_INI : 19|1@1+ (1,0) [0|1] "" Vector__XXX
 SG_ POWERMODULE_TEMPSENSOR_ERROR : 20|1@1+ (1,0) [0|1] "" Vector__XXX
 SG_ POWERMODULE_TEMPERATURE_WARNIN : 21|1@1+ (1,0) [0|1] "" Vector__XXX
 SG_ POWERMODULE_OVERTEMPERATURE : 22|1@1+ (1,0) [0|1] "" Vector__XXX
 SG_ POWERMODULE_IXT_FAULT : 23|1@1+ (1,0) [0|1] "" Vector__XXX
 SG_ POWERMODULE_SW_OVERCURRENT : 24|1@1+ (1,0) [0|1] "" Vector__XXX
 SG_ POWERMODULE_PATTERNDATA_INCONS : 25|1@1+ (1,0) [0|1] "" Vector__XXX
 SG_ DCBUS_TRIPZONE_OVERVOLTAGE : 26|1@1+ (1,0) [0|1] "" Vector__XXX
 SG_ DCBUS_SW_OVERVOLTAGE : 27|1@1+ (1,0) [0|1] "" Vector__XXX
 SG_ DCBUS_SW_UNDERVOLTAGE : 28|1@1+ (1,0) [0|1] "" Vector__XXX
 SG_ NEIGHBOUR_FAULT : 29|1@1+ (1,0) [0|1] "" Vector__XXX
 SG_ MOTOR_TEMPSENSOR_ERROR : 30|1@1+ (1,0) [0|1] "" Vector__XXX
 SG_ MOTOR_TEMPERATURE_WARNING : 31|1@1+ (1,0) [0|1] "" Vector__XXX
 SG_ MOTOR_OVERTEMPERATURE : 32|1@1+ (1,0) [0|1] "" Vector__XXX
 SG_ MOTOR_STATOR_FREQ_TO_HIGH : 33|1@1+ (1,0) [0|1] "" Vector__XXX
 SG_ SUPPLYVOLTAGE_ERROR : 34|1@1+ (1,0) [0|1] "" Vector__XXX
 SG_ RPDO_TIMEOUT : 35|1@1+ (1,0) [0|1] "" Vector__XXX
 SG_ NMT_NOT_OPERATIONAL : 36|1@1+ (1,0) [0|1] "" Vector__XXX
 SG_ TASKOVERRUN : 37|1@1+ (1,0) [0|1] "" Vector__XXX
 SG_ NETSYNC_ERROR : 38|1@1+ (1,0) [0|1] "" Vector__XXX
 SG_ POSDEVICE_SIGNAL_TO_LOW : 39|1@1+ (1,0) [0|1] "" Vector__XXX
 SG_ POSDEVICE_SIGNAL_TO_HIGH : 40|1@1+ (1,0) [0|1] "" Vector__XXX
 SG_ RESOLVER_CALIBRATION_FAILED : 41|1@1+ (1,0) [0|1] "" Vector__XXX
 SG_ SYSTEM_FAULT : 42|1@1+ (1,0) [0|1] "" Vector__XXX
 SG_ INTERLOCK_OPEN : 43|1@1+ (1,0) [0|1] "" Vector__XXX
 SG_ APPC_HAS_GATE_DRIVER_DISABLED : 44|1@1+ (1,0) [0|1] "" Vector__XXX
 SG_ MOTOR_STALL_ERROR : 45|1@1+ (1,0) [0|1] "" Vector__XXX
 SG_ AMBIENT_TEMPERATURE_WARNING : 46|1@1+ (1,0) [0|1] "" Vector__XXX
 SG_ AMBIENT_OVERTEMPERATURE : 47|1@1+ (1,0) [0|1] "" Vector__XXX
 SG_ AMBIENT_TEMPSENSOR_ERROR : 48|1@1+ (1,0) [0|1] "" Vector__XXX
 SG_ POWERMODULE_CLAMPING_TIMEOUT : 49|1@1+ (1,0) [0|1] "" Vector__XXX
 SG_ DCBUS_RIPPLE_TO_HIGH : 50|1@1+ (1,0) [0|1] "" Vector__XXX
 SG_ MOTOR_I2XT_WARNING : 51|1@1+ (1,0) [0|1] "" Vector__XXX
 SG_ MOTOR_I2XT_ERROR : 52|1@1+ (1,0) [0|1] "" Vector__XXX
 SG_ MOTOR_FIELDWEAKENING_ERROR : 53|1@1+ (1,0) [0|1] "" Vector__XXX
 SG_ INVALID_PARAMETER_COMBINATION : 54|1@1+ (1,0) [0|1] "" Vector__XXX
 SG_ PLUG_COVER_SENSOR_SIGNAL_LOW : 55|1@1+ (1,0) [0|1] "" Vector__XXX
 SG_ MOTOR_CONNECTION_TEST_FAILED : 56|1@1+ (1,0) [0|1] "" Vector__XXX
 SG_ POWERMODULE_IXT_WARNING : 57|1@1+ (1,0) [0|1] "" Vector__XXX
 SG_ ISOLATION_FAULT : 58|1@1+ (1,0) [0|1] "" Vector__XXX
 SG_ Inverter_B_Statusword_2 : 0|7@1+ (1,0) [0|127] "" Vector__XXX
 SG_ EVENTBUFFER_NEW_EVENT : 16|1@1+ (1,0) [0|1] "" Vector__XXX
 SG_ EVENTBUFFER_OVERFLOW : 17|1@1+ (1,0) [0|1] "" Vector__XXX
 SG_ POWERMODULE_TRIPZONE_OVERCURRE : 18|1@1+ (1,0) [0|1] "" Vector__XXX
 SG_ POWERMODULE_CURRENT_OFFSET_INI : 19|1@1+ (1,0) [0|1] "" Vector__XXX
 SG_ POWERMODULE_TEMPSENSOR_ERROR : 20|1@1+ (1,0) [0|1] "" Vector__XXX
 SG_ POWERMODULE_TEMPERATURE_WARNIN : 21|1@1+ (1,0) [0|1] "" Vector__XXX
 SG_ POWERMODULE_OVERTEMPERATURE : 22|1@1+ (1,0) [0|1] "" Vector__XXX
 SG_ POWERMODULE_IXT_FAULT : 23|1@1+ (1,0) [0|1] "" Vector__XXX
 SG_ POWERMODULE_SW_OVERCURRENT : 24|1@1+ (1,0) [0|1] "" Vector__XXX
 SG_ POWERMODULE_PATTERNDATA_INCONS : 25|1@1+ (1,0) [0|1] "" Vector__XXX
 SG_ DCBUS_TRIPZONE_OVERVOLTAGE : 26|1@1+ (1,0) [0|1] "" Vector__XXX
 SG_ DCBUS_SW_OVERVOLTAGE : 27|1@1+ (1,0) [0|1] "" Vector__XXX
 SG_ DCBUS_SW_UNDERVOLTAGE : 28|1@1+ (1,0) [0|1] "" Vector__XXX
 SG_ NEIGHBOUR_FAULT : 29|1@1+ (1,0) [0|1] "" Vector__XXX
 SG_ MOTOR_TEMPSENSOR_ERROR : 30|1@1+ (1,0) [0|1] "" Ve
 SG_ DCBUS_SW_UNDERVOLTAGE : 28|1@1+ (1,0) [0|1] "" Vector__XXX
 SG_ NEIGHBOUR_FAULT : 29|1@1+ (1,0) [0|1] "" Vector__XXX
 SG_ MOTOR_TEMPSENSOR_ERROR : 30|1@1+ (1,0) [0|1] "" Vector__XXX
 SG_ MOTOR_TEMPERATURE_WARNING : 31|1@1+ (1,0) [0|1] "" Vector__XXX
 SG_ MOTOR_OVERTEMPERATURE : 32|1@1+ (1,0) [0|1] "" Vector__XXX
 SG_ MOTOR_STATOR_FREQ_TO_HIGH : 33|1@1+ (1,0) [0|1] "" Vector__XXX
 SG_ SUPPLYVOLTAGE_ERROR : 34|1@1+ (1,0) [0|1] "" Vector__XXX
 SG_ RPDO_TIMEOUT : 35|1@1+ (1,0) [0|1] "" Vector__XXX
 SG_ NMT_NOT_OPERATIONAL : 36|1@1+ (1,0) [0|1] "" Vector__XXX
 SG_ TASKOVERRUN : 37|1@1+ (1,0) [0|1] "" Vector__XXX
 SG_ NETSYNC_ERROR : 38|1@1+ (1,0) [0|1] "" Vector__XXX
 SG_ POSDEVICE_SIGNAL_TO_LOW : 39|1@1+ (1,0) [0|1] "" Vector__XXX
 SG_ POSDEVICE_SIGNAL_TO_HIGH : 40|1@1+ (1,0) [0|1] "" Vector__XXX
 SG_ RESOLVER_CALIBRATION_FAILED : 41|1@1+ (1,0) [0|1] "" Vector__XXX
 SG_ SYSTEM_FAULT : 42|1@1+ (1,0) [0|1] "" Vector__XXX
 SG_ INTERLOCK_OPEN : 43|1@1+ (1,0) [0|1] "" Vector__XXX
 SG_ APPC_HAS_GATE_DRIVER_DISABLED : 44|1@1+ (1,0) [0|1] "" Vector__XXX
 SG_ MOTOR_STALL_ERROR : 45|1@1+ (1,0) [0|1] "" Vector__XXX
 SG_ AMBIENT_TEMPERATURE_WARNING : 46|1@1+ (1,0) [0|1] "" Vector__XXX
 SG_ AMBIENT_OVERTEMPERATURE : 47|1@1+ (1,0) [0|1] "" Vector__XXX
 SG_ AMBIENT_TEMPSENSOR_ERROR : 48|1@1+ (1,0) [0|1] "" Vector__XXX
 SG_ POWERMODULE_CLAMPING_TIMEOUT : 49|1@1+ (1,0) [0|1] "" Vector__XXX
 SG_ DCBUS_RIPPLE_TO_HIGH : 50|1@1+ (1,0) [0|1] "" Vector__XXX
 SG_ MOTOR_I2XT_WARNING : 51|1@1+ (1,0) [0|1] "" Vector__XXX
 SG_ MOTOR_I2XT_ERROR : 52|1@1+ (1,0) [0|1] "" Vector__XXX
 SG_ MOTOR_FIELDWEAKENING_ERROR : 53|1@1+ (1,0) [0|1] "" Vector__XXX
 SG_ INVALID_PARAMETER_COMBINATION : 54|1@1+ (1,0) [0|1] "" Vector__XXX
 SG_ PLUG_COVER_SENSOR_SIGNAL_LOW : 55|1@1+ (1,0) [0|1] "" Vector__XXX
 SG_ MOTOR_CONNECTION_TEST_FAILED : 56|1@1+ (1,0) [0|1] "" Vector__XXX
 SG_ POWERMODULE_IXT_WARNING : 57|1@1+ (1,0) [0|1] "" Vector__XXX
 SG_ ISOLATION_FAULT : 58|1@1+ (1,0) [0|1] "" Vector__XXX
 SG_ Inverter_B_Statusword_1 : 0|7@1+ (1,0) [0|127] "" Vector__XXX
 SG_ EVENTBUFFER_NEW_EVENT : 16|1@1+ (1,0) [0|1] "" Vector__XXX
 SG_ EVENTBUFFER_OVERFLOW : 17|1@1+ (1,0) [0|1] "" Vector__XXX
 SG_ POWERMODULE_TRIPZONE_OVERCURRE : 18|1@1+ (1,0) [0|1] "" Vector__XXX
 SG_ POWERMODULE_CURRENT_OFFSET_INI : 19|1@1+ (1,0) [0|1] "" Vector__XXX
 SG_ POWERMODULE_TEMPSENSOR_ERROR : 20|1@1+ (1,0) [0|1] "" Vector__XXX
 SG_ POWERMODULE_TEMPERATURE_WARNIN : 21|1@1+ (1,0) [0|1] "" Vector__XXX
 SG_ POWERMODULE_OVERTEMPERATURE : 22|1@1+ (1,0) [0|1] "" Vector__XXX
 SG_ POWERMODULE_IXT_FAULT : 23|1@1+ (1,0) [0|1] "" Vector__XXX
 SG_ POWERMODULE_SW_OVERCURRENT : 24|1@1+ (1,0) [0|1] "" Vector__XXX
 SG_ POWERMODULE_PATTERNDATA_INCONS : 25|1@1+ (1,0) [0|1] "" Vector__XXX
 SG_ DCBUS_TRIPZONE_OVERVOLTAGE : 26|1@1+ (1,0) [0|1] "" Vector__XXX
 SG_ DCBUS_SW_OVERVOLTAGE : 27|1@1+ (1,0) [0|1] "" Vector__XXX
 SG_ DCBUS_SW_UNDERVOLTAGE : 28|1@1+ (1,0) [0|1] "" Vector__XXX
 SG_ NEIGHBOUR_FAULT : 29|1@1+ (1,0) [0|1] "" Vector__XXX
 SG_ MOTOR_TEMPSENSOR_ERROR : 30|1@1+ (1,0) [0|1] "" Vector__XXX
 SG_ MOTOR_TEMPERATURE_WARNING : 31|1@1+ (1,0) [0|1] "" Vector__XXX
 SG_ MOTOR_OVERTEMPERATURE : 32|1@1+ (1,0) [0|1] "" Vector__XXX
 SG_ MOTOR_STATOR_FREQ_TO_HIGH : 33|1@1+ (1,0) [0|1] "" Vector__XXX
 SG_ SUPPLYVOLTAGE_ERROR : 34|1@1+ (1,0) [0|1] "" Vector__XXX
 SG_ RPDO_TIMEOUT : 35|1@1+ (1,0) [0|1] "" Vector__XXX
 SG_ NMT_NOT_OPERATIONAL : 36|1@1+ (1,0) [0|1] "" Vector__XXX
 SG_ TASKOVERRUN : 37|1@1+ (1,0) [0|1] "" Vector__XXX
 SG_ NETSYNC_ERROR : 38|1@1+ (1,0) [0|1] "" Vector__XXX
 SG_ POSDEVICE_SIGNAL_TO_LOW : 39|1@1+ (1,0) [0|1] "" Vector__XXX
 SG_ POSDEVICE_SIGNAL_TO_HIGH : 40|1@1+ (1,0) [0|1] "" Vector__XXX
 SG_ RESOLVER_CALIBRATION_FAILED : 41|1@1+ (1,0) [0|1] "" Vector__XXX
 SG_ SYSTEM_FAULT : 42|1@1+ (1,0) [0|1] "" Vector__XXX
 SG_ INTERLOCK_OPEN : 43|1@1+ (1,0) [0|1] "" Vector__XXX
 SG_ APPC_HAS_GATE_DRIVER_DISABLED : 44|1@1+ (1,0) [0|1] "" Vector__XXX
 SG_ MOTOR_STALL_ERROR : 45|1@1+ (1,0) [0|1] "" Vector__XXX
 SG_ AMBIENT_TEMPERATURE_WARNING : 46|1@1+ (1,0) [0|1] "" Vector__XXX
 SG_ AMBIENT_OVERTEMPERATURE : 47|1@1+ (1,0) [0|1] "" Vector__XXX
 SG_ AMBIENT_TEMPSENSOR_ERROR : 48|1@1+ (1,0) [0|1] "" Vector__XXX
 SG_ POWERMODULE_CLAMPING_TIMEOUT : 49|1@1+ (1,0) [0|1] "" Vector__XXX
 SG_ DCBUS_RIPPLE_TO_HIGH : 50|1@1+ (1,0) [0|1] "" Vector__XXX
 SG_ MOTOR_I2XT_WARNING : 51|1@1+ (1,0) [0|1] "" Vector__XXX
 SG_ MOTOR_I2XT_ERROR : 52|1@1+ (1,0) [0|1] "" Vector__XXX
 SG_ MOTOR_FIELDWEAKENING_ERROR : 53|1@1+ (1,0) [0|1] "" Vector__XXX
 SG_ INVALID_PARAMETER_COMBINATION : 54|1@1+ (1,0) [0|1] "" Vector__XXX
 SG_ PLUG_COVER_SENSOR_SIGNAL_LOW : 55|1@1+ (1,0) [0|1] "" Vector__XXX
 SG_ MOTOR_CONNECTION_TEST_FAILED : 56|1@1+ (1,0) [0|1] "" Vector__XXX
 SG_ POWERMODULE_IXT_WARNING : 57|1@1+ (1,0) [0|1] "" Vector__XXX
 SG_ ISOLATION_FAULT : 58|1@1+ (1,0) [0|1] "" Vector__XXX
 SG_ Inverter_B_Statusword_13 : 0|7@1+ (1,0) [0|127] "" Vector__XXX
 SG_ EVENTBUFFER_NEW_EVENT : 16|1@1+ (1,0) [0|1] "" Vector__XXX
 SG_ EVENTBUFFER_OVERFLOW : 17|1@1+ (1,0) [0|1] "" Vector__XXX
 SG_ POWERMODULE_TRIPZONE_OVERCURRE : 18|1@1+ (1,0) [0|1] "" Vector__XXX
 SG_ POWERMODULE_CURRENT_OFFSET_INI : 19|1@1+ (1,0) [0|1] "" Vector__XXX
 SG_ POWERMODULE_TEMPSENSOR_ERROR : 20|1@1+ (1,0) [0|1] "" Vector__XXX
 SG_ POWERMODULE_TEMPERATURE_WARNIN : 21|1@1+ (1,0) [0|1] "" Vector__XXX
 SG_ POWERMODULE_OVERTEMPERATURE : 22|1@1+ (1,0) [0|1] "" Vector__XXX
 SG_ POWERMODULE_IXT_FAULT : 23|1@1+ (1,0) [0|1] "" Vector__XXX
 SG_ POWERMODULE_SW_OVERCURRENT : 24|1@1+ (1,0) [0|1] "" Vector__XXX
 SG_ POWERMODULE_PATTERNDATA_INCONS : 25|1@1+ (1,0) [0|1] "" Vector__XXX
 SG_ DCBUS_TRIPZONE_OVERVOLTAGE : 26|1@1+ (1,0) [0|1] "" Vector__XXX
 SG_ DCBUS_SW_OVERVOLTAGE : 27|1@1+ (1,0) [0|1] "" Vector__XXX
 SG_ DCBUS_SW_UNDERVOLTAGE : 28|1@1+ (1,0) [0|1] "" Vector__XXX
 SG_ NEIGHBOUR_FAULT : 29|1@1+ (1,0) [0|1] "" Vector__XXX
 SG_ MOTOR_TEMPSENSOR_ERROR : 30|1@1+ (1,0) [0|1] "" Vector__XXX
 SG_ MOTOR_TEMPERATURE_WARNING : 31|1@1+ (1,0) [0|1] "" Vector__XXX
 SG_ MOTOR_OVERTEMPERATURE : 32|1@1+ (1,0) [0|1] "" Vector__XXX
 SG_ MOTOR_STATOR_FREQ_TO_HIGH : 33|1@1+ (1,0) [0|1] "" Vector__XXX
 SG_ SUPPLYVOLTAGE_ERROR : 34|1@1+ (1,0) [0|1] "" Vector__XXX
 SG_ RPDO_TIMEOUT : 35|1@1+ (1,0) [0|1] "" Vector__XXX
 SG_ NMT_NOT_OPERATIONAL : 36|1@1+ (1,0) [0|1] "" Vector__XXX
 SG_ TASKOVERRUN : 37|1@1+ (1,0) [0|1] "" Vector__XXX
 SG_ NETSYNC_ERROR : 38|1@1+ (1,0) [0|1] "" Vector__XXX
 SG_ POSDEVICE_SIGNAL_TO_LOW : 39|1@1+ (1,0) [0|1] "" Vector__XXX
 SG_ POSDEVICE_SIGNAL_TO_HIGH : 40|1@1+ (1,0) [0|1] "" Vector__XXX
 SG_ RESOLVER_CALIBRATION_FAILED : 41|1@1+ (1,0) [0|1] "" Vector__XXX
 SG_ SYSTEM_FAULT : 42|1@1+ (1,0) [0|1] "" Vector__XXX
 SG_ INTERLOCK_OPEN : 43|1@1+ (1,0) [0|1] "" Vector__XXX
 SG_ APPC_HAS_GATE_DRIVER_DISABLED : 44|1@1+ (1,0) [0|1] "" Vector__XXX
 SG_ MOTOR_STALL_ERROR : 45|1@1+ (1,0) [0|1] "" Vector__XXX
 SG_ AMBIENT_TEMPERATURE_WARNING : 46|1@1+ (1,0) [0|1] "" Vector__XXX
 SG_ AMBIENT_OVERTEMPERATURE : 47|1@1+ (1,0) [0|1] "" Vector__XXX
 SG_ AMBIENT_TEMPSENSOR_ERROR : 48|1@1+ (1,0) [0|1] "" Vector__XXX
 SG_ POWERMODULE_CLAMPING_TIMEOUT : 49|1@1+ (1,0) [0|1] "" Vector__XXX
 SG_ DCBUS_RIPPLE_TO_HIGH : 50|1@1+ (1,0) [0|1] "" Vector__XXX
 SG_ MOTOR_I2XT_WARNING : 51|1@1+ (1,0) [0|1] "" Vector__XXX
 SG_ MOTOR_I2XT_ERROR : 52|1@1+ (1,0) [0|1] "" Vector__XXX
 SG_ MOTOR_FIELDWEAKENING_ERROR : 53|1@1+ (1,0) [0|1] "" Vector__XXX
 SG_ INVALID_PARAMETER_COMBINATION : 54|1@1+ (1,0) [0|1] "" Vector__XXX
 SG_ PLUG_COVER_SENSOR_SIGNAL_LOW : 55|1@1+ (1,0) [0|1] "" Vector__XXX
 SG_ MOTOR_CONNECTION_TEST_FAILED : 56|1@1+ (1,0) [0|1] "" Vector__XXX
 SG_ POWERMODULE_IXT_WARNING : 57|1@1+ (1,0) [0|1] "" Vector__XXX
 SG_ ISOLATION_FAULT : 58|1@1+ (1,0) [0|1] "" Vector__XXX
 SG_ Inverter_B_Statusword_12 : 0|7@1+ (1,0) [0|127] "" Vector__XXX
 SG_ EVENTBUFFER_NEW_EVENT : 16|1@1+ (1,0) [0|1] "" Vector__XXX
 SG_ EVENTBUFFER_OVERFLOW : 17|1@1+ (1,0) [0|1] "" Vector__XXX
 SG_ POWERMODULE_TRIPZONE_OVERCURRE : 18|1@1+ (1,0) [0|1] "" Vector__XXX
 SG_ POWERMODULE_CURRENT_OFFSET_INI : 19|1@1+ (1,0) [0|1] "" Vector__XXX
 SG_ POWERMODULE_TEMPSENSOR_ERROR : 20|1@1+ (1,0) [0|1] "" Vector__XXX
 SG_ POWERMODULE_TEMPERATURE_WARNIN : 21|1@1+ (1,0) [0|1] "" Vector__XXX
 SG_ POWERMODULE_OVERTEMPERATURE : 22|1@1+ (1,0) [0|1] "" Vector__XXX
 SG_ POWERMODULE_IXT_FAULT : 23|1@1+ (1,0) [0|1] "" Vector__XXX
 SG_ POWERMODULE_SW_OVERCURRENT : 24|1@1+ (1,0) [0|1] "" Vector__XXX
 SG_ POWERMODULE_PATTERNDATA_INCONS : 25|1@1+ (1,0) [0|1] "" Vector__XXX
 SG_ DCBUS_TRIPZONE_OVERVOLTAGE : 26|1@1+ (1,0) [0|1] "" Vector__XXX
 SG_ DCBUS_SW_OVERVOLTAGE : 27|1@1+ (1,0) [0|1] "" Vector__XXX
 SG_ DCBUS_SW_UNDERVOLTAGE : 28|1@1+ (1,0) [0|1] "" Vector__XXX
 SG_ NEIGHBOUR_FAULT : 29|1@1+ (1,0) [0|1] "" Vector__XXX
 SG_ MOTOR_TEMPSENSOR_ERROR : 30|1@1+ (1,0) [0|1] "" Vector__XXX
 SG_ MOTOR_TEMPERATURE_WARNING : 31|1@1+ (1,0) [0|1] "" Vector__XXX
 SG_ MOTOR_OVERTEMPERATURE : 32|1@1+ (1,0) [0|1] "" Vector__XXX
 SG_ MOTOR_STATOR_FREQ_TO_HIGH : 33|1@1+ (1,0) [0|1] "" Vector__XXX
 SG_ SUPPLYVOLTAGE_ERROR : 34|1@1+ (1,0) [0|1] "" Vector__XXX
 SG_ RPDO_TIMEOUT : 35|1@1+ (1,0) [0|1] "" Vector__XXX
 SG_ NMT_NOT_OPERATIONAL : 36|1@1+ (1,0) [0|1] "" Vector__XXX
 SG_ TASKOVERRUN : 37|1@1+ (1,0) [0|1] "" Vector__XXX
 SG_ NETSYNC_ERROR : 38|1@1+ (1,0) [0|1] "" Vector__XXX
 SG_ POSDEVICE_SIGNAL_TO_LOW : 39|1@1+ (1,0) [0|1] "" Vector__XXX
 SG_ POSDEVICE_SIGNAL_TO_HIGH : 40|1@1+ (1,0) [0|1] "" Vector__XXX
 SG_ RESOLVER_CALIBRATION_FAILED : 41|1@1+ (1,0) [0|1] "" Vector__XXX
 SG_ SYSTEM_FAULT : 42|1@1+ (1,0) [0|1] "" Vector__XXX
 SG_ INTERLOCK_OPEN : 43|1@1+ (1,0) [0|1] "" Vector__XXX
 SG_ APPC_HAS_GATE_DRIVER_DISABLED : 44|1@1+ (1,0) [0|1] "" Vector__XXX
 SG_ MOTOR_STALL_ERROR : 45|1@1+ (1,0) [0|1] "" Vector__XXX
 SG_ AMBIENT_TEMPERATURE_WARNING : 46|1@1+ (1,0) [0|1] "" Vector__XXX
 SG_ AMBIENT_OVERTEMPERATURE : 47|1@1+ (1,0) [0|1] "" Vector__XXX
 SG_ AMBIENT_TEMPSENSOR_ERROR : 48|1@1+ (1,0) [0|1] "" Vector__XXX
 SG_ POWERMODULE_CLAMPING_TIMEOUT : 49|1@1+ (1,0) [0|1] "" Vector__XXX
 SG_ DCBUS_RIPPLE_TO_HIGH : 50|1@1+ (1,0) [0|1] "" Vector__XXX
 SG_ MOTOR_I2XT_WARNING : 51|1@1+ (1,0) [0|1] "" Vector__XXX
 SG_ MOTOR_I2XT_ERROR : 52|1@1+ (1,0) [0|1] "" Vector__XXX
 SG_ MOTOR_FIELDWEAKENING_ERROR : 53|1@1+ (1,0) [0|1] "" Vector__XXX
 SG_ INVALID_PARAMETER_COMBINATION : 54|1@1+ (1,0) [0|1] "" Vector__XXX
 SG_ PLUG_COVER_SENSOR_SIGNAL_LOW : 55|1@1+ (1,0) [0|1] "" Vector__XXX
 SG_ MOTOR_CONNECTION_TEST_FAILED : 56|1@1+ (1,0) [0|1] "" Vector__XXX
 SG_ POWERMODULE_IXT_WARNING : 57|1@1+ (1,0) [0|1] "" Vector__XXX
 SG_ ISOLATION_FAULT : 58|1@1+ (1,0) [0|1] "" Vector__XXX
 SG_ Inverter_B_Statusword_11 : 0|7@1+ (1,0) [0|127] "" Vector__XXX
 SG_ EVENTBUFFER_NEW_EVENT : 16|1@1+ (1,0) [0|1] "" Vector__XXX
 SG_ EVENTBUFFER_OVERFLOW : 17|1@1+ (1,0) [0|1] "" Vector__XXX
 SG_ POWERMODULE_TRIPZONE_OVERCURRE : 18|1@1+ (1,0) [0|1] "" Vector__XXX
 SG_ POWERMODULE_CURRENT_OFFSET_INI : 19|1@1+ (1,0) [0|1] "" Vector__XXX
 SG_ POWERMODULE_TEMPSENSOR_ERROR : 20|1@1+ (1,0) [0|1] "" Vector__XXX
 SG_ POWERMODULE_TEMPERATURE_WARNIN : 21|1@1+ (1,0) [0|1] "" Vector__XXX
 SG_ POWERMODULE_OVERTEMPERATURE : 22|1@1+ (1,0) [0|1] "" Vector__XXX
 SG_ POWERMODULE_IXT_FAULT : 23|1@1+ (1,0) [0|1] "" Vector__XXX
 SG_ POWERMODULE_SW_OVERCURRENT : 24|1@1+ (1,0) [0|1] "" Vector__XXX
 SG_ POWERMODULE_PATTERNDATA_INCONS : 25|1@1+ (1,0) [0|1] "" Vector__XXX
 SG_ DCBUS_TRIPZONE_OVERVOLTAGE : 26|1@1+ (1,0) [0|1] "" Vector__XXX
 SG_ DCBUS_SW_OVERVOLTAGE : 27|1@1+ (1,0) [0|1] "" Vector__XXX
 SG_ DCBUS_SW_UNDERVOLTAGE : 28|1@1+ (1,0) [0|1] "" Vector__XXX
 SG_ NEIGHBOUR_FAULT : 29|1@1+ (1,0) [0|1] "" Vector__XXX
 SG_ MOTOR_TEMPSENSOR_ERROR : 30|1@1+ (1,0) [0|1] "" Vector__XXX
 SG_ MOTOR_TEMPERATURE_WARNING : 31|1@1+ (1,0) [0|1] "" Vector__XXX
 SG_ MOTOR_OVERTEMPERATURE : 32|1@1+ (1,0) [0|1] "" Vector__XXX
 SG_ MOTOR_STATOR_FREQ_TO_HIGH : 33|1@1+ (1,0) [0|1] "" Vector__XXX
 SG_ SUPPLYVOLTAGE_ERROR : 34|1@1+ (1,0) [0|1] "" Vector__XXX
 SG_ RPDO_TIMEOUT : 35|1@1+ (1,0) [0|1] "" Vector__XXX
 SG_ NMT_NOT_OPERATIONAL : 36|1@1+ (1,0) [0|1] "" Vector__XXX
 SG_ TASKOVERRUN : 37|1@1+ (1,0) [0|1] "" Vector__XXX
 SG_ NETSYNC_ERROR : 38|1@1+ (1,0) [0|1] "" Vector__XXX
 SG_ POSDEVICE_SIGNAL_TO_LOW : 39|1@1+ (1,0) [0|1] "" Vector__XXX
 SG_ POSDEVICE_SIGNAL_TO_HIGH : 40|1@1+ (1,0) [0|1] "" Vector__XXX
 SG_ RESOLVER_CALIBRATION_FAILED : 41|1@1+ (1,0) [0|1] "" Vector__XXX
 SG_ SYSTEM_FAULT : 42|1@1+ (1,0) [0|1] "" Vector__XXX
 SG_ INTERLOCK_OPEN : 43|1@1+ (1,0) [0|1] "" Vector__XXX
 SG_ APPC_HAS_GATE_DRIVER_DISABLED : 44|1@1+ (1,0) [0|1] "" Vector__XXX
 SG_ MOTOR_STALL_ERROR : 45|1@1+ (1,0) [0|1] "" Vector__XXX
 SG_ AMBIENT_TEMPERATURE_WARNING : 46|1@1+ (1,0) [0|1] "" Vector__XXX
 SG_ AMBIENT_OVERTEMPERATURE : 47|1@1+ (1,0) [0|1] "" Vector__XXX
 SG_ AMBIENT_TEMPSENSOR_ERROR : 48|1@1+ (1,0) [0|1] "" Vector__XXX
 SG_ POWERMODULE_CLAMPING_TIMEOUT : 49|1@1+ (1,0) [0|1] "" Vector__XXX
 SG_ DCBUS_RIPPLE_TO_HIGH : 50|1@1+ (1,0) [0|1] "" Vector__XXX
 SG_ MOTOR_I2XT_WARNING : 51|1@1+ (1,0) [0|1] "" Vector__XXX
 SG_ MOTOR_I2XT_ERROR : 52|1@1+ (1,0) [0|1] "" Vector__XXX
 SG_ MOTOR_FIELDWEAKENING_ERROR : 53|1@1+ (1,0) [0|1] "" Vector__XXX
 SG_ INVALID_PARAMETER_COMBINATION : 54|1@1+ (1,0) [0|1] "" Vector__XXX
 SG_ PLUG_COVER_SENSOR_SIGNAL_LOW : 55|1@1+ (1,0) [0|1] "" Vector__XXX
 SG_ MOTOR_CONNECTION_TEST_FAILED : 56|1@1+ (1,0) [0|1] "" Vector__XXX
 SG_ POWERMODULE_IXT_WARNING : 57|1@1+ (1,0) [0|1] "" Vector__XXX
 SG_ ISOLATION_FAULT : 58|1@1+ (1,0) [0|1] "" Vector__XXX
 SG_ Inverter_B_Statusword_10 : 0|7@1+ (1,0) [0|127] "" Vector__XXX
 SG_ EVENTBUFFER_NEW_EVENT : 16|1@1+ (1,0) [0|1] "" Vector__XXX
 SG_ EVENTBUFFER_OVERFLOW : 17|1@1+ (1,0) [0|1] "" Vector__XXX
 SG_ POWERMODULE_TRIPZONE_OVERCURRE : 18|1@1+ (1,0) [0|1] "" Vector__XXX
 SG_ POWERMODULE_CURRENT_OFFSET_INI : 19|1@1+ (1,0) [0|1] "" Vector__XXX
 SG_ POWERMODULE_TEMPSENSOR_ERROR : 20|1@1+ (1,0) [0|1] "" Vector__XXX
 SG_ POWERMODULE_TEMPERATURE_WARNIN : 21|1@1+ (1,0) [0|1] "" Vector__XXX
 SG_ POWERMODULE_OVERTEMPERATURE : 22|1@1+ (1,0) [0|1] "" Vector__XXX
 SG_ POWERMODULE_IXT_FAULT : 23|1@1+ (1,0) [0|1] "" Vector__XXX
 SG_ POWERMODULE_SW_OVERCURRENT : 24|1@1+ (1,0) [0|1] "" Vector__XXX
 SG_ POWERMODULE_PATTERNDATA_INCONS : 25|1@1+ (1,0) [0|1] "" Vector__XXX
 SG_ DCBUS_TRIPZONE_OVERVOLTAGE : 26|1@1+ (1,0) [0|1] "" Vector__XXX
 SG_ DCBUS_SW_OVERVOLTAGE : 27|1@1+ (1,0) [0|1] "" Vector__XXX
 SG_ DCBUS_SW_UNDERVOLTAGE : 28|1@1+ (1,0) [0|1] "" Vector__XXX
 SG_ NEIGHBOUR_FAULT : 29|1@1+ (1,0) [0|1] "" Vector__XXX
 SG_ MOTOR_TEMPSENSOR_ERROR : 30|1@1+ (1,0) [0|1] "" Vector__XXX
 SG_ MOTOR_TEMPERATURE_WARNING : 31|1@1+ (1,0) [0|1] "" Vector__XXX
 SG_ MOTOR_OVERTEMPERATURE : 32|1@1+ (1,0) [0|1] "" Vector__XXX
 SG_ MOTOR_STATOR_FREQ_TO_HIGH : 33|1@1+ (1,0) [0|1] "" Vector__XXX
 SG_ SUPPLYVOLTAGE_ERROR : 34|1@1+ (1,0) [0|1] "" Vector__XXX
 SG_ RPDO_TIMEOUT : 35|1@1+ (1,0) [0|1] "" Vector__XXX
 SG_ NMT_NOT_OPERATIONAL : 36|1@1+ (1,0) [0|1] "" Vector__XXX
 SG_ TASKOVERRUN : 37|1@1+ (1,0) [0|1] "" Vector__XXX
 SG_ NETSYNC_ERROR : 38|1@1+ (1,0) [0|1] "" Vector__XXX
 SG_ POSDEVICE_SIGNAL_TO_LOW : 39|1@1+ (1,0) [0|1] "" Vector__XXX
 SG_ POSDEVICE_SIGNAL_TO_HIGH : 40|1@1+ (1,0) [0|1] "" Vector__XXX
 SG_ RESOLVER_CALIBRATION_FAILED : 41|1@1+ (1,0) [0|1] "" Vector__XXX
 SG_ SYSTEM_FAULT : 42|1@1+ (1,0) [0|1] "" Vector__XXX
 SG_ INTERLOCK_OPEN : 43|1@1+ (1,0) [0|1] "" Vector__XXX
 SG_ APPC_HAS_GATE_DRIVER_DISABLED : 44|1@1+ (1,0) [0|1] "" Vector__XXX
 SG_ MOTOR_STALL_ERROR : 45|1@1+ (1,0) [0|1] "" Vector__XXX
 SG_ AMBIENT_TEMPERATURE_WARNING : 46|1@1+ (1,0) [0|1] "" Vector__XXX
 SG_ AMBIENT_OVERTEMPERATURE : 47|1@1+ (1,0) [0|1] "" Vector__XXX
 SG_ AMBIENT_TEMPSENSOR_ERROR : 48|1@1+ (1,0) [0|1] "" Vector__XXX
 SG_ POWERMODULE_CLAMPING_TIMEOUT : 49|1@1+ (1,0) [0|1] "" Vector__XXX
 SG_ DCBUS_RIPPLE_TO_HIGH : 50|1@1+ (1,0) [0|1] "" Vector__XXX
 SG_ MOTOR_I2XT_WARNING : 51|1@1+ (1,0) [0|1] "" Vector__XXX
 SG_ MOTOR_I2XT_ERROR : 52|1@1+ (1,0) [0|1] "" Vector__XXX
 SG_ MOTOR_FIELDWEAKENING_ERROR : 53|1@1+ (1,0) [0|1] "" Vector__XXX
 SG_ INVALID_PARAMETER_COMBINATION : 54|1@1+ (1,0) [0|1] "" Vector__XXX
 SG_ PLUG_COVER_SENSOR_SIGNAL_LOW : 55|1@1+ (1,0) [0|1] "" Vector__XXX
 SG_ MOTOR_CONNECTION_TEST_FAILED : 56|1@1+ (1,0) [0|1] "" Vector__XXX
 SG_ POWERMODULE_IXT_WARNING : 57|1@1+ (1,0) [0|1] "" Vector__XXX
 SG_ ISOLATION_FAULT : 58|1@1+ (1,0) [0|1] "" Vector__XXX
 SG_ Inverter_B_Statusword_9 : 0|7@1+ (1,0) [0|127] "" Vector__XXX
 SG_ EVENTBUFFER_NEW_EVENT : 16|1@1+ (1,0) [0|1] "" Vector__XXX
 SG_ EVENTBUFFER_OVERFLOW : 17|1@1+ (1,0) [0|1] "" Vector__XXX
 SG_ POWERMODULE_TRIPZONE_OVERCURRE : 18|1@1+ (1,0) [0|1] "" Vector__XXX
 SG_ POWERMODULE_CURRENT_OFFSET_INI : 19|1@1+ (1,0) [0|1] "" Vector__XXX
 SG_ POWERMODULE_TEMPSENSOR_ERROR : 20|1@1+ (1,0) [0|1] "" Vector__XXX
 SG_ POWERMODULE_TEMPERATURE_WARNIN : 21|1@1+ (1,0) [0|1] "" Vector__XXX
 SG_ POWERMODULE_OVERTEMPERATURE : 22|1@1+ (1,0) [0|1] "" Vector__XXX
 SG_ POWERMODULE_IXT_FAULT : 23|1@1+ (1,0) [0|1] "" Vector__XXX
 SG_ POWERMODULE_SW_OVERCURRENT : 24|1@1+ (1,0) [0|1] "" Vector__XXX
 SG_ POWERMODULE_PATTERNDATA_INCONS : 25|1@1+ (1,0) [0|1] "" Vector__XXX
 SG_ DCBUS_TRIPZONE_OVERVOLTAGE : 26|1@1+ (1,0) [0|1] "" Vector__XXX
 SG_ DCBUS_SW_OVERVOLTAGE : 27|1@1+ (1,0) [0|1] "" Vector__XXX
 SG_ DCBUS_SW_UNDERVOLTAGE : 28|1@1+ (1,0) [0|1] "" Vector__XXX
 SG_ NEIGHBOUR_FAULT : 29|1@1+ (1,0) [0|1] "" Vector__XXX
 SG_ MOTOR_TEMPSENSOR_ERROR : 30|1@1+ (1,0) [0|1] "" Vector__XXX
 SG_ MOTOR_TEMPERATURE_WARNING : 31|1@1+ (1,0) [0|1] "" Vector__XXX
 SG_ MOTOR_OVERTEMPERATURE : 32|1@1+ (1,0) [0|1] "" Vector__XXX
 SG_ MOTOR_STATOR_FREQ_TO_HIGH : 33|1@1+ (1,0) [0|1] "" Vector__XXX
 SG_ SUPPLYVOLTAGE_ERROR : 34|1@1+ (1,0) [0|1] "" Vector__XXX
 SG_ RPDO_TIMEOUT : 35|1@1+ (1,0) [0|1] "" Vector__XXX
 SG_ NMT_NOT_OPERATIONAL : 36|1@1+ (1,0) [0|1] "" Vector__XXX
 SG_ TASKOVERRUN : 37|1@1+ (1,0) [0|1] "" Vector__XXX
 SG_ NETSYNC_ERROR : 38|1@1+ (1,0) [0|1] "" Vector__XXX
 SG_ POSDEVICE_SIGNAL_TO_LOW : 39|1@1+ (1,0) [0|1] "" Vector__XXX
 SG_ POSDEVICE_SIGNAL_TO_HIGH : 40|1@1+ (1,0) [0|1] "" Vector__XXX
 SG_ RESOLVER_CALIBRATION_FAILED : 41|1@1+ (1,0) [0|1] "" Vector__XXX
 SG_ SYSTEM_FAULT : 42|1@1+ (1,0) [0|1] "" Vector__XXX
 SG_ INTERLOCK_OPEN : 43|1@1+ (1,0) [0|1] "" Vector__XXX
 SG_ APPC_HAS_GATE_DRIVER_DISABLED : 44|1@1+ (1,0) [0|1] "" Vector__XXX
 SG_ MOTOR_STALL_ERROR : 45|1@1+ (1,0) [0|1] "" Vector__XXX
 SG_ AMBIENT_TEMPERATURE_WARNING : 46|1@1+ (1,0) [0|1] "" Vector__XXX
 SG_ AMBIENT_OVERTEMPERATURE : 47|1@1+ (1,0) [0|1] "" Vector__XXX
 SG_ AMBIENT_TEMPSENSOR_ERROR : 48|1@1+ (1,0) [0|1] "" Vector__XXX
 SG_ POWERMODULE_CLAMPING_TIMEOUT : 49|1@1+ (1,0) [0|1] "" Vector__XXX
 SG_ DCBUS_RIPPLE_TO_HIGH : 50|1@1+ (1,0) [0|1] "" Vector__XXX
 SG_ MOTOR_I2XT_WARNING : 51|1@1+ (1,0) [0|1] "" Vector__XXX
 SG_ MOTOR_I2XT_ERROR : 52|1@1+ (1,0) [0|1] "" Vector__XXX
 SG_ MOTOR_FIELDWEAKENING_ERROR : 53|1@1+ (1,0) [0|1] "" Vector__XXX
 SG_ INVALID_PARAMETER_COMBINATION : 54|1@1+ (1,0) [0|1] "" Vector__XXX
 SG_ PLUG_COVER_SENSOR_SIGNAL_LOW : 55|1@1+ (1,0) [0|1] "" Vector__XXX
 SG_ MOTOR_CONNECTION_TEST_FAILED : 56|1@1+ (1,0) [0|1] "" Vector__XXX
 SG_ POWERMODULE_IXT_WARNING : 57|1@1+ (1,0) [0|1] "" Vector__XXX
 SG_ ISOLATION_FAULT : 58|1@1+ (1,0) [0|1] "" Vector__XXX
 SG_ Inverter_B_Statusword_8 : 0|7@1+ (1,0) [0|127] "" Vector__XXX
 SG_ EVENTBUFFER_NEW_EVENT : 16|1@1+ (1,0) [0|1] "" Vector__XXX
 SG_ EVENTBUFFER_OVERFLOW : 17|1@1+ (1,0) [0|1] "" Vector__XXX
 SG_ POWERMODULE_TRIPZONE_OVERCURRE : 18|1@1+ (1,0) [0|1] "" Vector__XXX
 SG_ POWERMODULE_CURRENT_OFFSET_INI : 19|1@1+ (1,0) [0|1] "" Vector__XXX
 SG_ POWERMODULE_TEMPSENSOR_ERROR : 20|1@1+ (1,0) [0|1] "" Vector__XXX
 SG_ POWERMODULE_TEMPERATURE_WARNIN : 21|1@1+ (1,0) [0|1] "" Vector__XXX
 SG_ POWERMODULE_OVERTEMPERATURE : 22|1@1+ (1,0) [0|1] "" Vector__XXX
 SG_ POWERMODULE_IXT_FAULT : 23|1@1+ (1,0) [0|1] "" Vector__XXX
 SG_ POWERMODULE_SW_OVERCURRENT : 24|1@1+ (1,0) [0|1] "" Vector__XXX
 SG_ POWERMODULE_PATTERNDATA_INCONS : 25|1@1+ (1,0) [0|1] "" Vector__XXX
 SG_ DCBUS_TRIPZONE_OVERVOLTAGE : 26|1@1+ (1,0) [0|1] "" Vector__XXX
 SG_ DCBUS_SW_OVERVOLTAGE : 27|1@1+ (1,0) [0|1] "" Vector__XXX
 SG_ DCBUS_SW_UNDERVOLTAGE : 28|1@1+ (1,0) [0|1] "" Vector__XXX
 SG_ NEIGHBOUR_FAULT : 29|1@1+ (1,0) [0|1] "" Vector__XXX
 SG_ MOTOR_TEMPSENSOR_ERROR : 30|1@1+ (1,0) [0|1] "" Vector__XXX
 SG_ MOTOR_TEMPERATURE_WARNING : 31|1@1+ (1,0) [0|1] "" Vector__XXX
 SG_ MOTOR_OVERTEMPERATURE : 32|1@1+ (1,0) [0|1] "" Vector__XXX
 SG_ MOTOR_STATOR_FREQ_TO_HIGH : 33|1@1+ (1,0) [0|1] "" Vector__XXX
 SG_ SUPPLYVOLTAGE_ERROR : 34|1@1+ (1,0) [0|1] "" Vector__XXX
 SG_ RPDO_TIMEOUT : 35|1@1+ (1,0) [0|1] "" Vector__XXX
 SG_ NMT_NOT_OPERATIONAL : 36|1@1+ (1,0) [0|1] "" Vector__XXX
 SG_ TASKOVERRUN : 37|1@1+ (1,0) [0|1] "" Vector__XXX
 SG_ NETSYNC_ERROR : 38|1@1+ (1,0) [0|1] "" Vector__XXX
 SG_ POSDEVICE_SIGNAL_TO_LOW : 39|1@1+ (1,0) [0|1] "" Vector__XXX
 SG_ POSDEVICE_SIGNAL_TO_HIGH : 40|1@1+ (1,0) [0|1] "" Vector__XXX
 SG_ RESOLVER_CALIBRATION_FAILED : 41|1@1+ (1,0) [0|1] "" Vector__XXX
 SG_ SYSTEM_FAULT : 42|1@1+ (1,0) [0|1] "" Vector__XXX
 SG_ INTERLOCK_OPEN : 43|1@1+ (1,0) [0|1] "" Vector__XXX
 SG_ APPC_HAS_GATE_DRIVER_DISABLED : 44|1@1+ (1,0) [0|1] "" Vector__XXX
 SG_ MOTOR_STALL_ERROR : 45|1@1+ (1,0) [0|1] "" Vector__XXX
 SG_ AMBIENT_TEMPERATURE_WARNING : 46|1@1+ (1,0) [0|1] "" Vector__XXX
 SG_ AMBIENT_OVERTEMPERATURE : 47|1@1+ (1,0) [0|1] "" Vector__XXX
 SG_ AMBIENT_TEMPSENSOR_ERROR : 48|1@1+ (1,0) [0|1] "" Vector__XXX
 SG_ POWERMODULE_CLAMPING_TIMEOUT : 49|1@1+ (1,0) [0|1] "" Vector__XXX
 SG_ DCBUS_RIPPLE_TO_HIGH : 50|1@1+ (1,0) [0|1] "" Vector__XXX
 SG_ MOTOR_I2XT_WARNING : 51|1@1+ (1,0) [0|1] "" Vector__XXX
 SG_ MOTOR_I2XT_ERROR : 52|1@1+ (1,0) [0|1] "" Vector__XXX
 SG_ MOTOR_FIELDWEAKENING_ERROR : 53|1@1+ (1,0) [0|1] "" Vector__XXX
 SG_ INVALID_PARAMETER_COMBINATION : 54|1@1+ (1,0) [0|1] "" Vector__XXX
 SG_ PLUG_COVER_SENSOR_SIGNAL_LOW : 55|1@1+ (1,0) [0|1] "" Vector__XXX
 SG_ MOTOR_CONNECTION_TEST_FAILED : 56|1@1+ (1,0) [0|1] "" Vector__XXX
 SG_ POWERMODULE_IXT_WARNING : 57|1@1+ (1,0) [0|1] "" Vector__XXX
 SG_ ISOLATION_FAULT : 58|1@1+ (1,0) [0|1] "" Vector__XXX
 SG_ Inverter_B_Statusword_7 : 0|7@1+ (1,0) [0|127] "" Vector__XXX
 SG_ EVENTBUFFER_NEW_EVENT : 16|1@1+ (1,0) [0|1] "" Vector__XXX
 SG_ EVENTBUFFER_OVERFLOW : 17|1@1+ (1,0) [0|1] "" Vector__XXX
 SG_ POWERMODULE_TRIPZONE_OVERCURRE : 18|1@1+ (1,0) [0|1] "" Vector__XXX
 SG_ POWERMODULE_CURRENT_OFFSET_INI : 19|1@1+ (1,0) [0|1] "" Vector__XXX
 SG_ POWERMODULE_TEMPSENSOR_ERROR : 20|1@1+ (1,0) [0|1] "" Vector__XXX
 SG_ POWERMODULE_TEMPERATURE_WARNIN : 21|1@1+ (1,0) [0|1] "" Vector__XXX
 SG_ POWERMODULE_OVERTEMPERATURE : 22|1@1+ (1,0) [0|1] "" Vector__XXX
 SG_ POWERMODULE_IXT_FAULT : 23|1@1+ (1,0) [0|1] "" Vector__XXX
 SG_ POWERMODULE_SW_OVERCURRENT : 24|1@1+ (1,0) [0|1] "" Vector__XXX
 SG_ POWERMODULE_PATTERNDATA_INCONS : 25|1@1+ (1,0) [0|1] "" Vector__XXX
 SG_ DCBUS_TRIPZONE_OVERVOLTAGE : 26|1@1+ (1,0) [0|1] "" Vector__XXX
 SG_ DCBUS_SW_OVERVOLTAGE : 27|1@1+ (1,0) [0|1] "" Vector__XXX
 SG_ DCBUS_SW_UNDERVOLTAGE : 28|1@1+ (1,0) [0|1] "" Vector__XXX
 SG_ NEIGHBOUR_FAULT : 29|1@1+ (1,0) [0|1] "" Vector__XXX
 SG_ MOTOR_TEMPSENSOR_ERROR : 30|1@1+ (1,0) [0|1] "" Vector__XXX
 SG_ MOTOR_TEMPERATURE_WARNING : 31|1@1+ (1,0) [0|1] "" Vector__XXX
 SG_ MOTOR_OVERTEMPERATURE : 32|1@1+ (1,0) [0|1] "" Vector__XXX
 SG_ MOTOR_STATOR_FREQ_TO_HIGH : 33|1@1+ (1,0) [0|1] "" Vector__XXX
 SG_ SUPPLYVOLTAGE_ERROR : 34|1@1+ (1,0) [0|1] "" Vector__XXX
 SG_ RPDO_TIMEOUT : 35|1@1+ (1,0) [0|1] "" Vector__XXX
 SG_ NMT_NOT_OPERATIONAL : 36|1@1+ (1,0) [0|1] "" Vector__XXX
 SG_ TASKOVERRUN : 37|1@1+ (1,0) [0|1] "" Vector__XXX
 SG_ NETSYNC_ERROR : 38|1@1+ (1,0) [0|1] "" Vector__XXX
 SG_ POSDEVICE_SIGNAL_TO_LOW : 39|1@1+ (1,0) [0|1] "" Vector__XXX
 SG_ POSDEVICE_SIGNAL_TO_HIGH : 40|1@1+ (1,0) [0|1] "" Vector__XXX
 SG_ RESOLVER_CALIBRATION_FAILED : 41|1@1+ (1,0) [0|1] "" Vector__XXX
 SG_ SYSTEM_FAULT : 42|1@1+ (1,0) [0|1] "" Vector__XXX
 SG_ INTERLOCK_OPEN : 43|1@1+ (1,0) [0|1] "" Vector__XXX
 SG_ APPC_HAS_GATE_DRIVER_DISABLED : 44|1@1+ (1,0) [0|1] "" Vector__XXX
 SG_ MOTOR_STALL_ERROR : 45|1@1+ (1,0) [0|1] "" Vector__XXX
 SG_ AMBIENT_TEMPERATURE_WARNING : 46|1@1+ (1,0) [0|1] "" Vector__XXX
 SG_ AMBIENT_OVERTEMPERATURE : 47|1@1+ (1,0) [0|1] "" Vector__XXX
 SG_ AMBIENT_TEMPSENSOR_ERROR : 48|1@1+ (1,0) [0|1] "" Vector__XXX
 SG_ POWERMODULE_CLAMPING_TIMEOUT : 49|1@1+ (1,0) [0|1] "" Vector__XXX
 SG_ DCBUS_RIPPLE_TO_HIGH : 50|1@1+ (1,0) [0|1] "" Vector__XXX
 SG_ MOTOR_I2XT_WARNING : 51|1@1+ (1,0) [0|1] "" Vector__XXX
 SG_ MOTOR_I2XT_ERROR : 52|1@1+ (1,0) [0|1] "" Vector__XXX
 SG_ MOTOR_FIELDWEAKENING_ERROR : 53|1@1+ (1,0) [0|1] "" Vector__XXX
 SG_ INVALID_PARAMETER_COMBINATION : 54|1@1+ (1,0) [0|1] "" Vector__XXX
 SG_ PLUG_COVER_SENSOR_SIGNAL_LOW : 55|1@1+ (1,0) [0|1] "" Vector__XXX
 SG_ MOTOR_CONNECTION_TEST_FAILED : 56|1@1+ (1,0) [0|1] "" Vector__XXX
 SG_ POWERMODULE_IXT_WARNING : 57|1@1+ (1,0) [0|1] "" Vector__XXX
 SG_ ISOLATION_FAULT : 58|1@1+ (1,0) [0|1] "" Vector__XXX
 SG_ Motor_B_act_velocity_5 : 0|32@1- (6.103515625e-05,0) [-131072|131071.99994] "rpm" Vector__XXX
 SG_ Motor_B_act_torque_5 : 32|16@1- (0.1,0) [-3276.8|3276.7] "%" Vector__XXX
 SG_ Motor_B_act_current_5 : 48|16@1- (0.015625,0) [-512|511.984375] "A" Vector__XXX
 SG_ Motor_B_act_velocity_4 : 0|32@1- (6.103515625e-05,0) [-131072|131071.99994] "rpm" Vector__XXX
 SG_ Motor_B_act_torque_4 : 32|16@1- (0.1,0) [-3276.8|3276.7] "%" Vector__XXX
 SG_ Motor_B_act_current_4 : 48|16@1- (0.015625,0) [-512|511.984375] "A" Vector__XXX
 SG_ Motor_B_act_velocity_3 : 0|32@1- (6.103515625e-05,0) [-131072|131071.99994] "rpm" Vector__XXX
 SG_ Motor_B_act_torque_3 : 32|16@1- (0.1,0) [-3276.8|3276.7] "%" Vector__XXX
 SG_ Motor_B_act_current_3 : 48|16@1- (0.015625,0) [-512|511.984375] "A" Vector__XXX
 SG_ Motor_B_act_velocity_2 : 0|32@1- (6.103515625e-05,0) [-131072|131071.99994] "rpm" Vector__XXX
 SG_ Motor_B_act_torque_2 : 32|16@1- (0.1,0) [-3276.8|3276.7] "%" Vector__XXX
 SG_ Motor_B_act_current_2 : 48|16@1- (0.015625,0) [-512|511.984375] "A" Vector__XXX
 SG_ Motor_B_act_velocity_1 : 0|32@1- (6.103515625e-05,0) [-131072|131071.99994] "rpm" Vector__XXX
 SG_ Motor_B_act_torque_1 : 32|16@1- (0.1,0) [-3276.8|3276.7] "%" Vector__XXX
 SG_ Motor_B_act_current_1 : 48|16@1- (0.015625,0) [-512|511.984375] "A" Vector__XXX
 SG_ Motor_B_act_velocity_13 : 0|32@1- (6.103515625e-05,0) [-131072|131071.99994] "rpm" Vector__XXX
 SG_ Motor_B_act_torque_13 : 32|16@1- (0.1,0) [-3276.8|3276.7] "%" Vector__XXX
 SG_ Motor_B_act_current_13 : 48|16@1- (0.015625,0) [-512|511.984375] "A" Vector__XXX
 SG_ Motor_B_act_velocity_12 : 0|32@1- (6.103515625e-05,0) [-131072|131071.99994] "rpm" Vector__XXX
 SG_ Motor_B_act_torque_12 : 32|16@1- (0.1,0) [-3276.8|3276.7] "%" Vector__XXX
 SG_ Motor_B_act_current_12 : 48|16@1- (0.015625,0) [-512|511.984375] "A" Vector__XXX
 SG_ Motor_B_act_velocity_11 : 0|32@1- (6.103515625e-05,0) [-131072|131071.99994] "rpm" Vector__XXX
 SG_ Motor_B_act_torque_11 : 32|16@1- (0.1,0) [-3276.8|3276.7] "%" Vector__XXX
 SG_ Motor_B_act_current_11 : 48|16@1- (0.015625,0) [-512|511.984375] "A" Vector__XXX
 SG_ Motor_B_act_velocity_10 : 0|32@1- (6.103515625e-05,0) [-131072|131071.99994] "rpm" Vector__XXX
 SG_ Motor_B_act_torque_10 : 32|16@1- (0.1,0) [-3276.8|3276.7] "%" Vector__XXX
 SG_ Motor_B_act_current_10 : 48|16@1- (0.015625,0) [-512|511.984375] "A" Vector__XXX
 SG_ Motor_B_act_velocity_9 : 0|32@1- (6.103515625e-05,0) [-131072|131071.99994] "rpm" Vector__XXX
 SG_ Motor_B_act_torque_9 : 32|16@1- (0.1,0) [-3276.8|3276.7] "%" Vector__XXX
 SG_ Motor_B_act_current_9 : 48|16@1- (0.015625,0) [-512|511.984375] "A" Vector__XXX
 SG_ Motor_B_act_velocity_8 : 0|32@1- (6.103515625e-05,0) [-131072|131071.99994] "rpm" Vector__XXX
 SG_ Motor_B_act_torque_8 : 32|16@1- (0.1,0) [-3276.8|3276.7] "%" Vector__XXX
 SG_ Motor_B_act_current_8 : 48|16@1- (0.015625,0) [-512|511.984375] "A" Vector__XXX
 SG_ Motor_B_act_velocity_7 : 0|32@1- (6.103515625e-05,0) [-131072|131071.99994] "rpm" Vector__XXX
 SG_ Motor_B_act_torque_7 : 32|16@1- (0.1,0) [-3276.8|3276.7] "%" Vector__XXX
 SG_ Motor_B_act_current_7 : 48|16@1- (0.015625,0) [-512|511.984375] "A" Vector__XXX
 SG_ Motor_B_act_temp_5 : 0|16@1- (0.0625,0) [-2048|2047.9375] "�C" Vector__XXX
 SG_ Motor_B_act_power_5 : 16|16@1- (0.016,0) [-524.288|524.272] "kW" Vector__XXX
 SG_ Motor_B_act_voltage_5 : 32|16@1- (0.0625,0) [-2048|2047.9375] "V" Vector__XXX
 SG_ Inverter_B_act_module_temp_5 : 48|16@1- (0.0625,0) [-2048|2047.9375] "�C" Vector__XXX
 SG_ Motor_B_act_temp_4 : 0|16@1- (0.0625,0) [-2048|2047.9375] "�C" Vector__XXX
 SG_ Motor_B_act_power_4 : 16|16@1- (0.016,0) [-524.288|524.272] "kW" Vector__XXX
 SG_ Motor_B_act_voltage_4 : 32|16@1- (0.0625,0) [-2048|2047.9375] "V" Vector__XXX
 SG_ Inverter_B_act_module_temp_4 : 48|16@1- (0.0625,0) [-2048|2047.9375] "�C" Vector__XXX
 SG_ Motor_B_act_temp_3 : 0|16@1- (0.0625,0) [-2048|2047.9375] "�C" Vector__XXX
 SG_ Motor_B_act_power_3 : 16|16@1- (0.016,0) [-524.288|524.272] "kW" Vector__XXX
 SG_ Motor_B_act_voltage_3 : 32|16@1- (0.0625,0) [-2048|2047.9375] "V" Vector__XXX
 SG_ Inverter_B_act_module_temp_3 : 48|16@1- (0.0625,0) [-2048|2047.9375] "�C" Vector__XXX
 SG_ Motor_B_act_temp_2 : 0|16@1- (0.0625,0) [-2048|2047.9375] "�C" Vector__XXX
 SG_ Motor_B_act_power_2 : 16|16@1- (0.016,0) [-524.288|524.272] "kW" Vector__XXX
 SG_ Motor_B_act_voltage_2 : 32|16@1- (0.0625,0) [-2048|2047.9375] "V" Vector__XXX
 SG_ Inverter_B_act_module_temp_2 : 48|16@1- (0.0625,0) [-2048|2047.9375] "�C" Vector__XXX
 SG_ Motor_B_act_temp_1 : 0|16@1- (0.0625,0) [-2048|2047.9375] "�C" Vector__XXX
 SG_ Motor_B_act_power_1 : 16|16@1- (0.016,0) [-524.288|524.272] "kW" Vector__XXX
 SG_ Motor_B_act_voltage_1 : 32|16@1- (0.0625,0) [-2048|2047.9375] "V" Vector__XXX
 SG_ Inverter_B_act_module_temp_1 : 48|16@1- (0.0625,0) [-2048|2047.9375] "�C" Vector__XXX
 SG_ Motor_B_act_temp_13 : 0|16@1- (0.0625,0) [-2048|2047.9375] "�C" Vector__XXX
 SG_ Motor_B_act_power_13 : 16|16@1- (0.016,0) [-524.288|524.272] "kW" Vector__XXX
 SG_ Motor_B_act_voltage_13 : 32|16@1- (0.0625,0) [-2048|2047.9375] "V" Vector__XXX
 SG_ Inverter_B_act_module_temp_13 : 48|16@1- (0.0625,0) [-2048|2047.9375] "�C" Vector__XXX
 SG_ Motor_B_act_temp_12 : 0|16@1- (0.0625,0) [-2048|2047.9375] "�C" Vector__XXX
 SG_ Motor_B_act_power_12 : 16|16@1- (0.016,0) [-524.288|524.272] "kW" Vector__XXX
 SG_ Motor_B_act_voltage_12 : 32|16@1- (0.0625,0) [-2048|2047.9375] "V" Vector__XXX
 SG_ Inverter_B_act_module_temp_12 : 48|16@1- (0.0625,0) [-2048|2047.9375] "�C" Vector__XXX
 SG_ Motor_B_act_temp_11 : 0|16@1- (0.0625,0) [-2048|2047.9375] "�C" Vector__XXX
 SG_ Motor_B_act_power_11 : 16|16@1- (0.016,0) [-524.288|524.272] "kW" Vector__XXX
 SG_ Motor_B_act_voltage_11 : 32|16@1- (0.0625,0) [-2048|2047.9375] "V" Vector__XXX
 SG_ Inverter_B_act_module_temp_11 : 48|16@1- (0.0625,0) [-2048|2047.9375] "�C" Vector__XXX
 SG_ Motor_B_act_temp_10 : 0|16@1- (0.0625,0) [-2048|2047.9375] "�C" Vector__XXX
 SG_ Motor_B_act_power_10 : 16|16@1- (0.016,0) [-524.288|524.272] "kW" Vector__XXX
 SG_ Motor_B_act_voltage_10 : 32|16@1- (0.0625,0) [-2048|2047.9375] "V" Vector__XXX
 SG_ Inverter_B_act_module_temp_10 : 48|16@1- (0.0625,0) [-2048|2047.9375] "�C" Vector__XXX
 SG_ Motor_B_act_temp_9 : 0|16@1- (0.0625,0) [-2048|2047.9375] "�C" Vector__XXX
 SG_ Motor_B_act_power_9 : 16|16@1- (0.016,0) [-524.288|524.272] "kW" Vector__XXX
 SG_ Motor_B_act_voltage_9 : 32|16@1- (0.0625,0) [-2048|2047.9375] "V" Vector__XXX
 SG_ Inverter_B_act_module_temp_9 : 48|16@1- (0.0625,0) [-2048|2047.9375] "�C" Vector__XXX
 SG_ Motor_B_act_temp_8 : 0|16@1- (0.0625,0) [-2048|2047.9375] "�C" Vector__XXX
 SG_ Motor_B_act_power_8 : 16|16@1- (0.016,0) [-524.288|524.272] "kW" Vector__XXX
 SG_ Motor_B_act_voltage_8 : 32|16@1- (0.0625,0) [-2048|2047.9375] "V" Vector__XXX
 SG_ Inverter_B_act_module_temp_8 : 48|16@1- (0.0625,0) [-2048|2047.9375] "�C" Vector__XXX
 SG_ Motor_B_act_temp_7 : 0|16@1- (0.0625,0) [-2048|2047.9375] "�C" Vector__XXX
 SG_ Motor_B_act_power_7 : 16|16@1- (0.016,0) [-524.288|524.272] "kW" Vector__XXX
 SG_ Motor_B_act_voltage_7 : 32|16@1- (0.0625,0) [-2048|2047.9375] "V" Vector__XXX
 SG_ Inverter_B_act_module_temp_7 : 48|16@1- (0.0625,0) [-2048|2047.9375] "�C" Vector__XXX
 SG_ Inverter_A_Controlword_5 : 0|16@1+ (1,0) [0|65535] "" Vector__XXX
 SG_ Motor_A_target_velocity_5 : 16|32@1- (6.103515625e-05,0) [-131072|131071.99994] "rpm" Vector__XXX
 SG_ Motor_A_target_torque_5 : 48|16@1- (0.1,0) [-3276.8|3276.7] "%" Vector__XXX
 SG_ Inverter_A_Controlword_4 : 0|16@1+ (1,0) [0|65535] "" Vector__XXX
 SG_ Motor_A_target_velocity_4 : 16|32@1- (6.103515625e-05,0) [-131072|131071.99994] "rpm" Vector__XXX
 SG_ Motor_A_target_torque_4 : 48|16@1- (0.1,0) [-3276.8|3276.7] "%" Vector__XXX
 SG_ Inverter_A_Controlword_3 : 0|16@1+ (1,0) [0|65535] "" Vector__XXX
 SG_ Motor_A_target_velocity_3 : 16|32@1- (6.103515625e-05,0) [-131072|131071.99994] "rpm" Vector__XXX
 SG_ Motor_A_target_torque_3 : 48|16@1- (0.1,0) [-3276.8|3276.7] "%" Vector__XXX
 SG_ Inverter_A_Controlword_2 : 0|16@1+ (1,0) [0|65535] "" Vector__XXX
 SG_ Motor_A_target_velocity_2 : 16|32@1- (6.103515625e-05,0) [-131072|131071.99994] "rpm" Vector__XXX
 SG_ Motor_A_target_torque_2 : 48|16@1- (0.1,0) [-3276.8|3276.7] "%" Vector__XXX
 SG_ Inverter_A_Controlword_1 : 0|16@1+ (1,0) [0|65535] "" Vector__XXX
 SG_ Motor_A_target_velocity_1 : 16|32@1- (6.103515625e-05,0) [-131072|131071.99994] "rpm" Vector__XXX
 SG_ Motor_A_target_torque_1 : 48|16@1- (0.1,0) [-3276.8|3276.7] "%" Vector__XXX
 SG_ Inverter_A_Controlword_13 : 0|16@1+ (1,0) [0|65535] "" Vector__XXX
 SG_ Motor_A_target_velocity_13 : 16|32@1- (6.103515625e-05,0) [-131072|131071.99994] "rpm" Vector__XXX
 SG_ Motor_A_target_torque_13 : 48|16@1- (0.1,0) [-3276.8|3276.7] "%" Vector__XXX
 SG_ Inverter_A_Controlword_12 : 0|16@1+ (1,0) [0|65535] "" Vector__XXX
 SG_ Motor_A_target_velocity_12 : 16|32@1- (6.103515625e-05,0) [-131072|131071.99994] "rpm" Vector__XXX
 SG_ Motor_A_target_torque_12 : 48|16@1- (0.1,0) [-3276.8|3276.7] "%" Vector__XXX
 SG_ Inverter_A_Controlword_11 : 0|16@1+ (1,0) [0|65535] "" Vector__XXX
 SG_ Motor_A_target_velocity_11 : 16|32@1- (6.103515625e-05,0) [-131072|131071.99994] "rpm" Vector__XXX
 SG_ Motor_A_target_torque_11 : 48|16@1- (0.1,0) [-3276.8|3276.7] "%" Vector__XXX
 SG_ Inverter_A_Controlword_10 : 0|16@1+ (1,0) [0|65535] "" Vector__XXX
 SG_ Motor_A_target_velocity_10 : 16|32@1- (6.103515625e-05,0) [-131072|131071.99994] "rpm" Vector__XXX
 SG_ Motor_A_target_torque_10 : 48|16@1- (0.1,0) [-3276.8|3276.7] "%" Vector__XXX
 SG_ Inverter_A_Controlword_9 : 0|16@1+ (1,0) [0|65535] "" Vector__XXX
 SG_ Motor_A_target_velocity_9 : 16|32@1- (6.103515625e-05,0) [-131072|131071.99994] "rpm" Vector__XXX
 SG_ Motor_A_target_torque_9 : 48|16@1- (0.1,0) [-3276.8|3276.7] "%" Vector__XXX
 SG_ Inverter_A_Controlword_8 : 0|16@1+ (1,0) [0|65535] "" Vector__XXX
 SG_ Motor_A_target_velocity_8 : 16|32@1- (6.103515625e-05,0) [-131072|131071.99994] "rpm" Vector__XXX
 SG_ Motor_A_target_torque_8 : 48|16@1- (0.1,0) [-3276.8|3276.7] "%" Vector__XXX
 SG_ Inverter_A_Controlword_7 : 0|16@1+ (1,0) [0|65535] "" Vector__XXX
 SG_ Motor_A_target_velocity_7 : 16|32@1- (6.103515625e-05,0) [-131072|131071.99994] "rpm" Vector__XXX
 SG_ Motor_A_target_torque_7 : 48|16@1- (0.1,0) [-3276.8|3276.7] "%" Vector__XXX
 SG_ Motor_A_dc_link_vol_max_5 : 0|16@1- (0.0625,0) [-2048|2047.9375] "V" Vector__XXX
 SG_ Motor_A_dc_link_vol_min_5 : 16|16@1- (0.0625,0) [-2048|2047.9375] "V" Vector__XXX
 SG_ Motor_A_mot_power_max_5 : 32|16@1- (0.1,0) [-3276.8|3276.7] "%" Vector__XXX
 SG_ Motor_A_gen_power_max_5 : 48|16@1- (0.1,0) [-3276.8|3276.7] "%" Vector__XXX
 SG_ Motor_A_dc_link_vol_max_4 : 0|16@1- (0.0625,0) [-2048|2047.9375] "V" Vector__XXX
 SG_ Motor_A_dc_link_vol_min_4 : 16|16@1- (0.0625,0) [-2048|2047.9375] "V" Vector__XXX
 SG_ Motor_A_mot_power_max_4 : 32|16@1- (0.1,0) [-3276.8|3276.7] "%" Vector__XXX
 SG_ Motor_A_gen_power_max_4 : 48|16@1- (0.1,0) [-3276.8|3276.7] "%" Vector__XXX
 SG_ Motor_A_dc_link_vol_max_3 : 0|16@1- (0.0625,0) [-2048|2047.9375] "V" Vector__XXX
 SG_ Motor_A_dc_link_vol_min_3 : 16|16@1- (0.0625,0) [-2048|2047.9375] "V" Vector__XXX
 SG_ Motor_A_mot_power_max_3 : 32|16@1- (0.1,0) [-3276.8|3276.7] "%" Vector__XXX
 SG_ Motor_A_gen_power_max_3 : 48|16@1- (0.1,0) [-3276.8|3276.7] "%" Vector__XXX
 SG_ Motor_A_dc_link_vol_max_2 : 0|16@1- (0.0625,0) [-2048|2047.9375] "V" Vector__XXX
 SG_ Motor_A_dc_link_vol_min_2 : 16|16@1- (0.0625,0) [-2048|2047.9375] "V" Vector__XXX
 SG_ Motor_A_mot_power_max_2 : 32|16@1- (0.1,0) [-3276.8|3276.7] "%" Vector__XXX
 SG_ Motor_A_gen_power_max_2 : 48|16@1- (0.1,0) [-3276.8|3276.7] "%" Vector__XXX
 SG_ Motor_A_dc_link_vol_max_1 : 0|16@1- (0.0625,0) [-2048|2047.9375] "V" Vector__XXX
 SG_ Motor_A_dc_link_vol_min_1 : 16|16@1- (0.0625,0) [-2048|2047.9375] "V" Vector__XXX
 SG_ Motor_A_mot_power_max_1 : 32|16@1- (0.1,0) [-3276.8|3276.7] "%" Vector__XXX
 SG_ Motor_A_gen_power_max_1 : 48|16@1- (0.1,0) [-3276.8|3276.7] "%" Vector__XXX
 SG_ Motor_A_dc_link_vol_max_13 : 0|16@1- (0.0625,0) [-2048|2047.9375] "V" Vector__XXX
 SG_ Motor_A_dc_link_vol_min_13 : 16|16@1- (0.0625,0) [-2048|2047.9375] "V" Vector__XXX
 SG_ Motor_A_mot_power_max_13 : 32|16@1- (0.1,0) [-3276.8|3276.7] "%" Vector__XXX
 SG_ Motor_A_gen_power_max_13 : 48|16@1- (0.1,0) [-3276.8|3276.7] "%" Vector__XXX
 SG_ Motor_A_dc_link_vol_max_12 : 0|16@1- (0.0625,0) [-2048|2047.9375] "V" Vector__XXX
 SG_ Motor_A_dc_link_vol_min_12 : 16|16@1- (0.0625,0) [-2048|2047.9375] "V" Vector__XXX
 SG_ Motor_A_mot_power_max_12 : 32|16@1- (0.1,0) [-3276.8|3276.7] "%" Vector__XXX
 SG_ Motor_A_gen_power_max_12 : 48|16@1- (0.1,0) [-3276.8|3276.7] "%" Vector__XXX
 SG_ Motor_A_dc_link_vol_max_11 : 0|16@1- (0.0625,0) [-2048|2047.9375] "V" Vector__XXX
 SG_ Motor_A_dc_link_vol_min_11 : 16|16@1- (0.0625,0) [-2048|2047.9375] "V" Vector__XXX
 SG_ Motor_A_mot_power_max_11 : 32|16@1- (0.1,0) [-3276.8|3276.7] "%" Vector__XXX
 SG_ Motor_A_gen_power_max_11 : 48|16@1- (0.1,0) [-3276.8|3276.7] "%" Vector__XXX
 SG_ Motor_A_dc_link_vol_max_10 : 0|16@1- (0.0625,0) [-2048|2047.9375] "V" Vector__XXX
 SG_ Motor_A_dc_link_vol_min_10 : 16|16@1- (0.0625,0) [-2048|2047.9375] "V" Vector__XXX
 SG_ Motor_A_mot_power_max_10 : 32|16@1- (0.1,0) [-3276.8|3276.7] "%" Vector__XXX
 SG_ Motor_A_gen_power_max_10 : 48|16@1- (0.1,0) [-3276.8|3276.7] "%" Vector__XXX
 SG_ Motor_A_dc_link_vol_max_9 : 0|16@1- (0.0625,0) [-2048|2047.9375] "V" Vector__XXX
 SG_ Motor_A_dc_link_vol_min_9 : 16|16@1- (0.0625,0) [-2048|2047.9375] "V" Vector__XXX
 SG_ Motor_A_mot_power_max_9 : 32|16@1- (0.1,0) [-3276.8|3276.7] "%" Vector__XXX
 SG_ Motor_A_gen_power_max_9 : 48|16@1- (0.1,0) [-3276.8|3276.7] "%" Vector__XXX
 SG_ Motor_A_dc_link_vol_max_8 : 0|16@1- (0.0625,0) [-2048|2047.9375] "V" Vector__XXX
 SG_ Motor_A_dc_link_vol_min_8 : 16|16@1- (0.0625,0) [-2048|2047.9375] "V" Vector__XXX
 SG_ Motor_A_mot_power_max_8 : 32|16@1- (0.1,0) [-3276.8|3276.7] "%" Vector__XXX
 SG_ Motor_A_gen_power_max_8 : 48|16@1- (0.1,0) [-3276.8|3276.7] "%" Vector__XXX
 SG_ Motor_A_dc_link_vol_max_7 : 0|16@1- (0.0625,0) [-2048|2047.9375] "V" Vector__XXX
 SG_ Motor_A_dc_link_vol_min_7 : 16|16@1- (0.0625,0) [-2048|2047.9375] "V" Vector__XXX
 SG_ Motor_A_mot_power_max_7 : 32|16@1- (0.1,0) [-3276.8|3276.7] "%" Vector__XXX
 SG_ Motor_A_gen_power_max_7 : 48|16@1- (0.1,0) [-3276.8|3276.7] "%" Vector__XXX
 SG_ Inverter_B_Controlword_5 : 0|16@1+ (1,0) [0|65535] "" Vector__XXX
 SG_ Motor_B_target_velocity_5 : 16|32@1- (6.103515625e-05,0) [-131072|131071.99994] "rpm" Vector__XXX
 SG_ Motor_B_target_torque_5 : 48|16@1- (0.1,0) [-3276.8|3276.7] "%" Vector__XXX
 SG_ Inverter_B_Controlword_4 : 0|16@1+ (1,0) [0|65535] "" Vector__XXX
 SG_ Motor_B_target_velocity_4 : 16|32@1- (6.103515625e-05,0) [-131072|131071.99994] "rpm" Vector__XXX
 SG_ Motor_B_target_torque_4 : 48|16@1- (0.1,0) [-3276.8|3276.7] "%" Vector__XXX
 SG_ Inverter_B_Controlword_3 : 0|16@1+ (1,0) [0|65535] "" Vector__XXX
 SG_ Motor_B_target_velocity_3 : 16|32@1- (6.103515625e-05,0) [-131072|131071.99994] "rpm" Vector__XXX
 SG_ Motor_B_target_torque_3 : 48|16@1- (0.1,0) [-3276.8|3276.7] "%" Vector__XXX
 SG_ Inverter_B_Controlword_2 : 0|16@1+ (1,0) [0|65535] "" Vector__XXX
 SG_ Motor_B_target_velocity_2 : 16|32@1- (6.103515625e-05,0) [-131072|131071.99994] "rpm" Vector__XXX
 SG_ Motor_B_target_torque_2 : 48|16@1- (0.1,0) [-3276.8|3276.7] "%" Vector__XXX
 SG_ Inverter_B_Controlword_1 : 0|16@1+ (1,0) [0|65535] "" Vector__XXX
 SG_ Motor_B_target_velocity_1 : 16|32@1- (6.103515625e-05,0) [-131072|131071.99994] "rpm" Vector__XXX
 SG_ Motor_B_target_torque_1 : 48|16@1- (0.1,0) [-3276.8|3276.7] "%" Vector__XXX
 SG_ Inverter_B_Controlword_13 : 0|16@1+ (1,0) [0|65535] "" Vector__XXX
 SG_ Motor_B_target_velocity_13 : 16|32@1- (6.103515625e-05,0) [-131072|131071.99994] "rpm" Vector__XXX
 SG_ Motor_B_target_torque_13 : 48|16@1- (0.1,0) [-3276.8|3276.7] "%" Vector__XXX
 SG_ Inverter_B_Controlword_12 : 0|16@1+ (1,0) [0|65535] "" Vector__XXX
 SG_ Motor_B_target_velocity_12 : 16|32@1- (6.103515625e-05,0) [-131072|131071.99994] "rpm" Vector__XXX
 SG_ Motor_B_target_torque_12 : 48|16@1- (0.1,0) [-3276.8|3276.7] "%" Vector__XXX
 SG_ Inverter_B_Controlword_11 : 0|16@1+ (1,0) [0|65535] "" Vector__XXX
 SG_ Motor_B_target_velocity_11 : 16|32@1- (6.103515625e-05,0) [-131072|131071.99994] "rpm" Vector__XXX
 SG_ Motor_B_target_torque_11 : 48|16@1- (0.1,0) [-3276.8|3276.7] "%" Vector__XXX
 SG_ Inverter_B_Controlword_10 : 0|16@1+ (1,0) [0|65535] "" Vector__XXX
 SG_ Motor_B_target_velocity_10 : 16|32@1- (6.103515625e-05,0) [-131072|131071.99994] "rpm" Vector__XXX
 SG_ Motor_B_target_torque_10 : 48|16@1- (0.1,0) [-3276.8|3276.7] "%" Vector__XXX
 SG_ Inverter_B_Controlword_9 : 0|16@1+ (1,0) [0|65535] "" Vector__XXX
 SG_ Motor_B_target_velocity_9 : 16|32@1- (6.103515625e-05,0) [-131072|131071.99994] "rpm" Vector__XXX
 SG_ Motor_B_target_torque_9 : 48|16@1- (0.1,0) [-3276.8|3276.7] "%" Vector__XXX
 SG_ Inverter_B_Controlword_8 : 0|16@1+ (1,0) [0|65535] "" Vector__XXX
 SG_ Motor_B_target_velocity_8 : 16|32@1- (6.103515625e-05,0) [-131072|131071.99994] "rpm" Vector__XXX
 SG_ Motor_B_target_torque_8 : 48|16@1- (0.1,0) [-3276.8|3276.7] "%" Vector__XXX
 SG_ Inverter_B_Controlword_7 : 0|16@1+ (1,0) [0|65535] "" Vector__XXX
 SG_ Motor_B_target_velocity_7 : 16|32@1- (6.103515625e-05,0) [-131072|131071.99994] "rpm" Vector__XXX
 SG_ Motor_B_target_torque_7 : 48|16@1- (0.1,0) [-3276.8|3276.7] "%" Vector__XXX
 SG_ Motor_B_dc_link_vol_max_5 : 0|16@1- (0.0625,0) [-2048|2047.9375] "V" Vector__XXX
 SG_ Motor_B_dc_link_vol_min_5 : 16|16@1- (0.0625,0) [-2048|2047.9375] "V" Vector__XXX
 SG_ Motor_B_mot_power_max_5 : 32|16@1- (0.1,0) [-3276.8|3276.7] "%" Vector__XXX
 SG_ Motor_B_gen_power_max_5 : 48|16@1- (0.1,0) [-3276.8|3276.7] "%" Vector__XXX
 SG_ Motor_B_dc_link_vol_max_4 : 0|16@1- (0.0625,0) [-2048|2047.9375] "V" Vector__XXX
 SG_ Motor_B_dc_link_vol_min_4 : 16|16@1- (0.0625,0) [-2048|2047.9375] "V" Vector__XXX
 SG_ Motor_B_mot_power_max_4 : 32|16@1- (0.1,0) [-3276.8|3276.7] "%" Vector__XXX
 SG_ Motor_B_gen_power_max_4 : 48|16@1- (0.1,0) [-3276.8|3276.7] "%" Vector__XXX
 SG_ Motor_B_dc_link_vol_max_3 : 0|16@1- (0.0625,0) [-2048|2047.9375] "V" Vector__XXX
 SG_ Motor_B_dc_link_vol_min_3 : 16|16@1- (0.0625,0) [-2048|2047.9375] "V" Vector__XXX
 SG_ Motor_B_mot_power_max_3 : 32|16@1- (0.1,0) [-3276.8|3276.7] "%" Vector__XXX
 SG_ Motor_B_gen_power_max_3 : 48|16@1- (0.1,0) [-3276.8|3276.7] "%" Vector__XXX
 SG_ Motor_B_dc_link_vol_max_2 : 0|16@1- (0.0625,0) [-2048|2047.9375] "V" Vector__XXX
 SG_ Motor_B_dc_link_vol_min_2 : 16|16@1- (0.0625,0) [-2048|2047.9375] "V" Vector__XXX
 SG_ Motor_B_mot_power_max_2 : 32|16@1- (0.1,0) [-3276.8|3276.7] "%" Vector__XXX
 SG_ Motor_B_gen_power_max_2 : 48|16@1- (0.1,0) [-3276.8|3276.7] "%" Vector__XXX
 SG_ Motor_B_dc_link_vol_max_1 : 0|16@1- (0.0625,0) [-2048|2047.9375] "V" Vector__XXX
 SG_ Motor_B_dc_link_vol_min_1 : 16|16@1- (0.0625,0) [-2048|2047.9375] "V" Vector__XXX
 SG_ Motor_B_mot_power_max_1 : 32|16@1- (0.1,0) [-3276.8|3276.7] "%" Vector__XXX
 SG_ Motor_B_gen_power_max_1 : 48|16@1- (0.1,0) [-3276.8|3276.7] "%" Vector__XXX
 SG_ Motor_B_dc_link_vol_max_13 : 0|16@1- (0.0625,0) [-2048|2047.9375] "V" Vector__XXX
 SG_ Motor_B_dc_link_vol_min_13 : 16|16@1- (0.0625,0) [-2048|2047.9375] "V" Vector__XXX
 SG_ Motor_B_mot_power_max_13 : 32|16@1- (0.1,0) [-3276.8|3276.7] "%" Vector__XXX
 SG_ Motor_B_gen_power_max_13 : 48|16@1- (0.1,0) [-3276.8|3276.7] "%" Vector__XXX
 SG_ Motor_B_dc_link_vol_max_12 : 0|16@1- (0.0625,0) [-2048|2047.9375] "V" Vector__XXX
 SG_ Motor_B_dc_link_vol_min_12 : 16|16@1- (0.0625,0) [-2048|2047.9375] "V" Vector__XXX
 SG_ Motor_B_mot_power_max_12 : 32|16@1- (0.1,0) [-3276.8|3276.7] "%" Vector__XXX
 SG_ Motor_B_gen_power_max_12 : 48|16@1- (0.1,0) [-3276.8|3276.7] "%" Vector__XXX
 SG_ Motor_B_dc_link_vol_max_11 : 0|16@1- (0.0625,0) [-2048|2047.9375] "V" Vector__XXX
 SG_ Motor_B_dc_link_vol_min_11 : 16|16@1- (0.0625,0) [-2048|2047.9375] "V" Vector__XXX
 SG_ Motor_B_mot_power_max_11 : 32|16@1- (0.1,0) [-3276.8|3276.7] "%" Vector__XXX
 SG_ Motor_B_gen_power_max_11 : 48|16@1- (0.1,0) [-3276.8|3276.7] "%" Vector__XXX
 SG_ Motor_B_dc_link_vol_max_10 : 0|16@1- (0.0625,0) [-2048|2047.9375] "V" Vector__XXX
 SG_ Motor_B_dc_link_vol_min_10 : 16|16@1- (0.0625,0) [-2048|2047.9375] "V" Vector__XXX
 SG_ Motor_B_mot_power_max_10 : 32|16@1- (0.1,0) [-3276.8|3276.7] "%" Vector__XXX
 SG_ Motor_B_gen_power_max_10 : 48|16@1- (0.1,0) [-3276.8|3276.7] "%" Vector__XXX
 SG_ Motor_B_dc_link_vol_max_9 : 0|16@1- (0.0625,0) [-2048|2047.9375] "V" Vector__XXX
 SG_ Motor_B_dc_link_vol_min_9 : 16|16@1- (0.0625,0) [-2048|2047.9375] "V" Vector__XXX
 SG_ Motor_B_mot_power_max_9 : 32|16@1- (0.1,0) [-3276.8|3276.7] "%" Vector__XXX
 SG_ Motor_B_gen_power_max_9 : 48|16@1- (0.1,0) [-3276.8|3276.7] "%" Vector__XXX
 SG_ Motor_B_dc_link_vol_max_8 : 0|16@1- (0.0625,0) [-2048|2047.9375] "V" Vector__XXX
 SG_ Motor_B_dc_link_vol_min_8 : 16|16@1- (0.0625,0) [-2048|2047.9375] "V" Vector__XXX
 SG_ Motor_B_mot_power_max_8 : 32|16@1- (0.1,0) [-3276.8|3276.7] "%" Vector__XXX
 SG_ Motor_B_gen_power_max_8 : 48|16@1- (0.1,0) [-3276.8|3276.7] "%" Vector__XXX
 SG_ Motor_B_dc_link_vol_max_7 : 0|16@1- (0.0625,0) [-2048|2047.9375] "V" Vector__XXX
 SG_ Motor_B_dc_link_vol_min_7 : 16|16@1- (0.0625,0) [-2048|2047.9375] "V" Vector__XXX
 SG_ Motor_B_mot_power_max_7 : 32|16@1- (0.1,0) [-3276.8|3276.7] "%" Vector__XXX
 SG_ Motor_B_gen_power_max_7 : 48|16@1- (0.1,0) [-3276.8|3276.7] "%" Vector__XXX
 SG_ systemTimeStamp : 0|32@1+ (1,0) [0|4294967295] "ms" Vector__XXX
 SG_ systemTimeStamp : 0|32@1+ (1,0) [0|4294967295] "ms" Vector__XXX
 SG_ systemTimeStamp : 0|32@1+ (1,0) [0|4294967295] "ms" Vector__XXX
 SG_ systemTimeStamp : 0|32@1+ (1,0) [0|4294967295] "ms" Vector__XXX
 SG_ systemTimeStamp : 0|32@1+ (1,0) [0|4294967295] "ms" Vector__XXX
 SG_ systemTimeStamp : 0|32@1+ (1,0) [0|4294967295] "ms" Vector__XXX
 SG_ systemTimeStamp : 0|32@1+ (1,0) [0|4294967295] "ms" Vector__XXX
 SG_ systemTimeStamp : 0|32@1+ (1,0) [0|4294967295] "ms" Vector__XXX
 SG_ systemTimeStamp : 0|32@1+ (1,0) [0|4294967295] "ms" Vector__XXX
 SG_ systemTimeStamp : 0|32@1+ (1,0) [0|4294967295] "ms" Vector__XXX
 SG_ systemTimeStamp : 0|32@1+ (1,0) [0|4294967295] "ms" Vector__XXX
 SG_ systemTimeStamp : 0|32@1+ (1,0) [0|4294967295] "ms" Vector__XXX
 SG_ j : 48|8@1+ (1,0) [0|0] "" Vector__XXX
 SG_ i : 40|8@1+ (1,0) [0|0] "" Vector__XXX

CM_ BO_ 3221225472 "This is a message for not used signals, created by Vector CANdb++ DBC OLE DB Provider.";
BA_DEF_ BU_  "Manufacturer" STRING ;
BA_DEF_ BU_  "ILUsed" ENUM  "No","Yes";
BA_DEF_ BO_  "NmMessage" ENUM  "no","yes";
BA_DEF_ BO_  "GenMsgILSupport" ENUM  "No","Yes";
BA_DEF_ BU_  "NmNode" ENUM  "no","yes";
BA_DEF_  "NmBaseAddress" HEX 1024 1087;
BA_DEF_  "BusType" STRING ;
BA_DEF_ BO_  "GenMsgSendType" ENUM  "Cyclic","NotUsed","NotUsed","NotUsed","NotUsed","Cyclic","NotUsed","IfActive","NoMsgSendType","NotUsed","vector_leerstring";
BA_DEF_ SG_  "GenSigSendType" ENUM  "Cyclic","OnWrite","OnWriteWithRepetition","OnChange","OnChangeWithRepetition","IfActive","IfActiveWithRepetition","NoSigSendType","NotUsed","NotUsed","NotUsed","NotUsed","NotUsed";
BA_DEF_ SG_  "GenSigStartValue" FLOAT 0 1215752192;
BA_DEF_DEF_  "Manufacturer" "Isabellenhuette";
BA_DEF_DEF_  "ILUsed" "Yes";
BA_DEF_DEF_  "NmMessage" "no";
BA_DEF_DEF_  "GenMsgILSupport" "Yes";
BA_DEF_DEF_  "NmNode" "no";
BA_DEF_DEF_  "NmBaseAddress" 1024;
BA_DEF_DEF_  "BusType" "CAN";
BA_DEF_DEF_  "GenMsgSendType" "NoMsgSendType";
BA_DEF_DEF_  "GenSigSendType" "OnWrite";
BA_DEF_DEF_  "GenSigStartValue" 0;
BA_ "NmNode" BU_ IVT_Mod 1;
